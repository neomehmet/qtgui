ASAP2_VERSION 1 60
/begin PROJECT Tamkin "XCP on CAN"
/begin HEADER "" VERSION "1.0.0.0" PROJECT_NO Tamkin /end HEADER
/begin MODULE Tamkin ""
/begin MEASUREMENT cap_canApiMsg_EBCM_STATUS_CHS1.BreakPedalPercent_raw "description" FLOAT32_IEEE cal_signal_objects_CM_single 0 0 0 4294967295 ECU_ADDRESS 0x00 DISPLAY_IDENTIFIER BreakPedalPercent_raw /end MEASUREMENT
/begin MEASUREMENT cap_canApiMsg_TLT_RW_CHS1.AVL_LOGR_RW_phy "description" FLOAT32_IEEE cal_signal_objects_CM_single 0 0 0 4294967295 ECU_ADDRESS 0x00 DISPLAY_IDENTIFIER AVL_LOGR_RW_phy /end MEASUREMENT
/begin MEASUREMENT cap_canApiMsg_TLT_RW_CHS1.AVL_LOGR_RW_raw "description" FLOAT32_IEEE cal_signal_objects_CM_single 0 0 0 4294967295 ECU_ADDRESS 0x00 DISPLAY_IDENTIFIER AVL_LOGR_RW_raw /end MEASUREMENT
/begin MEASUREMENT cap_canApiMsg_BundleEAFlexrayToAECANFD20msNo2_CHS1.ACLNX_COG_phy "description" FLOAT32_IEEE cal_signal_objects_CM_single 0 0 0 4294967295 ECU_ADDRESS 0x00 DISPLAY_IDENTIFIER ACLNX_COG_phy /end MEASUREMENT
/begin MEASUREMENT cap_canApiMsg_BundleEAFlexrayToAECANFD20msNo2_CHS1.ACLNX_COG_raw "description" FLOAT32_IEEE cal_signal_objects_CM_single 0 0 0 4294967295 ECU_ADDRESS 0x00 DISPLAY_IDENTIFIER ACLNX_COG_raw /end MEASUREMENT
/begin MEASUREMENT cap_canApiMsg_BundleEAFlexrayToAECANFD20msNo2_CHS1.ACLNY_COG_phy "description" FLOAT32_IEEE cal_signal_objects_CM_single 0 0 0 4294967295 ECU_ADDRESS 0x00 DISPLAY_IDENTIFIER ACLNY_COG_phy /end MEASUREMENT
/begin MEASUREMENT cap_canApiMsg_BundleEAFlexrayToAECANFD20msNo2_CHS1.ACLNY_COG_raw "description" FLOAT32_IEEE cal_signal_objects_CM_single 0 0 0 4294967295 ECU_ADDRESS 0x00 DISPLAY_IDENTIFIER ACLNY_COG_raw /end MEASUREMENT
/begin MEASUREMENT cap_canApiMsg_BundleEAFlexrayToAECANFD10msNo1_CHS1.AVL_BRTORQ_WHL_RS_LH_EXT_phy "description" FLOAT32_IEEE cal_signal_objects_CM_single 0 0 0 4294967295 ECU_ADDRESS 0x00 DISPLAY_IDENTIFIER AVL_BRTORQ_WHL_RS_LH_EXT_phy /end MEASUREMENT
/begin MEASUREMENT cap_canApiMsg_BundleEAFlexrayToAECANFD10msNo1_CHS1.AVL_BRTORQ_WHL_RS_LH_EXT_raw "description" FLOAT32_IEEE cal_signal_objects_CM_single 0 0 0 4294967295 ECU_ADDRESS 0x00 DISPLAY_IDENTIFIER AVL_BRTORQ_WHL_RS_LH_EXT_raw /end MEASUREMENT
/begin MEASUREMENT cap_canApiMsg_BundleEAFlexrayToAECANFD10msNo1_CHS1.AVL_BRTORQ_WHL_RS_RH_EXT_phy "description" FLOAT32_IEEE cal_signal_objects_CM_single 0 0 0 4294967295 ECU_ADDRESS 0x00 DISPLAY_IDENTIFIER AVL_BRTORQ_WHL_RS_RH_EXT_phy /end MEASUREMENT
/begin MEASUREMENT cap_canApiMsg_BundleEAFlexrayToAECANFD10msNo1_CHS1.AVL_BRTORQ_WHL_RS_RH_EXT_raw "description" FLOAT32_IEEE cal_signal_objects_CM_single 0 0 0 4294967295 ECU_ADDRESS 0x00 DISPLAY_IDENTIFIER AVL_BRTORQ_WHL_RS_RH_EXT_raw /end MEASUREMENT
/begin MEASUREMENT cap_canApiMsg_BundleEAFlexrayToAECANFD10msNo1_CHS1.AVL_BRTORQ_WHL_FS_LH_EXT_phy "description" FLOAT32_IEEE cal_signal_objects_CM_single 0 0 0 4294967295 ECU_ADDRESS 0x00 DISPLAY_IDENTIFIER AVL_BRTORQ_WHL_FS_LH_EXT_phy /end MEASUREMENT
/begin MEASUREMENT cap_canApiMsg_BundleEAFlexrayToAECANFD10msNo1_CHS1.AVL_BRTORQ_WHL_FS_LH_EXT_raw "description" FLOAT32_IEEE cal_signal_objects_CM_single 0 0 0 4294967295 ECU_ADDRESS 0x00 DISPLAY_IDENTIFIER AVL_BRTORQ_WHL_FS_LH_EXT_raw /end MEASUREMENT
/begin MEASUREMENT cap_canApiMsg_BundleEAFlexrayToAECANFD10msNo1_CHS1.AVL_BRTORQ_WHL_FS_RH_EXT_phy "description" FLOAT32_IEEE cal_signal_objects_CM_single 0 0 0 4294967295 ECU_ADDRESS 0x00 DISPLAY_IDENTIFIER AVL_BRTORQ_WHL_FS_RH_EXT_phy /end MEASUREMENT
/begin MEASUREMENT cap_canApiMsg_BundleEAFlexrayToAECANFD10msNo1_CHS1.AVL_BRTORQ_WHL_FS_RH_EXT_raw "description" FLOAT32_IEEE cal_signal_objects_CM_single 0 0 0 4294967295 ECU_ADDRESS 0x00 DISPLAY_IDENTIFIER AVL_BRTORQ_WHL_FS_RH_EXT_raw /end MEASUREMENT
/begin MEASUREMENT cap_canApiMsg_BundleEAFlexrayToAECANFD10msNo1_CHS1.TAR_RPM_MAX_BAX_phy "description" FLOAT32_IEEE cal_signal_objects_CM_single 0 0 0 4294967295 ECU_ADDRESS 0x00 DISPLAY_IDENTIFIER TAR_RPM_MAX_BAX_phy /end MEASUREMENT
/begin MEASUREMENT cap_canApiMsg_BundleEAFlexrayToAECANFD10msNo1_CHS1.TAR_RPM_MAX_BAX_raw "description" FLOAT32_IEEE cal_signal_objects_CM_single 0 0 0 4294967295 ECU_ADDRESS 0x00 DISPLAY_IDENTIFIER TAR_RPM_MAX_BAX_raw /end MEASUREMENT
/begin MEASUREMENT cap_canApiMsg_BundleEAFlexrayToAECANFD10msNo1_CHS1.TAR_RPM_MIN_BAX_phy "description" FLOAT32_IEEE cal_signal_objects_CM_single 0 0 0 4294967295 ECU_ADDRESS 0x00 DISPLAY_IDENTIFIER TAR_RPM_MIN_BAX_phy /end MEASUREMENT
/begin MEASUREMENT cap_canApiMsg_BundleEAFlexrayToAECANFD10msNo1_CHS1.TAR_RPM_MIN_BAX_raw "description" FLOAT32_IEEE cal_signal_objects_CM_single 0 0 0 4294967295 ECU_ADDRESS 0x00 DISPLAY_IDENTIFIER TAR_RPM_MIN_BAX_raw /end MEASUREMENT
/begin MEASUREMENT cap_canApiMsg_BundleEAFlexrayToAECANFD10msNo1_CHS1.TAR_RPM_MAX_FTAX_phy "description" FLOAT32_IEEE cal_signal_objects_CM_single 0 0 0 4294967295 ECU_ADDRESS 0x00 DISPLAY_IDENTIFIER TAR_RPM_MAX_FTAX_phy /end MEASUREMENT
/begin MEASUREMENT cap_canApiMsg_BundleEAFlexrayToAECANFD10msNo1_CHS1.TAR_RPM_MAX_FTAX_raw "description" FLOAT32_IEEE cal_signal_objects_CM_single 0 0 0 4294967295 ECU_ADDRESS 0x00 DISPLAY_IDENTIFIER TAR_RPM_MAX_FTAX_raw /end MEASUREMENT
/begin MEASUREMENT cap_canApiMsg_BundleEAFlexrayToAECANFD10msNo1_CHS1.TAR_RPM_MIN_FTAX_phy "description" FLOAT32_IEEE cal_signal_objects_CM_single 0 0 0 4294967295 ECU_ADDRESS 0x00 DISPLAY_IDENTIFIER TAR_RPM_MIN_FTAX_phy /end MEASUREMENT
/begin MEASUREMENT cap_canApiMsg_BundleEAFlexrayToAECANFD10msNo1_CHS1.TAR_RPM_MIN_FTAX_raw "description" FLOAT32_IEEE cal_signal_objects_CM_single 0 0 0 4294967295 ECU_ADDRESS 0x00 DISPLAY_IDENTIFIER TAR_RPM_MIN_FTAX_raw /end MEASUREMENT
/begin MEASUREMENT cap_canApiMsg_AVL_RPM_WHL_CHS1.AVL_RPM_WHL_RLH_phy "description" FLOAT32_IEEE cal_signal_objects_CM_single 0 0 0 4294967295 ECU_ADDRESS 0x00 DISPLAY_IDENTIFIER AVL_RPM_WHL_RLH_phy /end MEASUREMENT
/begin MEASUREMENT cap_canApiMsg_AVL_RPM_WHL_CHS1.AVL_RPM_WHL_RLH_raw "description" FLOAT32_IEEE cal_signal_objects_CM_single 0 0 0 4294967295 ECU_ADDRESS 0x00 DISPLAY_IDENTIFIER AVL_RPM_WHL_RLH_raw /end MEASUREMENT
/begin MEASUREMENT cap_canApiMsg_AVL_RPM_WHL_CHS1.AVL_RPM_WHL_RRH_phy "description" FLOAT32_IEEE cal_signal_objects_CM_single 0 0 0 4294967295 ECU_ADDRESS 0x00 DISPLAY_IDENTIFIER AVL_RPM_WHL_RRH_phy /end MEASUREMENT
/begin MEASUREMENT cap_canApiMsg_AVL_RPM_WHL_CHS1.AVL_RPM_WHL_RRH_raw "description" FLOAT32_IEEE cal_signal_objects_CM_single 0 0 0 4294967295 ECU_ADDRESS 0x00 DISPLAY_IDENTIFIER AVL_RPM_WHL_RRH_raw /end MEASUREMENT
/begin MEASUREMENT cap_canApiMsg_AVL_RPM_WHL_CHS1.AVL_RPM_WHL_FLH_phy "description" FLOAT32_IEEE cal_signal_objects_CM_single 0 0 0 4294967295 ECU_ADDRESS 0x00 DISPLAY_IDENTIFIER AVL_RPM_WHL_FLH_phy /end MEASUREMENT
/begin MEASUREMENT cap_canApiMsg_AVL_RPM_WHL_CHS1.AVL_RPM_WHL_FLH_raw "description" FLOAT32_IEEE cal_signal_objects_CM_single 0 0 0 4294967295 ECU_ADDRESS 0x00 DISPLAY_IDENTIFIER AVL_RPM_WHL_FLH_raw /end MEASUREMENT
/begin MEASUREMENT cap_canApiMsg_AVL_RPM_WHL_CHS1.AVL_RPM_WHL_FRH_phy "description" FLOAT32_IEEE cal_signal_objects_CM_single 0 0 0 4294967295 ECU_ADDRESS 0x00 DISPLAY_IDENTIFIER AVL_RPM_WHL_FRH_phy /end MEASUREMENT
/begin MEASUREMENT cap_canApiMsg_AVL_RPM_WHL_CHS1.AVL_RPM_WHL_FRH_raw "description" FLOAT32_IEEE cal_signal_objects_CM_single 0 0 0 4294967295 ECU_ADDRESS 0x00 DISPLAY_IDENTIFIER AVL_RPM_WHL_FRH_raw /end MEASUREMENT
/begin MEASUREMENT cap_canApiMsg_BundleEAFlexrayToCANFD20msNo1_CHS1.V_VEH_COG_phy "description" FLOAT32_IEEE cal_signal_objects_CM_single 0 0 0 4294967295 ECU_ADDRESS 0x00 DISPLAY_IDENTIFIER V_VEH_COG_phy /end MEASUREMENT
/begin MEASUREMENT cap_canApiMsg_BundleEAFlexrayToCANFD20msNo1_CHS1.V_VEH_COG_raw "description" FLOAT32_IEEE cal_signal_objects_CM_single 0 0 0 4294967295 ECU_ADDRESS 0x00 DISPLAY_IDENTIFIER V_VEH_COG_raw /end MEASUREMENT
/begin MEASUREMENT cap_canApiMsg_SFA_SteerWheel_Info_CHS1.SFA_SteerWheelTorque_phy "description" FLOAT32_IEEE cal_signal_objects_CM_single 0 0 0 4294967295 ECU_ADDRESS 0x00 DISPLAY_IDENTIFIER SFA_SteerWheelTorque_phy /end MEASUREMENT
/begin MEASUREMENT cap_canApiMsg_SFA_SteerWheel_Info_CHS1.SFA_SteerWheelTorque_raw "description" FLOAT32_IEEE cal_signal_objects_CM_single 0 0 0 4294967295 ECU_ADDRESS 0x00 DISPLAY_IDENTIFIER SFA_SteerWheelTorque_raw /end MEASUREMENT
/begin MEASUREMENT cap_canApiMsg_SFA_SteerWheel_Info_CHS1.SFA_SteerWheelAngleSpeed_phy "description" FLOAT32_IEEE cal_signal_objects_CM_single 0 0 0 4294967295 ECU_ADDRESS 0x00 DISPLAY_IDENTIFIER SFA_SteerWheelAngleSpeed_phy /end MEASUREMENT
/begin MEASUREMENT cap_canApiMsg_SFA_SteerWheel_Info_CHS1.SFA_SteerWheelAngleSpeed_raw "description" FLOAT32_IEEE cal_signal_objects_CM_single 0 0 0 4294967295 ECU_ADDRESS 0x00 DISPLAY_IDENTIFIER SFA_SteerWheelAngleSpeed_raw /end MEASUREMENT
/begin MEASUREMENT cap_canApiMsg_SFA_SteerWheel_Info_CHS1.SFA_SteerWheelAngle_phy "description" FLOAT32_IEEE cal_signal_objects_CM_single 0 0 0 4294967295 ECU_ADDRESS 0x00 DISPLAY_IDENTIFIER SFA_SteerWheelAngle_phy /end MEASUREMENT
/begin MEASUREMENT cap_canApiMsg_SFA_SteerWheel_Info_CHS1.SFA_SteerWheelAngle_raw "description" FLOAT32_IEEE cal_signal_objects_CM_single 0 0 0 4294967295 ECU_ADDRESS 0x00 DISPLAY_IDENTIFIER SFA_SteerWheelAngle_raw /end MEASUREMENT
/begin MEASUREMENT cap_canApiMsg_VCU_TractionEMachine2_10ms_CHS2.RpmEmETractSys2ActualValue_phy "description" FLOAT32_IEEE cal_signal_objects_CM_single 0 0 0 4294967295 ECU_ADDRESS 0x00 DISPLAY_IDENTIFIER RpmEmETractSys2ActualValue_phy /end MEASUREMENT
/begin MEASUREMENT cap_canApiMsg_VCU_TractionEMachine2_10ms_CHS2.RpmEmETractSys2ActualValue_raw "description" FLOAT32_IEEE cal_signal_objects_CM_single 0 0 0 4294967295 ECU_ADDRESS 0x00 DISPLAY_IDENTIFIER RpmEmETractSys2ActualValue_raw /end MEASUREMENT
/begin MEASUREMENT cap_canApiMsg_VCU_TractionEMachine2_10ms_CHS2.TorqueEmETractSys2GeneratorDyn_phy "description" FLOAT32_IEEE cal_signal_objects_CM_single 0 0 0 4294967295 ECU_ADDRESS 0x00 DISPLAY_IDENTIFIER TorqueEmETractSys2GeneratorDyn_phy /end MEASUREMENT
/begin MEASUREMENT cap_canApiMsg_VCU_TractionEMachine2_10ms_CHS2.TorqueEmETractSys2GeneratorDyn_raw "description" FLOAT32_IEEE cal_signal_objects_CM_single 0 0 0 4294967295 ECU_ADDRESS 0x00 DISPLAY_IDENTIFIER TorqueEmETractSys2GeneratorDyn_raw /end MEASUREMENT
/begin MEASUREMENT cap_canApiMsg_VCU_TractionEMachine2_10ms_CHS2.TorqueEmETractSys2MotorDyn_phy "description" FLOAT32_IEEE cal_signal_objects_CM_single 0 0 0 4294967295 ECU_ADDRESS 0x00 DISPLAY_IDENTIFIER TorqueEmETractSys2MotorDyn_phy /end MEASUREMENT
/begin MEASUREMENT cap_canApiMsg_VCU_TractionEMachine2_10ms_CHS2.TorqueEmETractSys2MotorDyn_raw "description" FLOAT32_IEEE cal_signal_objects_CM_single 0 0 0 4294967295 ECU_ADDRESS 0x00 DISPLAY_IDENTIFIER TorqueEmETractSys2MotorDyn_raw /end MEASUREMENT
/begin MEASUREMENT cap_canApiMsg_VCU_TractionEMachine2_10ms_CHS2.TorqueEmETractSys2ActualValue_phy "description" FLOAT32_IEEE cal_signal_objects_CM_single 0 0 0 4294967295 ECU_ADDRESS 0x00 DISPLAY_IDENTIFIER TorqueEmETractSys2ActualValue_phy /end MEASUREMENT
/begin MEASUREMENT cap_canApiMsg_VCU_TractionEMachine2_10ms_CHS2.TorqueEmETractSys2ActualValue_raw "description" FLOAT32_IEEE cal_signal_objects_CM_single 0 0 0 4294967295 ECU_ADDRESS 0x00 DISPLAY_IDENTIFIER TorqueEmETractSys2ActualValue_raw /end MEASUREMENT
/begin MEASUREMENT cap_canApiMsg_VCU_TractionEMachine1_10ms_CHS2.RpmEmETractSys1ActualValue_phy "description" FLOAT32_IEEE cal_signal_objects_CM_single 0 0 0 4294967295 ECU_ADDRESS 0x00 DISPLAY_IDENTIFIER RpmEmETractSys1ActualValue_phy /end MEASUREMENT
/begin MEASUREMENT cap_canApiMsg_VCU_TractionEMachine1_10ms_CHS2.RpmEmETractSys1ActualValue_raw "description" FLOAT32_IEEE cal_signal_objects_CM_single 0 0 0 4294967295 ECU_ADDRESS 0x00 DISPLAY_IDENTIFIER RpmEmETractSys1ActualValue_raw /end MEASUREMENT
/begin MEASUREMENT cap_canApiMsg_VCU_TractionEMachine1_10ms_CHS2.TorqueEmETractSys1GeneratorDyn_phy "description" FLOAT32_IEEE cal_signal_objects_CM_single 0 0 0 4294967295 ECU_ADDRESS 0x00 DISPLAY_IDENTIFIER TorqueEmETractSys1GeneratorDyn_phy /end MEASUREMENT
/begin MEASUREMENT cap_canApiMsg_VCU_TractionEMachine1_10ms_CHS2.TorqueEmETractSys1GeneratorDyn_raw "description" FLOAT32_IEEE cal_signal_objects_CM_single 0 0 0 4294967295 ECU_ADDRESS 0x00 DISPLAY_IDENTIFIER TorqueEmETractSys1GeneratorDyn_raw /end MEASUREMENT
/begin MEASUREMENT cap_canApiMsg_VCU_TractionEMachine1_10ms_CHS2.TorqueEmETractSys1MotorDyn_phy "description" FLOAT32_IEEE cal_signal_objects_CM_single 0 0 0 4294967295 ECU_ADDRESS 0x00 DISPLAY_IDENTIFIER TorqueEmETractSys1MotorDyn_phy /end MEASUREMENT
/begin MEASUREMENT cap_canApiMsg_VCU_TractionEMachine1_10ms_CHS2.TorqueEmETractSys1MotorDyn_raw "description" FLOAT32_IEEE cal_signal_objects_CM_single 0 0 0 4294967295 ECU_ADDRESS 0x00 DISPLAY_IDENTIFIER TorqueEmETractSys1MotorDyn_raw /end MEASUREMENT
/begin MEASUREMENT cap_canApiMsg_VCU_TractionEMachine1_10ms_CHS2.TorqueEmETractSys1ActualValue_phy "description" FLOAT32_IEEE cal_signal_objects_CM_single 0 0 0 4294967295 ECU_ADDRESS 0x00 DISPLAY_IDENTIFIER TorqueEmETractSys1ActualValue_phy /end MEASUREMENT
/begin MEASUREMENT cap_canApiMsg_VCU_TractionEMachine1_10ms_CHS2.TorqueEmETractSys1ActualValue_raw "description" FLOAT32_IEEE cal_signal_objects_CM_single 0 0 0 4294967295 ECU_ADDRESS 0x00 DISPLAY_IDENTIFIER TorqueEmETractSys1ActualValue_raw /end MEASUREMENT
/begin MEASUREMENT cap_canApiMsg_VCU_TractionEMachine2_100ms_CHS2.WheelRatioEAxlEtractSys2ActVal_phy "description" FLOAT32_IEEE cal_signal_objects_CM_single 0 0 0 4294967295 ECU_ADDRESS 0x00 DISPLAY_IDENTIFIER WheelRatioEAxlEtractSys2ActVal_phy /end MEASUREMENT
/begin MEASUREMENT cap_canApiMsg_VCU_TractionEMachine2_100ms_CHS2.WheelRatioEAxlEtractSys2ActVal_raw "description" FLOAT32_IEEE cal_signal_objects_CM_single 0 0 0 4294967295 ECU_ADDRESS 0x00 DISPLAY_IDENTIFIER WheelRatioEAxlEtractSys2ActVal_raw /end MEASUREMENT
/begin MEASUREMENT cap_canApiMsg_VCU_TractionEMachine1_100ms_CHS2.WheelRatioEAxlEtractSys1ActVal_phy "description" FLOAT32_IEEE cal_signal_objects_CM_single 0 0 0 4294967295 ECU_ADDRESS 0x00 DISPLAY_IDENTIFIER WheelRatioEAxlEtractSys1ActVal_phy /end MEASUREMENT
/begin MEASUREMENT cap_canApiMsg_VCU_TractionEMachine1_100ms_CHS2.WheelRatioEAxlEtractSys1ActVal_raw "description" FLOAT32_IEEE cal_signal_objects_CM_single 0 0 0 4294967295 ECU_ADDRESS 0x00 DISPLAY_IDENTIFIER WheelRatioEAxlEtractSys1ActVal_raw /end MEASUREMENT
/begin MEASUREMENT cap_canApiMsg_VCU_Status_CHS2.VCU_ACPD_Percent_phy "description" FLOAT32_IEEE cal_signal_objects_CM_single 0 0 0 4294967295 ECU_ADDRESS 0x00 DISPLAY_IDENTIFIER VCU_ACPD_Percent_phy /end MEASUREMENT
/begin MEASUREMENT cap_canApiMsg_VCU_Status_CHS2.VCU_ACPD_Percent_raw "description" FLOAT32_IEEE cal_signal_objects_CM_single 0 0 0 4294967295 ECU_ADDRESS 0x00 DISPLAY_IDENTIFIER VCU_ACPD_Percent_raw /end MEASUREMENT
/begin MEASUREMENT cap_canApiMsg_VCU_CombinedChargerUnit_CHS2.TargetTorqueEmETractSys1_phy "description" FLOAT32_IEEE cal_signal_objects_CM_single 0 0 0 4294967295 ECU_ADDRESS 0x00 DISPLAY_IDENTIFIER TargetTorqueEmETractSys1_phy /end MEASUREMENT
/begin MEASUREMENT cap_canApiMsg_VCU_CombinedChargerUnit_CHS2.TargetTorqueEmETractSys1_raw "description" FLOAT32_IEEE cal_signal_objects_CM_single 0 0 0 4294967295 ECU_ADDRESS 0x00 DISPLAY_IDENTIFIER TargetTorqueEmETractSys1_raw /end MEASUREMENT
/begin MEASUREMENT cap_canApiMsg_VCU_CombinedChargerUnit_CHS2.TargetTorqueEmETractSys2_phy "description" FLOAT32_IEEE cal_signal_objects_CM_single 0 0 0 4294967295 ECU_ADDRESS 0x00 DISPLAY_IDENTIFIER TargetTorqueEmETractSys2_phy /end MEASUREMENT
/begin MEASUREMENT cap_canApiMsg_VCU_CombinedChargerUnit_CHS2.TargetTorqueEmETractSys2_raw "description" FLOAT32_IEEE cal_signal_objects_CM_single 0 0 0 4294967295 ECU_ADDRESS 0x00 DISPLAY_IDENTIFIER TargetTorqueEmETractSys2_raw /end MEASUREMENT
/begin MEASUREMENT cap_canApiMsg_EBCM_STATUS_CHS2.MCPressure_phy "description" FLOAT32_IEEE cal_signal_objects_CM_single 0 0 0 4294967295 ECU_ADDRESS 0x00 DISPLAY_IDENTIFIER MCPressure_phy /end MEASUREMENT
/begin MEASUREMENT cap_canApiMsg_EBCM_STATUS_CHS2.MCPressure_raw "description" FLOAT32_IEEE cal_signal_objects_CM_single 0 0 0 4294967295 ECU_ADDRESS 0x00 DISPLAY_IDENTIFIER MCPressure_raw /end MEASUREMENT
/begin MEASUREMENT cap_canApiMsg_EBCM_STATUS_CHS2.BreakPedalPercent_phy "description" FLOAT32_IEEE cal_signal_objects_CM_single 0 0 0 4294967295 ECU_ADDRESS 0x00 DISPLAY_IDENTIFIER BreakPedalPercent_phy /end MEASUREMENT
/begin MEASUREMENT cap_canApiMsg_EBCM_STATUS_CHS2.BreakPedalPercent_raw "description" FLOAT32_IEEE cal_signal_objects_CM_single 0 0 0 4294967295 ECU_ADDRESS 0x00 DISPLAY_IDENTIFIER BreakPedalPercent_raw /end MEASUREMENT
/begin MEASUREMENT cap_canApiMsg_BundleEAFlexrayToAECANFD10msNo1_CHS2.AVL_BRTORQ_WHL_RS_LH_EXT_phy "description" FLOAT32_IEEE cal_signal_objects_CM_single 0 0 0 4294967295 ECU_ADDRESS 0x00 DISPLAY_IDENTIFIER AVL_BRTORQ_WHL_RS_LH_EXT_phy /end MEASUREMENT
/begin MEASUREMENT cap_canApiMsg_BundleEAFlexrayToAECANFD10msNo1_CHS2.AVL_BRTORQ_WHL_RS_LH_EXT_raw "description" FLOAT32_IEEE cal_signal_objects_CM_single 0 0 0 4294967295 ECU_ADDRESS 0x00 DISPLAY_IDENTIFIER AVL_BRTORQ_WHL_RS_LH_EXT_raw /end MEASUREMENT
/begin MEASUREMENT cap_canApiMsg_BundleEAFlexrayToAECANFD10msNo1_CHS2.AVL_BRTORQ_WHL_RS_RH_EXT_phy "description" FLOAT32_IEEE cal_signal_objects_CM_single 0 0 0 4294967295 ECU_ADDRESS 0x00 DISPLAY_IDENTIFIER AVL_BRTORQ_WHL_RS_RH_EXT_phy /end MEASUREMENT
/begin MEASUREMENT cap_canApiMsg_BundleEAFlexrayToAECANFD10msNo1_CHS2.AVL_BRTORQ_WHL_RS_RH_EXT_raw "description" FLOAT32_IEEE cal_signal_objects_CM_single 0 0 0 4294967295 ECU_ADDRESS 0x00 DISPLAY_IDENTIFIER AVL_BRTORQ_WHL_RS_RH_EXT_raw /end MEASUREMENT
/begin MEASUREMENT cap_canApiMsg_BundleEAFlexrayToAECANFD10msNo1_CHS2.AVL_BRTORQ_WHL_FS_LH_EXT_phy "description" FLOAT32_IEEE cal_signal_objects_CM_single 0 0 0 4294967295 ECU_ADDRESS 0x00 DISPLAY_IDENTIFIER AVL_BRTORQ_WHL_FS_LH_EXT_phy /end MEASUREMENT
/begin MEASUREMENT cap_canApiMsg_BundleEAFlexrayToAECANFD10msNo1_CHS2.AVL_BRTORQ_WHL_FS_LH_EXT_raw "description" FLOAT32_IEEE cal_signal_objects_CM_single 0 0 0 4294967295 ECU_ADDRESS 0x00 DISPLAY_IDENTIFIER AVL_BRTORQ_WHL_FS_LH_EXT_raw /end MEASUREMENT
/begin MEASUREMENT cap_canApiMsg_BundleEAFlexrayToAECANFD10msNo1_CHS2.AVL_BRTORQ_WHL_FS_RH_EXT_phy "description" FLOAT32_IEEE cal_signal_objects_CM_single 0 0 0 4294967295 ECU_ADDRESS 0x00 DISPLAY_IDENTIFIER AVL_BRTORQ_WHL_FS_RH_EXT_phy /end MEASUREMENT
/begin MEASUREMENT cap_canApiMsg_BundleEAFlexrayToAECANFD10msNo1_CHS2.AVL_BRTORQ_WHL_FS_RH_EXT_raw "description" FLOAT32_IEEE cal_signal_objects_CM_single 0 0 0 4294967295 ECU_ADDRESS 0x00 DISPLAY_IDENTIFIER AVL_BRTORQ_WHL_FS_RH_EXT_raw /end MEASUREMENT
/begin MEASUREMENT cap_canApiMsg_BundleEAFlexrayToAECANFD10msNo1_CHS2.TAR_RPM_MAX_BAX_phy "description" FLOAT32_IEEE cal_signal_objects_CM_single 0 0 0 4294967295 ECU_ADDRESS 0x00 DISPLAY_IDENTIFIER TAR_RPM_MAX_BAX_phy /end MEASUREMENT
/begin MEASUREMENT cap_canApiMsg_BundleEAFlexrayToAECANFD10msNo1_CHS2.TAR_RPM_MAX_BAX_raw "description" FLOAT32_IEEE cal_signal_objects_CM_single 0 0 0 4294967295 ECU_ADDRESS 0x00 DISPLAY_IDENTIFIER TAR_RPM_MAX_BAX_raw /end MEASUREMENT
/begin MEASUREMENT cap_canApiMsg_BundleEAFlexrayToAECANFD10msNo1_CHS2.TAR_RPM_MIN_BAX_phy "description" FLOAT32_IEEE cal_signal_objects_CM_single 0 0 0 4294967295 ECU_ADDRESS 0x00 DISPLAY_IDENTIFIER TAR_RPM_MIN_BAX_phy /end MEASUREMENT
/begin MEASUREMENT cap_canApiMsg_BundleEAFlexrayToAECANFD10msNo1_CHS2.TAR_RPM_MIN_BAX_raw "description" FLOAT32_IEEE cal_signal_objects_CM_single 0 0 0 4294967295 ECU_ADDRESS 0x00 DISPLAY_IDENTIFIER TAR_RPM_MIN_BAX_raw /end MEASUREMENT
/begin MEASUREMENT cap_canApiMsg_BundleEAFlexrayToAECANFD10msNo1_CHS2.TAR_RPM_MAX_FTAX_phy "description" FLOAT32_IEEE cal_signal_objects_CM_single 0 0 0 4294967295 ECU_ADDRESS 0x00 DISPLAY_IDENTIFIER TAR_RPM_MAX_FTAX_phy /end MEASUREMENT
/begin MEASUREMENT cap_canApiMsg_BundleEAFlexrayToAECANFD10msNo1_CHS2.TAR_RPM_MAX_FTAX_raw "description" FLOAT32_IEEE cal_signal_objects_CM_single 0 0 0 4294967295 ECU_ADDRESS 0x00 DISPLAY_IDENTIFIER TAR_RPM_MAX_FTAX_raw /end MEASUREMENT
/begin MEASUREMENT cap_canApiMsg_BundleEAFlexrayToAECANFD10msNo1_CHS2.TAR_RPM_MIN_FTAX_phy "description" FLOAT32_IEEE cal_signal_objects_CM_single 0 0 0 4294967295 ECU_ADDRESS 0x00 DISPLAY_IDENTIFIER TAR_RPM_MIN_FTAX_phy /end MEASUREMENT
/begin MEASUREMENT cap_canApiMsg_BundleEAFlexrayToAECANFD10msNo1_CHS2.TAR_RPM_MIN_FTAX_raw "description" FLOAT32_IEEE cal_signal_objects_CM_single 0 0 0 4294967295 ECU_ADDRESS 0x00 DISPLAY_IDENTIFIER TAR_RPM_MIN_FTAX_raw /end MEASUREMENT
/begin MEASUREMENT cap_canApiMsg_AVL_RPM_WHL_CHS2.AVL_RPM_WHL_RLH_phy "description" FLOAT32_IEEE cal_signal_objects_CM_single 0 0 0 4294967295 ECU_ADDRESS 0x00 DISPLAY_IDENTIFIER AVL_RPM_WHL_RLH_phy /end MEASUREMENT
/begin MEASUREMENT cap_canApiMsg_AVL_RPM_WHL_CHS2.AVL_RPM_WHL_RLH_raw "description" FLOAT32_IEEE cal_signal_objects_CM_single 0 0 0 4294967295 ECU_ADDRESS 0x00 DISPLAY_IDENTIFIER AVL_RPM_WHL_RLH_raw /end MEASUREMENT
/begin MEASUREMENT cap_canApiMsg_AVL_RPM_WHL_CHS2.AVL_RPM_WHL_RRH_phy "description" FLOAT32_IEEE cal_signal_objects_CM_single 0 0 0 4294967295 ECU_ADDRESS 0x00 DISPLAY_IDENTIFIER AVL_RPM_WHL_RRH_phy /end MEASUREMENT
/begin MEASUREMENT cap_canApiMsg_AVL_RPM_WHL_CHS2.AVL_RPM_WHL_RRH_raw "description" FLOAT32_IEEE cal_signal_objects_CM_single 0 0 0 4294967295 ECU_ADDRESS 0x00 DISPLAY_IDENTIFIER AVL_RPM_WHL_RRH_raw /end MEASUREMENT
/begin MEASUREMENT cap_canApiMsg_AVL_RPM_WHL_CHS2.AVL_RPM_WHL_FLH_phy "description" FLOAT32_IEEE cal_signal_objects_CM_single 0 0 0 4294967295 ECU_ADDRESS 0x00 DISPLAY_IDENTIFIER AVL_RPM_WHL_FLH_phy /end MEASUREMENT
/begin MEASUREMENT cap_canApiMsg_AVL_RPM_WHL_CHS2.AVL_RPM_WHL_FLH_raw "description" FLOAT32_IEEE cal_signal_objects_CM_single 0 0 0 4294967295 ECU_ADDRESS 0x00 DISPLAY_IDENTIFIER AVL_RPM_WHL_FLH_raw /end MEASUREMENT
/begin MEASUREMENT cap_canApiMsg_AVL_RPM_WHL_CHS2.AVL_RPM_WHL_FRH_phy "description" FLOAT32_IEEE cal_signal_objects_CM_single 0 0 0 4294967295 ECU_ADDRESS 0x00 DISPLAY_IDENTIFIER AVL_RPM_WHL_FRH_phy /end MEASUREMENT
/begin MEASUREMENT cap_canApiMsg_AVL_RPM_WHL_CHS2.AVL_RPM_WHL_FRH_raw "description" FLOAT32_IEEE cal_signal_objects_CM_single 0 0 0 4294967295 ECU_ADDRESS 0x00 DISPLAY_IDENTIFIER AVL_RPM_WHL_FRH_raw /end MEASUREMENT
/begin MEASUREMENT cap_canApiMsg_BundleEAFlexrayToCANFD20msNo1_CHS2.V_VEH_COG_phy "description" FLOAT32_IEEE cal_signal_objects_CM_single 0 0 0 4294967295 ECU_ADDRESS 0x00 DISPLAY_IDENTIFIER V_VEH_COG_phy /end MEASUREMENT
/begin MEASUREMENT cap_canApiMsg_BundleEAFlexrayToCANFD20msNo1_CHS2.V_VEH_COG_raw "description" FLOAT32_IEEE cal_signal_objects_CM_single 0 0 0 4294967295 ECU_ADDRESS 0x00 DISPLAY_IDENTIFIER V_VEH_COG_raw /end MEASUREMENT
/begin MEASUREMENT cap_canApiMsg_SFA_SteerWheel_Info_CHS2.SFA_SteerWheelTorque_phy "description" FLOAT32_IEEE cal_signal_objects_CM_single 0 0 0 4294967295 ECU_ADDRESS 0x00 DISPLAY_IDENTIFIER SFA_SteerWheelTorque_phy /end MEASUREMENT
/begin MEASUREMENT cap_canApiMsg_SFA_SteerWheel_Info_CHS2.SFA_SteerWheelTorque_raw "description" FLOAT32_IEEE cal_signal_objects_CM_single 0 0 0 4294967295 ECU_ADDRESS 0x00 DISPLAY_IDENTIFIER SFA_SteerWheelTorque_raw /end MEASUREMENT
/begin MEASUREMENT cap_canApiMsg_SFA_SteerWheel_Info_CHS2.SFA_SteerWheelAngleSpeed_phy "description" FLOAT32_IEEE cal_signal_objects_CM_single 0 0 0 4294967295 ECU_ADDRESS 0x00 DISPLAY_IDENTIFIER SFA_SteerWheelAngleSpeed_phy /end MEASUREMENT
/begin MEASUREMENT cap_canApiMsg_SFA_SteerWheel_Info_CHS2.SFA_SteerWheelAngleSpeed_raw "description" FLOAT32_IEEE cal_signal_objects_CM_single 0 0 0 4294967295 ECU_ADDRESS 0x00 DISPLAY_IDENTIFIER SFA_SteerWheelAngleSpeed_raw /end MEASUREMENT
/begin MEASUREMENT cap_canApiMsg_SFA_SteerWheel_Info_CHS2.SFA_SteerWheelAngle_phy "description" FLOAT32_IEEE cal_signal_objects_CM_single 0 0 0 4294967295 ECU_ADDRESS 0x00 DISPLAY_IDENTIFIER SFA_SteerWheelAngle_phy /end MEASUREMENT
/begin MEASUREMENT cap_canApiMsg_SFA_SteerWheel_Info_CHS2.SFA_SteerWheelAngle_raw "description" FLOAT32_IEEE cal_signal_objects_CM_single 0 0 0 4294967295 ECU_ADDRESS 0x00 DISPLAY_IDENTIFIER SFA_SteerWheelAngle_raw /end MEASUREMENT
/begin MEASUREMENT cap_canApiMsg_VCU_Thermal_Status_PT.VCU_LTROutLetTemp_phy "description" FLOAT32_IEEE cal_signal_objects_CM_single 0 0 0 4294967295 ECU_ADDRESS 0x00 DISPLAY_IDENTIFIER VCU_LTROutLetTemp_phy /end MEASUREMENT
/begin MEASUREMENT cap_canApiMsg_VCU_Thermal_Status_PT.VCU_LTROutLetTemp_raw "description" FLOAT32_IEEE cal_signal_objects_CM_single 0 0 0 4294967295 ECU_ADDRESS 0x00 DISPLAY_IDENTIFIER VCU_LTROutLetTemp_raw /end MEASUREMENT
/begin MEASUREMENT cap_canApiMsg_BMS_CellTempMeas2_PT.BMS_CellTemp42_phy "description" FLOAT32_IEEE cal_signal_objects_CM_single 0 0 0 4294967295 ECU_ADDRESS 0x00 DISPLAY_IDENTIFIER BMS_CellTemp42_phy /end MEASUREMENT
/begin MEASUREMENT cap_canApiMsg_BMS_CellTempMeas2_PT.BMS_CellTemp42_raw "description" FLOAT32_IEEE cal_signal_objects_CM_single 0 0 0 4294967295 ECU_ADDRESS 0x00 DISPLAY_IDENTIFIER BMS_CellTemp42_raw /end MEASUREMENT
/begin MEASUREMENT cap_canApiMsg_BMS_CellTempMeas2_PT.BMS_CellTemp43_phy "description" FLOAT32_IEEE cal_signal_objects_CM_single 0 0 0 4294967295 ECU_ADDRESS 0x00 DISPLAY_IDENTIFIER BMS_CellTemp43_phy /end MEASUREMENT
/begin MEASUREMENT cap_canApiMsg_BMS_CellTempMeas2_PT.BMS_CellTemp43_raw "description" FLOAT32_IEEE cal_signal_objects_CM_single 0 0 0 4294967295 ECU_ADDRESS 0x00 DISPLAY_IDENTIFIER BMS_CellTemp43_raw /end MEASUREMENT
/begin MEASUREMENT cap_canApiMsg_BMS_CellTempMeas2_PT.BMS_CellTemp44_phy "description" FLOAT32_IEEE cal_signal_objects_CM_single 0 0 0 4294967295 ECU_ADDRESS 0x00 DISPLAY_IDENTIFIER BMS_CellTemp44_phy /end MEASUREMENT
/begin MEASUREMENT cap_canApiMsg_BMS_CellTempMeas2_PT.BMS_CellTemp44_raw "description" FLOAT32_IEEE cal_signal_objects_CM_single 0 0 0 4294967295 ECU_ADDRESS 0x00 DISPLAY_IDENTIFIER BMS_CellTemp44_raw /end MEASUREMENT
/begin MEASUREMENT cap_canApiMsg_BMS_CellTempMeas2_PT.BMS_CellTemp45_phy "description" FLOAT32_IEEE cal_signal_objects_CM_single 0 0 0 4294967295 ECU_ADDRESS 0x00 DISPLAY_IDENTIFIER BMS_CellTemp45_phy /end MEASUREMENT
/begin MEASUREMENT cap_canApiMsg_BMS_CellTempMeas2_PT.BMS_CellTemp45_raw "description" FLOAT32_IEEE cal_signal_objects_CM_single 0 0 0 4294967295 ECU_ADDRESS 0x00 DISPLAY_IDENTIFIER BMS_CellTemp45_raw /end MEASUREMENT
/begin MEASUREMENT cap_canApiMsg_BMS_CellTempMeas2_PT.BMS_CellTemp46_phy "description" FLOAT32_IEEE cal_signal_objects_CM_single 0 0 0 4294967295 ECU_ADDRESS 0x00 DISPLAY_IDENTIFIER BMS_CellTemp46_phy /end MEASUREMENT
/begin MEASUREMENT cap_canApiMsg_BMS_CellTempMeas2_PT.BMS_CellTemp46_raw "description" FLOAT32_IEEE cal_signal_objects_CM_single 0 0 0 4294967295 ECU_ADDRESS 0x00 DISPLAY_IDENTIFIER BMS_CellTemp46_raw /end MEASUREMENT
/begin MEASUREMENT cap_canApiMsg_BMS_CellTempMeas2_PT.BMS_CellTemp47_phy "description" FLOAT32_IEEE cal_signal_objects_CM_single 0 0 0 4294967295 ECU_ADDRESS 0x00 DISPLAY_IDENTIFIER BMS_CellTemp47_phy /end MEASUREMENT
/begin MEASUREMENT cap_canApiMsg_BMS_CellTempMeas2_PT.BMS_CellTemp47_raw "description" FLOAT32_IEEE cal_signal_objects_CM_single 0 0 0 4294967295 ECU_ADDRESS 0x00 DISPLAY_IDENTIFIER BMS_CellTemp47_raw /end MEASUREMENT
/begin MEASUREMENT cap_canApiMsg_BMS_CellTempMeas2_PT.BMS_CellTemp48_phy "description" FLOAT32_IEEE cal_signal_objects_CM_single 0 0 0 4294967295 ECU_ADDRESS 0x00 DISPLAY_IDENTIFIER BMS_CellTemp48_phy /end MEASUREMENT
/begin MEASUREMENT cap_canApiMsg_BMS_CellTempMeas2_PT.BMS_CellTemp48_raw "description" FLOAT32_IEEE cal_signal_objects_CM_single 0 0 0 4294967295 ECU_ADDRESS 0x00 DISPLAY_IDENTIFIER BMS_CellTemp48_raw /end MEASUREMENT
/begin MEASUREMENT cap_canApiMsg_AVL_RPM_WHL_PT.AVL_RPM_WHL_RLH_phy "description" FLOAT32_IEEE cal_signal_objects_CM_single 0 0 0 4294967295 ECU_ADDRESS 0x00 DISPLAY_IDENTIFIER AVL_RPM_WHL_RLH_phy /end MEASUREMENT
/begin MEASUREMENT cap_canApiMsg_AVL_RPM_WHL_PT.AVL_RPM_WHL_RLH_raw "description" FLOAT32_IEEE cal_signal_objects_CM_single 0 0 0 4294967295 ECU_ADDRESS 0x00 DISPLAY_IDENTIFIER AVL_RPM_WHL_RLH_raw /end MEASUREMENT
/begin MEASUREMENT cap_canApiMsg_AVL_RPM_WHL_PT.AVL_RPM_WHL_RRH_phy "description" FLOAT32_IEEE cal_signal_objects_CM_single 0 0 0 4294967295 ECU_ADDRESS 0x00 DISPLAY_IDENTIFIER AVL_RPM_WHL_RRH_phy /end MEASUREMENT
/begin MEASUREMENT cap_canApiMsg_AVL_RPM_WHL_PT.AVL_RPM_WHL_RRH_raw "description" FLOAT32_IEEE cal_signal_objects_CM_single 0 0 0 4294967295 ECU_ADDRESS 0x00 DISPLAY_IDENTIFIER AVL_RPM_WHL_RRH_raw /end MEASUREMENT
/begin MEASUREMENT cap_canApiMsg_AVL_RPM_WHL_PT.AVL_RPM_WHL_FLH_phy "description" FLOAT32_IEEE cal_signal_objects_CM_single 0 0 0 4294967295 ECU_ADDRESS 0x00 DISPLAY_IDENTIFIER AVL_RPM_WHL_FLH_phy /end MEASUREMENT
/begin MEASUREMENT cap_canApiMsg_AVL_RPM_WHL_PT.AVL_RPM_WHL_FLH_raw "description" FLOAT32_IEEE cal_signal_objects_CM_single 0 0 0 4294967295 ECU_ADDRESS 0x00 DISPLAY_IDENTIFIER AVL_RPM_WHL_FLH_raw /end MEASUREMENT
/begin MEASUREMENT cap_canApiMsg_AVL_RPM_WHL_PT.AVL_RPM_WHL_FRH_phy "description" FLOAT32_IEEE cal_signal_objects_CM_single 0 0 0 4294967295 ECU_ADDRESS 0x00 DISPLAY_IDENTIFIER AVL_RPM_WHL_FRH_phy /end MEASUREMENT
/begin MEASUREMENT cap_canApiMsg_AVL_RPM_WHL_PT.AVL_RPM_WHL_FRH_raw "description" FLOAT32_IEEE cal_signal_objects_CM_single 0 0 0 4294967295 ECU_ADDRESS 0x00 DISPLAY_IDENTIFIER AVL_RPM_WHL_FRH_raw /end MEASUREMENT
/begin MEASUREMENT cap_canApiMsg_BMS_ChgParamReq_PT.BMS_ChgVoltageReq_phy "description" FLOAT32_IEEE cal_signal_objects_CM_single 0 0 0 4294967295 ECU_ADDRESS 0x00 DISPLAY_IDENTIFIER BMS_ChgVoltageReq_phy /end MEASUREMENT
/begin MEASUREMENT cap_canApiMsg_BMS_ChgParamReq_PT.BMS_ChgVoltageReq_raw "description" FLOAT32_IEEE cal_signal_objects_CM_single 0 0 0 4294967295 ECU_ADDRESS 0x00 DISPLAY_IDENTIFIER BMS_ChgVoltageReq_raw /end MEASUREMENT
/begin MEASUREMENT cap_canApiMsg_BMS_ChgParamReq_PT.BMS_ChgCurrentReq_phy "description" FLOAT32_IEEE cal_signal_objects_CM_single 0 0 0 4294967295 ECU_ADDRESS 0x00 DISPLAY_IDENTIFIER BMS_ChgCurrentReq_phy /end MEASUREMENT
/begin MEASUREMENT cap_canApiMsg_BMS_ChgParamReq_PT.BMS_ChgCurrentReq_raw "description" FLOAT32_IEEE cal_signal_objects_CM_single 0 0 0 4294967295 ECU_ADDRESS 0x00 DISPLAY_IDENTIFIER BMS_ChgCurrentReq_raw /end MEASUREMENT
/begin MEASUREMENT cap_canApiMsg_BMS_ChgParamReq_PT.BMS_MaxChgCurrentLim_phy "description" FLOAT32_IEEE cal_signal_objects_CM_single 0 0 0 4294967295 ECU_ADDRESS 0x00 DISPLAY_IDENTIFIER BMS_MaxChgCurrentLim_phy /end MEASUREMENT
/begin MEASUREMENT cap_canApiMsg_BMS_ChgParamReq_PT.BMS_MaxChgCurrentLim_raw "description" FLOAT32_IEEE cal_signal_objects_CM_single 0 0 0 4294967295 ECU_ADDRESS 0x00 DISPLAY_IDENTIFIER BMS_MaxChgCurrentLim_raw /end MEASUREMENT
/begin MEASUREMENT cap_canApiMsg_BMS_ChgParamReq_PT.BMS_MaxChgCurrentLimPeak_phy "description" FLOAT32_IEEE cal_signal_objects_CM_single 0 0 0 4294967295 ECU_ADDRESS 0x00 DISPLAY_IDENTIFIER BMS_MaxChgCurrentLimPeak_phy /end MEASUREMENT
/begin MEASUREMENT cap_canApiMsg_BMS_ChgParamReq_PT.BMS_MaxChgCurrentLimPeak_raw "description" FLOAT32_IEEE cal_signal_objects_CM_single 0 0 0 4294967295 ECU_ADDRESS 0x00 DISPLAY_IDENTIFIER BMS_MaxChgCurrentLimPeak_raw /end MEASUREMENT
/begin MEASUREMENT cap_canApiMsg_BMS_ChgParamReq_PT.BMS_MaxChgCurrent2s_phy "description" FLOAT32_IEEE cal_signal_objects_CM_single 0 0 0 4294967295 ECU_ADDRESS 0x00 DISPLAY_IDENTIFIER BMS_MaxChgCurrent2s_phy /end MEASUREMENT
/begin MEASUREMENT cap_canApiMsg_BMS_ChgParamReq_PT.BMS_MaxChgCurrent2s_raw "description" FLOAT32_IEEE cal_signal_objects_CM_single 0 0 0 4294967295 ECU_ADDRESS 0x00 DISPLAY_IDENTIFIER BMS_MaxChgCurrent2s_raw /end MEASUREMENT
/begin MEASUREMENT cap_canApiMsg_BMS_ChgParamReq_PT.BMS_MaxChgCurrent10s_phy "description" FLOAT32_IEEE cal_signal_objects_CM_single 0 0 0 4294967295 ECU_ADDRESS 0x00 DISPLAY_IDENTIFIER BMS_MaxChgCurrent10s_phy /end MEASUREMENT
/begin MEASUREMENT cap_canApiMsg_BMS_ChgParamReq_PT.BMS_MaxChgCurrent10s_raw "description" FLOAT32_IEEE cal_signal_objects_CM_single 0 0 0 4294967295 ECU_ADDRESS 0x00 DISPLAY_IDENTIFIER BMS_MaxChgCurrent10s_raw /end MEASUREMENT
/begin MEASUREMENT cap_canApiMsg_BMS_ChgParamReq_PT.BMS_MaxChgCurrent30s_phy "description" FLOAT32_IEEE cal_signal_objects_CM_single 0 0 0 4294967295 ECU_ADDRESS 0x00 DISPLAY_IDENTIFIER BMS_MaxChgCurrent30s_phy /end MEASUREMENT
/begin MEASUREMENT cap_canApiMsg_BMS_ChgParamReq_PT.BMS_MaxChgCurrent30s_raw "description" FLOAT32_IEEE cal_signal_objects_CM_single 0 0 0 4294967295 ECU_ADDRESS 0x00 DISPLAY_IDENTIFIER BMS_MaxChgCurrent30s_raw /end MEASUREMENT
/begin MEASUREMENT cap_canApiMsg_BMS_ChgParamReq_PT.BMS_MaxChgPwrLim_phy "description" FLOAT32_IEEE cal_signal_objects_CM_single 0 0 0 4294967295 ECU_ADDRESS 0x00 DISPLAY_IDENTIFIER BMS_MaxChgPwrLim_phy /end MEASUREMENT
/begin MEASUREMENT cap_canApiMsg_BMS_ChgParamReq_PT.BMS_MaxChgPwrLim_raw "description" FLOAT32_IEEE cal_signal_objects_CM_single 0 0 0 4294967295 ECU_ADDRESS 0x00 DISPLAY_IDENTIFIER BMS_MaxChgPwrLim_raw /end MEASUREMENT
/begin MEASUREMENT cap_canApiMsg_BMS_ChgParamReq_PT.BMS_MaxChgPwrLimPeak_phy "description" FLOAT32_IEEE cal_signal_objects_CM_single 0 0 0 4294967295 ECU_ADDRESS 0x00 DISPLAY_IDENTIFIER BMS_MaxChgPwrLimPeak_phy /end MEASUREMENT
/begin MEASUREMENT cap_canApiMsg_BMS_ChgParamReq_PT.BMS_MaxChgPwrLimPeak_raw "description" FLOAT32_IEEE cal_signal_objects_CM_single 0 0 0 4294967295 ECU_ADDRESS 0x00 DISPLAY_IDENTIFIER BMS_MaxChgPwrLimPeak_raw /end MEASUREMENT
/begin MEASUREMENT cap_canApiMsg_BMS_ChgParamReq_PT.BMS_MaxChgPwr2s_phy "description" FLOAT32_IEEE cal_signal_objects_CM_single 0 0 0 4294967295 ECU_ADDRESS 0x00 DISPLAY_IDENTIFIER BMS_MaxChgPwr2s_phy /end MEASUREMENT
/begin MEASUREMENT cap_canApiMsg_BMS_ChgParamReq_PT.BMS_MaxChgPwr2s_raw "description" FLOAT32_IEEE cal_signal_objects_CM_single 0 0 0 4294967295 ECU_ADDRESS 0x00 DISPLAY_IDENTIFIER BMS_MaxChgPwr2s_raw /end MEASUREMENT
/begin MEASUREMENT cap_canApiMsg_BMS_ChgParamReq_PT.BMS_MaxChgPwr10s_phy "description" FLOAT32_IEEE cal_signal_objects_CM_single 0 0 0 4294967295 ECU_ADDRESS 0x00 DISPLAY_IDENTIFIER BMS_MaxChgPwr10s_phy /end MEASUREMENT
/begin MEASUREMENT cap_canApiMsg_BMS_ChgParamReq_PT.BMS_MaxChgPwr10s_raw "description" FLOAT32_IEEE cal_signal_objects_CM_single 0 0 0 4294967295 ECU_ADDRESS 0x00 DISPLAY_IDENTIFIER BMS_MaxChgPwr10s_raw /end MEASUREMENT
/begin MEASUREMENT cap_canApiMsg_BMS_ChgParamReq_PT.BMS_MaxChgPwr30s_phy "description" FLOAT32_IEEE cal_signal_objects_CM_single 0 0 0 4294967295 ECU_ADDRESS 0x00 DISPLAY_IDENTIFIER BMS_MaxChgPwr30s_phy /end MEASUREMENT
/begin MEASUREMENT cap_canApiMsg_BMS_ChgParamReq_PT.BMS_MaxChgPwr30s_raw "description" FLOAT32_IEEE cal_signal_objects_CM_single 0 0 0 4294967295 ECU_ADDRESS 0x00 DISPLAY_IDENTIFIER BMS_MaxChgPwr30s_raw /end MEASUREMENT
/begin MEASUREMENT cap_canApiMsg_BMS_CurMeas_PT.BMS_PackCurMeas_phy "description" FLOAT32_IEEE cal_signal_objects_CM_single 0 0 0 4294967295 ECU_ADDRESS 0x00 DISPLAY_IDENTIFIER BMS_PackCurMeas_phy /end MEASUREMENT
/begin MEASUREMENT cap_canApiMsg_BMS_CurMeas_PT.BMS_PackCurMeas_raw "description" FLOAT32_IEEE cal_signal_objects_CM_single 0 0 0 4294967295 ECU_ADDRESS 0x00 DISPLAY_IDENTIFIER BMS_PackCurMeas_raw /end MEASUREMENT
/begin MEASUREMENT cap_canApiMsg_CombinedChargerUnit10msNo1_PT.TargetTorqueEmETractSys1_phy "description" FLOAT32_IEEE cal_signal_objects_CM_single 0 0 0 4294967295 ECU_ADDRESS 0x00 DISPLAY_IDENTIFIER TargetTorqueEmETractSys1_phy /end MEASUREMENT
/begin MEASUREMENT cap_canApiMsg_CombinedChargerUnit10msNo1_PT.TargetTorqueEmETractSys1_raw "description" FLOAT32_IEEE cal_signal_objects_CM_single 0 0 0 4294967295 ECU_ADDRESS 0x00 DISPLAY_IDENTIFIER TargetTorqueEmETractSys1_raw /end MEASUREMENT
/begin MEASUREMENT cap_canApiMsg_CombinedChargerUnit10msNo1_PT.TargetTorqueEmETractSys2_phy "description" FLOAT32_IEEE cal_signal_objects_CM_single 0 0 0 4294967295 ECU_ADDRESS 0x00 DISPLAY_IDENTIFIER TargetTorqueEmETractSys2_phy /end MEASUREMENT
/begin MEASUREMENT cap_canApiMsg_CombinedChargerUnit10msNo1_PT.TargetTorqueEmETractSys2_raw "description" FLOAT32_IEEE cal_signal_objects_CM_single 0 0 0 4294967295 ECU_ADDRESS 0x00 DISPLAY_IDENTIFIER TargetTorqueEmETractSys2_raw /end MEASUREMENT
/begin MEASUREMENT cap_canApiMsg_CombinedChargerUnit10msNo1_PT.TorqBoundaryETractSys1EmNCtrlMax_phy "description" FLOAT32_IEEE cal_signal_objects_CM_single 0 0 0 4294967295 ECU_ADDRESS 0x00 DISPLAY_IDENTIFIER TorqBoundaryETractSys1EmNCtrlMax_phy /end MEASUREMENT
/begin MEASUREMENT cap_canApiMsg_CombinedChargerUnit10msNo1_PT.TorqBoundaryETractSys1EmNCtrlMax_raw "description" FLOAT32_IEEE cal_signal_objects_CM_single 0 0 0 4294967295 ECU_ADDRESS 0x00 DISPLAY_IDENTIFIER TorqBoundaryETractSys1EmNCtrlMax_raw /end MEASUREMENT
/begin MEASUREMENT cap_canApiMsg_CombinedChargerUnit10msNo1_PT.TorqBoundaryETractSys1EmNCtrlMin_phy "description" FLOAT32_IEEE cal_signal_objects_CM_single 0 0 0 4294967295 ECU_ADDRESS 0x00 DISPLAY_IDENTIFIER TorqBoundaryETractSys1EmNCtrlMin_phy /end MEASUREMENT
/begin MEASUREMENT cap_canApiMsg_CombinedChargerUnit10msNo1_PT.TorqBoundaryETractSys1EmNCtrlMin_raw "description" FLOAT32_IEEE cal_signal_objects_CM_single 0 0 0 4294967295 ECU_ADDRESS 0x00 DISPLAY_IDENTIFIER TorqBoundaryETractSys1EmNCtrlMin_raw /end MEASUREMENT
/begin MEASUREMENT cap_canApiMsg_CombinedChargerUnit10msNo1_PT.TorqBoundaryETractSys2EmNCtrlMax_phy "description" FLOAT32_IEEE cal_signal_objects_CM_single 0 0 0 4294967295 ECU_ADDRESS 0x00 DISPLAY_IDENTIFIER TorqBoundaryETractSys2EmNCtrlMax_phy /end MEASUREMENT
/begin MEASUREMENT cap_canApiMsg_CombinedChargerUnit10msNo1_PT.TorqBoundaryETractSys2EmNCtrlMax_raw "description" FLOAT32_IEEE cal_signal_objects_CM_single 0 0 0 4294967295 ECU_ADDRESS 0x00 DISPLAY_IDENTIFIER TorqBoundaryETractSys2EmNCtrlMax_raw /end MEASUREMENT
/begin MEASUREMENT cap_canApiMsg_CombinedChargerUnit10msNo1_PT.TorqBoundaryETractSys2EmNCtrlMin_phy "description" FLOAT32_IEEE cal_signal_objects_CM_single 0 0 0 4294967295 ECU_ADDRESS 0x00 DISPLAY_IDENTIFIER TorqBoundaryETractSys2EmNCtrlMin_phy /end MEASUREMENT
/begin MEASUREMENT cap_canApiMsg_CombinedChargerUnit10msNo1_PT.TorqBoundaryETractSys2EmNCtrlMin_raw "description" FLOAT32_IEEE cal_signal_objects_CM_single 0 0 0 4294967295 ECU_ADDRESS 0x00 DISPLAY_IDENTIFIER TorqBoundaryETractSys2EmNCtrlMin_raw /end MEASUREMENT
/begin MEASUREMENT cap_canApiMsg_CombinedChargerUnit10msNo1_PT.TargetEMRpmETractSys1_phy "description" FLOAT32_IEEE cal_signal_objects_CM_single 0 0 0 4294967295 ECU_ADDRESS 0x00 DISPLAY_IDENTIFIER TargetEMRpmETractSys1_phy /end MEASUREMENT
/begin MEASUREMENT cap_canApiMsg_CombinedChargerUnit10msNo1_PT.TargetEMRpmETractSys1_raw "description" FLOAT32_IEEE cal_signal_objects_CM_single 0 0 0 4294967295 ECU_ADDRESS 0x00 DISPLAY_IDENTIFIER TargetEMRpmETractSys1_raw /end MEASUREMENT
/begin MEASUREMENT cap_canApiMsg_CombinedChargerUnit10msNo1_PT.TargetEMRpmETractSys2_phy "description" FLOAT32_IEEE cal_signal_objects_CM_single 0 0 0 4294967295 ECU_ADDRESS 0x00 DISPLAY_IDENTIFIER TargetEMRpmETractSys2_phy /end MEASUREMENT
/begin MEASUREMENT cap_canApiMsg_CombinedChargerUnit10msNo1_PT.TargetEMRpmETractSys2_raw "description" FLOAT32_IEEE cal_signal_objects_CM_single 0 0 0 4294967295 ECU_ADDRESS 0x00 DISPLAY_IDENTIFIER TargetEMRpmETractSys2_raw /end MEASUREMENT
/begin MEASUREMENT cap_canApiMsg_HighVoltageStorage10msNo2_PT.ActualValueVoltageLinkVerified_phy "description" FLOAT32_IEEE cal_signal_objects_CM_single 0 0 0 4294967295 ECU_ADDRESS 0x00 DISPLAY_IDENTIFIER ActualValueVoltageLinkVerified_phy /end MEASUREMENT
/begin MEASUREMENT cap_canApiMsg_HighVoltageStorage10msNo2_PT.ActualValueVoltageLinkVerified_raw "description" FLOAT32_IEEE cal_signal_objects_CM_single 0 0 0 4294967295 ECU_ADDRESS 0x00 DISPLAY_IDENTIFIER ActualValueVoltageLinkVerified_raw /end MEASUREMENT
/begin MEASUREMENT cap_canApiMsg_TracEMacElectc1Time10msNo1_PT.CurrDrctCurrETractSys1ActVal_phy "description" FLOAT32_IEEE cal_signal_objects_CM_single 0 0 0 4294967295 ECU_ADDRESS 0x00 DISPLAY_IDENTIFIER CurrDrctCurrETractSys1ActVal_phy /end MEASUREMENT
/begin MEASUREMENT cap_canApiMsg_TracEMacElectc1Time10msNo1_PT.CurrDrctCurrETractSys1ActVal_raw "description" FLOAT32_IEEE cal_signal_objects_CM_single 0 0 0 4294967295 ECU_ADDRESS 0x00 DISPLAY_IDENTIFIER CurrDrctCurrETractSys1ActVal_raw /end MEASUREMENT
/begin MEASUREMENT cap_canApiMsg_TracEMacElectc1Time10msNo1_PT.VolDrctCurrETractSys1ActVal_phy "description" FLOAT32_IEEE cal_signal_objects_CM_single 0 0 0 4294967295 ECU_ADDRESS 0x00 DISPLAY_IDENTIFIER VolDrctCurrETractSys1ActVal_phy /end MEASUREMENT
/begin MEASUREMENT cap_canApiMsg_TracEMacElectc1Time10msNo1_PT.VolDrctCurrETractSys1ActVal_raw "description" FLOAT32_IEEE cal_signal_objects_CM_single 0 0 0 4294967295 ECU_ADDRESS 0x00 DISPLAY_IDENTIFIER VolDrctCurrETractSys1ActVal_raw /end MEASUREMENT
/begin MEASUREMENT cap_canApiMsg_TracEMacElectc1Time10msNo1_PT.RpmEmETractSys1MaximumLimit_phy "description" FLOAT32_IEEE cal_signal_objects_CM_single 0 0 0 4294967295 ECU_ADDRESS 0x00 DISPLAY_IDENTIFIER RpmEmETractSys1MaximumLimit_phy /end MEASUREMENT
/begin MEASUREMENT cap_canApiMsg_TracEMacElectc1Time10msNo1_PT.RpmEmETractSys1MaximumLimit_raw "description" FLOAT32_IEEE cal_signal_objects_CM_single 0 0 0 4294967295 ECU_ADDRESS 0x00 DISPLAY_IDENTIFIER RpmEmETractSys1MaximumLimit_raw /end MEASUREMENT
/begin MEASUREMENT cap_canApiMsg_TracEMacElectc1Time10msNo1_PT.RpmEmETractSys1MinimumLimit_phy "description" FLOAT32_IEEE cal_signal_objects_CM_single 0 0 0 4294967295 ECU_ADDRESS 0x00 DISPLAY_IDENTIFIER RpmEmETractSys1MinimumLimit_phy /end MEASUREMENT
/begin MEASUREMENT cap_canApiMsg_TracEMacElectc1Time10msNo1_PT.RpmEmETractSys1MinimumLimit_raw "description" FLOAT32_IEEE cal_signal_objects_CM_single 0 0 0 4294967295 ECU_ADDRESS 0x00 DISPLAY_IDENTIFIER RpmEmETractSys1MinimumLimit_raw /end MEASUREMENT
/begin MEASUREMENT cap_canApiMsg_TracEMacElectc1Time10msNo1_PT.TqEmETractSys1VibrationDampSusp_phy "description" FLOAT32_IEEE cal_signal_objects_CM_single 0 0 0 4294967295 ECU_ADDRESS 0x00 DISPLAY_IDENTIFIER TqEmETractSys1VibrationDampSusp_phy /end MEASUREMENT
/begin MEASUREMENT cap_canApiMsg_TracEMacElectc1Time10msNo1_PT.TqEmETractSys1VibrationDampSusp_raw "description" FLOAT32_IEEE cal_signal_objects_CM_single 0 0 0 4294967295 ECU_ADDRESS 0x00 DISPLAY_IDENTIFIER TqEmETractSys1VibrationDampSusp_raw /end MEASUREMENT
/begin MEASUREMENT cap_canApiMsg_TracEMacElectc1Time10msNo1_PT.RpmEmETractSys1ActualValue_phy "description" FLOAT32_IEEE cal_signal_objects_CM_single 0 0 0 4294967295 ECU_ADDRESS 0x00 DISPLAY_IDENTIFIER RpmEmETractSys1ActualValue_phy /end MEASUREMENT
/begin MEASUREMENT cap_canApiMsg_TracEMacElectc1Time10msNo1_PT.RpmEmETractSys1ActualValue_raw "description" FLOAT32_IEEE cal_signal_objects_CM_single 0 0 0 4294967295 ECU_ADDRESS 0x00 DISPLAY_IDENTIFIER RpmEmETractSys1ActualValue_raw /end MEASUREMENT
/begin MEASUREMENT cap_canApiMsg_TracEMacElectc1Time10msNo1_PT.TqEmETractSys1GeneratorStatic_phy "description" FLOAT32_IEEE cal_signal_objects_CM_single 0 0 0 4294967295 ECU_ADDRESS 0x00 DISPLAY_IDENTIFIER TqEmETractSys1GeneratorStatic_phy /end MEASUREMENT
/begin MEASUREMENT cap_canApiMsg_TracEMacElectc1Time10msNo1_PT.TqEmETractSys1GeneratorStatic_raw "description" FLOAT32_IEEE cal_signal_objects_CM_single 0 0 0 4294967295 ECU_ADDRESS 0x00 DISPLAY_IDENTIFIER TqEmETractSys1GeneratorStatic_raw /end MEASUREMENT
/begin MEASUREMENT cap_canApiMsg_TracEMacElectc1Time10msNo1_PT.TqEmETractSys1GeneratorDynamic_phy "description" FLOAT32_IEEE cal_signal_objects_CM_single 0 0 0 4294967295 ECU_ADDRESS 0x00 DISPLAY_IDENTIFIER TqEmETractSys1GeneratorDynamic_phy /end MEASUREMENT
/begin MEASUREMENT cap_canApiMsg_TracEMacElectc1Time10msNo1_PT.TqEmETractSys1GeneratorDynamic_raw "description" FLOAT32_IEEE cal_signal_objects_CM_single 0 0 0 4294967295 ECU_ADDRESS 0x00 DISPLAY_IDENTIFIER TqEmETractSys1GeneratorDynamic_raw /end MEASUREMENT
/begin MEASUREMENT cap_canApiMsg_TracEMacElectc1Time10msNo1_PT.TorqueEmETractSys1MotorStatic_phy "description" FLOAT32_IEEE cal_signal_objects_CM_single 0 0 0 4294967295 ECU_ADDRESS 0x00 DISPLAY_IDENTIFIER TorqueEmETractSys1MotorStatic_phy /end MEASUREMENT
/begin MEASUREMENT cap_canApiMsg_TracEMacElectc1Time10msNo1_PT.TorqueEmETractSys1MotorStatic_raw "description" FLOAT32_IEEE cal_signal_objects_CM_single 0 0 0 4294967295 ECU_ADDRESS 0x00 DISPLAY_IDENTIFIER TorqueEmETractSys1MotorStatic_raw /end MEASUREMENT
/begin MEASUREMENT cap_canApiMsg_TracEMacElectc1Time10msNo1_PT.TorqueEmETractSys1MotorDynamic_phy "description" FLOAT32_IEEE cal_signal_objects_CM_single 0 0 0 4294967295 ECU_ADDRESS 0x00 DISPLAY_IDENTIFIER TorqueEmETractSys1MotorDynamic_phy /end MEASUREMENT
/begin MEASUREMENT cap_canApiMsg_TracEMacElectc1Time10msNo1_PT.TorqueEmETractSys1MotorDynamic_raw "description" FLOAT32_IEEE cal_signal_objects_CM_single 0 0 0 4294967295 ECU_ADDRESS 0x00 DISPLAY_IDENTIFIER TorqueEmETractSys1MotorDynamic_raw /end MEASUREMENT
/begin MEASUREMENT cap_canApiMsg_TracEMacElectc1Time10msNo1_PT.TorqueEmETractSys1ActualValue_phy "description" FLOAT32_IEEE cal_signal_objects_CM_single 0 0 0 4294967295 ECU_ADDRESS 0x00 DISPLAY_IDENTIFIER TorqueEmETractSys1ActualValue_phy /end MEASUREMENT
/begin MEASUREMENT cap_canApiMsg_TracEMacElectc1Time10msNo1_PT.TorqueEmETractSys1ActualValue_raw "description" FLOAT32_IEEE cal_signal_objects_CM_single 0 0 0 4294967295 ECU_ADDRESS 0x00 DISPLAY_IDENTIFIER TorqueEmETractSys1ActualValue_raw /end MEASUREMENT
/begin MEASUREMENT cap_canApiMsg_TracEMacElectc1Time10msNo1_PT.TqEmETractSys1MotorSumLimTarget_phy "description" FLOAT32_IEEE cal_signal_objects_CM_single 0 0 0 4294967295 ECU_ADDRESS 0x00 DISPLAY_IDENTIFIER TqEmETractSys1MotorSumLimTarget_phy /end MEASUREMENT
/begin MEASUREMENT cap_canApiMsg_TracEMacElectc1Time10msNo1_PT.TqEmETractSys1MotorSumLimTarget_raw "description" FLOAT32_IEEE cal_signal_objects_CM_single 0 0 0 4294967295 ECU_ADDRESS 0x00 DISPLAY_IDENTIFIER TqEmETractSys1MotorSumLimTarget_raw /end MEASUREMENT
/begin MEASUREMENT cap_canApiMsg_TracEMacElectc1Time10msNo1_PT.SumWhlTqIntvETractSys1_phy "description" FLOAT32_IEEE cal_signal_objects_CM_single 0 0 0 4294967295 ECU_ADDRESS 0x00 DISPLAY_IDENTIFIER SumWhlTqIntvETractSys1_phy /end MEASUREMENT
/begin MEASUREMENT cap_canApiMsg_TracEMacElectc1Time10msNo1_PT.SumWhlTqIntvETractSys1_raw "description" FLOAT32_IEEE cal_signal_objects_CM_single 0 0 0 4294967295 ECU_ADDRESS 0x00 DISPLAY_IDENTIFIER SumWhlTqIntvETractSys1_raw /end MEASUREMENT
/begin MEASUREMENT cap_canApiMsg_TracEMacElectc1Time10msNo1_PT.PowerETractSys1LossActualValue_phy "description" FLOAT32_IEEE cal_signal_objects_CM_single 0 0 0 4294967295 ECU_ADDRESS 0x00 DISPLAY_IDENTIFIER PowerETractSys1LossActualValue_phy /end MEASUREMENT
/begin MEASUREMENT cap_canApiMsg_TracEMacElectc1Time10msNo1_PT.PowerETractSys1LossActualValue_raw "description" FLOAT32_IEEE cal_signal_objects_CM_single 0 0 0 4294967295 ECU_ADDRESS 0x00 DISPLAY_IDENTIFIER PowerETractSys1LossActualValue_raw /end MEASUREMENT
/begin MEASUREMENT cap_canApiMsg_TracEMacElectc1Time10msNo1_PT.TarTqETractSys1NControlStatic_phy "description" FLOAT32_IEEE cal_signal_objects_CM_single 0 0 0 4294967295 ECU_ADDRESS 0x00 DISPLAY_IDENTIFIER TarTqETractSys1NControlStatic_phy /end MEASUREMENT
/begin MEASUREMENT cap_canApiMsg_TracEMacElectc1Time10msNo1_PT.TarTqETractSys1NControlStatic_raw "description" FLOAT32_IEEE cal_signal_objects_CM_single 0 0 0 4294967295 ECU_ADDRESS 0x00 DISPLAY_IDENTIFIER TarTqETractSys1NControlStatic_raw /end MEASUREMENT
/begin MEASUREMENT cap_canApiMsg_TracEMacElectc1Time10msNo1_PT.PwrLossPrednETractSys1Mot_phy "description" FLOAT32_IEEE cal_signal_objects_CM_single 0 0 0 4294967295 ECU_ADDRESS 0x00 DISPLAY_IDENTIFIER PwrLossPrednETractSys1Mot_phy /end MEASUREMENT
/begin MEASUREMENT cap_canApiMsg_TracEMacElectc1Time10msNo1_PT.PwrLossPrednETractSys1Mot_raw "description" FLOAT32_IEEE cal_signal_objects_CM_single 0 0 0 4294967295 ECU_ADDRESS 0x00 DISPLAY_IDENTIFIER PwrLossPrednETractSys1Mot_raw /end MEASUREMENT
/begin MEASUREMENT cap_canApiMsg_TracEMacElectc1Time10msNo1_PT.PwrLossPrednETractSys1Genr_phy "description" FLOAT32_IEEE cal_signal_objects_CM_single 0 0 0 4294967295 ECU_ADDRESS 0x00 DISPLAY_IDENTIFIER PwrLossPrednETractSys1Genr_phy /end MEASUREMENT
/begin MEASUREMENT cap_canApiMsg_TracEMacElectc1Time10msNo1_PT.PwrLossPrednETractSys1Genr_raw "description" FLOAT32_IEEE cal_signal_objects_CM_single 0 0 0 4294967295 ECU_ADDRESS 0x00 DISPLAY_IDENTIFIER PwrLossPrednETractSys1Genr_raw /end MEASUREMENT
/begin MEASUREMENT cap_canApiMsg_WMOM_DRV_9_PT.TAR_WMOM_PT_SUM_COOTD_phy "description" FLOAT32_IEEE cal_signal_objects_CM_single 0 0 0 4294967295 ECU_ADDRESS 0x00 DISPLAY_IDENTIFIER TAR_WMOM_PT_SUM_COOTD_phy /end MEASUREMENT
/begin MEASUREMENT cap_canApiMsg_WMOM_DRV_9_PT.TAR_WMOM_PT_SUM_COOTD_raw "description" FLOAT32_IEEE cal_signal_objects_CM_single 0 0 0 4294967295 ECU_ADDRESS 0x00 DISPLAY_IDENTIFIER TAR_WMOM_PT_SUM_COOTD_raw /end MEASUREMENT
/begin MEASUREMENT cap_canApiMsg_BMS_HVMeas_PT.BMS_HVPackVol_phy "description" FLOAT32_IEEE cal_signal_objects_CM_single 0 0 0 4294967295 ECU_ADDRESS 0x00 DISPLAY_IDENTIFIER BMS_HVPackVol_phy /end MEASUREMENT
/begin MEASUREMENT cap_canApiMsg_BMS_HVMeas_PT.BMS_HVPackVol_raw "description" FLOAT32_IEEE cal_signal_objects_CM_single 0 0 0 4294967295 ECU_ADDRESS 0x00 DISPLAY_IDENTIFIER BMS_HVPackVol_raw /end MEASUREMENT
/begin MEASUREMENT cap_canApiMsg_BMS_HVMeas_PT.BMS_HVLinkVol_phy "description" FLOAT32_IEEE cal_signal_objects_CM_single 0 0 0 4294967295 ECU_ADDRESS 0x00 DISPLAY_IDENTIFIER BMS_HVLinkVol_phy /end MEASUREMENT
/begin MEASUREMENT cap_canApiMsg_BMS_HVMeas_PT.BMS_HVLinkVol_raw "description" FLOAT32_IEEE cal_signal_objects_CM_single 0 0 0 4294967295 ECU_ADDRESS 0x00 DISPLAY_IDENTIFIER BMS_HVLinkVol_raw /end MEASUREMENT
/begin MEASUREMENT cap_canApiMsg_BMS_HVMeas_PT.BMS_HVBusVol_phy "description" FLOAT32_IEEE cal_signal_objects_CM_single 0 0 0 4294967295 ECU_ADDRESS 0x00 DISPLAY_IDENTIFIER BMS_HVBusVol_phy /end MEASUREMENT
/begin MEASUREMENT cap_canApiMsg_BMS_HVMeas_PT.BMS_HVBusVol_raw "description" FLOAT32_IEEE cal_signal_objects_CM_single 0 0 0 4294967295 ECU_ADDRESS 0x00 DISPLAY_IDENTIFIER BMS_HVBusVol_raw /end MEASUREMENT
/begin MEASUREMENT cap_canApiMsg_BMS_HVMeas_PT.BMS_HVFuseVol_phy "description" FLOAT32_IEEE cal_signal_objects_CM_single 0 0 0 4294967295 ECU_ADDRESS 0x00 DISPLAY_IDENTIFIER BMS_HVFuseVol_phy /end MEASUREMENT
/begin MEASUREMENT cap_canApiMsg_BMS_HVMeas_PT.BMS_HVFuseVol_raw "description" FLOAT32_IEEE cal_signal_objects_CM_single 0 0 0 4294967295 ECU_ADDRESS 0x00 DISPLAY_IDENTIFIER BMS_HVFuseVol_raw /end MEASUREMENT
/begin MEASUREMENT cap_canApiMsg_BMS_HVMeas_PT.BMS_DCPlugVol_phy "description" FLOAT32_IEEE cal_signal_objects_CM_single 0 0 0 4294967295 ECU_ADDRESS 0x00 DISPLAY_IDENTIFIER BMS_DCPlugVol_phy /end MEASUREMENT
/begin MEASUREMENT cap_canApiMsg_BMS_HVMeas_PT.BMS_DCPlugVol_raw "description" FLOAT32_IEEE cal_signal_objects_CM_single 0 0 0 4294967295 ECU_ADDRESS 0x00 DISPLAY_IDENTIFIER BMS_DCPlugVol_raw /end MEASUREMENT
/begin MEASUREMENT cap_canApiMsg_TracEMacElectc2Time10msNo1_PT.CurrDrctCurrETractSys2ActVal_phy "description" FLOAT32_IEEE cal_signal_objects_CM_single 0 0 0 4294967295 ECU_ADDRESS 0x00 DISPLAY_IDENTIFIER CurrDrctCurrETractSys2ActVal_phy /end MEASUREMENT
/begin MEASUREMENT cap_canApiMsg_TracEMacElectc2Time10msNo1_PT.CurrDrctCurrETractSys2ActVal_raw "description" FLOAT32_IEEE cal_signal_objects_CM_single 0 0 0 4294967295 ECU_ADDRESS 0x00 DISPLAY_IDENTIFIER CurrDrctCurrETractSys2ActVal_raw /end MEASUREMENT
/begin MEASUREMENT cap_canApiMsg_TracEMacElectc2Time10msNo1_PT.VolDrctCurrETractSys2ActVal_phy "description" FLOAT32_IEEE cal_signal_objects_CM_single 0 0 0 4294967295 ECU_ADDRESS 0x00 DISPLAY_IDENTIFIER VolDrctCurrETractSys2ActVal_phy /end MEASUREMENT
/begin MEASUREMENT cap_canApiMsg_TracEMacElectc2Time10msNo1_PT.VolDrctCurrETractSys2ActVal_raw "description" FLOAT32_IEEE cal_signal_objects_CM_single 0 0 0 4294967295 ECU_ADDRESS 0x00 DISPLAY_IDENTIFIER VolDrctCurrETractSys2ActVal_raw /end MEASUREMENT
/begin MEASUREMENT cap_canApiMsg_TracEMacElectc2Time10msNo1_PT.RpmEmETractSys2MaximumLimit_phy "description" FLOAT32_IEEE cal_signal_objects_CM_single 0 0 0 4294967295 ECU_ADDRESS 0x00 DISPLAY_IDENTIFIER RpmEmETractSys2MaximumLimit_phy /end MEASUREMENT
/begin MEASUREMENT cap_canApiMsg_TracEMacElectc2Time10msNo1_PT.RpmEmETractSys2MaximumLimit_raw "description" FLOAT32_IEEE cal_signal_objects_CM_single 0 0 0 4294967295 ECU_ADDRESS 0x00 DISPLAY_IDENTIFIER RpmEmETractSys2MaximumLimit_raw /end MEASUREMENT
/begin MEASUREMENT cap_canApiMsg_TracEMacElectc2Time10msNo1_PT.RpmEmETractSys2MinimumLimit_phy "description" FLOAT32_IEEE cal_signal_objects_CM_single 0 0 0 4294967295 ECU_ADDRESS 0x00 DISPLAY_IDENTIFIER RpmEmETractSys2MinimumLimit_phy /end MEASUREMENT
/begin MEASUREMENT cap_canApiMsg_TracEMacElectc2Time10msNo1_PT.RpmEmETractSys2MinimumLimit_raw "description" FLOAT32_IEEE cal_signal_objects_CM_single 0 0 0 4294967295 ECU_ADDRESS 0x00 DISPLAY_IDENTIFIER RpmEmETractSys2MinimumLimit_raw /end MEASUREMENT
/begin MEASUREMENT cap_canApiMsg_TracEMacElectc2Time10msNo1_PT.TqEmETractSys2VibrationDampSusp_phy "description" FLOAT32_IEEE cal_signal_objects_CM_single 0 0 0 4294967295 ECU_ADDRESS 0x00 DISPLAY_IDENTIFIER TqEmETractSys2VibrationDampSusp_phy /end MEASUREMENT
/begin MEASUREMENT cap_canApiMsg_TracEMacElectc2Time10msNo1_PT.TqEmETractSys2VibrationDampSusp_raw "description" FLOAT32_IEEE cal_signal_objects_CM_single 0 0 0 4294967295 ECU_ADDRESS 0x00 DISPLAY_IDENTIFIER TqEmETractSys2VibrationDampSusp_raw /end MEASUREMENT
/begin MEASUREMENT cap_canApiMsg_TracEMacElectc2Time10msNo1_PT.RpmEmETractSys2ActualValue_phy "description" FLOAT32_IEEE cal_signal_objects_CM_single 0 0 0 4294967295 ECU_ADDRESS 0x00 DISPLAY_IDENTIFIER RpmEmETractSys2ActualValue_phy /end MEASUREMENT
/begin MEASUREMENT cap_canApiMsg_TracEMacElectc2Time10msNo1_PT.RpmEmETractSys2ActualValue_raw "description" FLOAT32_IEEE cal_signal_objects_CM_single 0 0 0 4294967295 ECU_ADDRESS 0x00 DISPLAY_IDENTIFIER RpmEmETractSys2ActualValue_raw /end MEASUREMENT
/begin MEASUREMENT cap_canApiMsg_TracEMacElectc2Time10msNo1_PT.TqEmETractSys2GeneratorStatic_phy "description" FLOAT32_IEEE cal_signal_objects_CM_single 0 0 0 4294967295 ECU_ADDRESS 0x00 DISPLAY_IDENTIFIER TqEmETractSys2GeneratorStatic_phy /end MEASUREMENT
/begin MEASUREMENT cap_canApiMsg_TracEMacElectc2Time10msNo1_PT.TqEmETractSys2GeneratorStatic_raw "description" FLOAT32_IEEE cal_signal_objects_CM_single 0 0 0 4294967295 ECU_ADDRESS 0x00 DISPLAY_IDENTIFIER TqEmETractSys2GeneratorStatic_raw /end MEASUREMENT
/begin MEASUREMENT cap_canApiMsg_TracEMacElectc2Time10msNo1_PT.TqEmETractSys2GeneratorDynamic_phy "description" FLOAT32_IEEE cal_signal_objects_CM_single 0 0 0 4294967295 ECU_ADDRESS 0x00 DISPLAY_IDENTIFIER TqEmETractSys2GeneratorDynamic_phy /end MEASUREMENT
/begin MEASUREMENT cap_canApiMsg_TracEMacElectc2Time10msNo1_PT.TqEmETractSys2GeneratorDynamic_raw "description" FLOAT32_IEEE cal_signal_objects_CM_single 0 0 0 4294967295 ECU_ADDRESS 0x00 DISPLAY_IDENTIFIER TqEmETractSys2GeneratorDynamic_raw /end MEASUREMENT
/begin MEASUREMENT cap_canApiMsg_TracEMacElectc2Time10msNo1_PT.TorqueEmETractSys2MotorStatic_phy "description" FLOAT32_IEEE cal_signal_objects_CM_single 0 0 0 4294967295 ECU_ADDRESS 0x00 DISPLAY_IDENTIFIER TorqueEmETractSys2MotorStatic_phy /end MEASUREMENT
/begin MEASUREMENT cap_canApiMsg_TracEMacElectc2Time10msNo1_PT.TorqueEmETractSys2MotorStatic_raw "description" FLOAT32_IEEE cal_signal_objects_CM_single 0 0 0 4294967295 ECU_ADDRESS 0x00 DISPLAY_IDENTIFIER TorqueEmETractSys2MotorStatic_raw /end MEASUREMENT
/begin MEASUREMENT cap_canApiMsg_TracEMacElectc2Time10msNo1_PT.TorqueEmETractSys2MotorDynamic_phy "description" FLOAT32_IEEE cal_signal_objects_CM_single 0 0 0 4294967295 ECU_ADDRESS 0x00 DISPLAY_IDENTIFIER TorqueEmETractSys2MotorDynamic_phy /end MEASUREMENT
/begin MEASUREMENT cap_canApiMsg_TracEMacElectc2Time10msNo1_PT.TorqueEmETractSys2MotorDynamic_raw "description" FLOAT32_IEEE cal_signal_objects_CM_single 0 0 0 4294967295 ECU_ADDRESS 0x00 DISPLAY_IDENTIFIER TorqueEmETractSys2MotorDynamic_raw /end MEASUREMENT
/begin MEASUREMENT cap_canApiMsg_TracEMacElectc2Time10msNo1_PT.TorqueEmETractSys2ActualValue_phy "description" FLOAT32_IEEE cal_signal_objects_CM_single 0 0 0 4294967295 ECU_ADDRESS 0x00 DISPLAY_IDENTIFIER TorqueEmETractSys2ActualValue_phy /end MEASUREMENT
/begin MEASUREMENT cap_canApiMsg_TracEMacElectc2Time10msNo1_PT.TorqueEmETractSys2ActualValue_raw "description" FLOAT32_IEEE cal_signal_objects_CM_single 0 0 0 4294967295 ECU_ADDRESS 0x00 DISPLAY_IDENTIFIER TorqueEmETractSys2ActualValue_raw /end MEASUREMENT
/begin MEASUREMENT cap_canApiMsg_TracEMacElectc2Time10msNo1_PT.TqEmETractSys2MotorSumLimTarget_phy "description" FLOAT32_IEEE cal_signal_objects_CM_single 0 0 0 4294967295 ECU_ADDRESS 0x00 DISPLAY_IDENTIFIER TqEmETractSys2MotorSumLimTarget_phy /end MEASUREMENT
/begin MEASUREMENT cap_canApiMsg_TracEMacElectc2Time10msNo1_PT.TqEmETractSys2MotorSumLimTarget_raw "description" FLOAT32_IEEE cal_signal_objects_CM_single 0 0 0 4294967295 ECU_ADDRESS 0x00 DISPLAY_IDENTIFIER TqEmETractSys2MotorSumLimTarget_raw /end MEASUREMENT
/begin MEASUREMENT cap_canApiMsg_TracEMacElectc2Time10msNo1_PT.SumWhlTqIntvETractSys2_phy "description" FLOAT32_IEEE cal_signal_objects_CM_single 0 0 0 4294967295 ECU_ADDRESS 0x00 DISPLAY_IDENTIFIER SumWhlTqIntvETractSys2_phy /end MEASUREMENT
/begin MEASUREMENT cap_canApiMsg_TracEMacElectc2Time10msNo1_PT.SumWhlTqIntvETractSys2_raw "description" FLOAT32_IEEE cal_signal_objects_CM_single 0 0 0 4294967295 ECU_ADDRESS 0x00 DISPLAY_IDENTIFIER SumWhlTqIntvETractSys2_raw /end MEASUREMENT
/begin MEASUREMENT cap_canApiMsg_TracEMacElectc2Time10msNo1_PT.PowerETractSys2LossActualValue_phy "description" FLOAT32_IEEE cal_signal_objects_CM_single 0 0 0 4294967295 ECU_ADDRESS 0x00 DISPLAY_IDENTIFIER PowerETractSys2LossActualValue_phy /end MEASUREMENT
/begin MEASUREMENT cap_canApiMsg_TracEMacElectc2Time10msNo1_PT.PowerETractSys2LossActualValue_raw "description" FLOAT32_IEEE cal_signal_objects_CM_single 0 0 0 4294967295 ECU_ADDRESS 0x00 DISPLAY_IDENTIFIER PowerETractSys2LossActualValue_raw /end MEASUREMENT
/begin MEASUREMENT cap_canApiMsg_TracEMacElectc2Time10msNo1_PT.TarTqETractSys2NControlStatic_phy "description" FLOAT32_IEEE cal_signal_objects_CM_single 0 0 0 4294967295 ECU_ADDRESS 0x00 DISPLAY_IDENTIFIER TarTqETractSys2NControlStatic_phy /end MEASUREMENT
/begin MEASUREMENT cap_canApiMsg_TracEMacElectc2Time10msNo1_PT.TarTqETractSys2NControlStatic_raw "description" FLOAT32_IEEE cal_signal_objects_CM_single 0 0 0 4294967295 ECU_ADDRESS 0x00 DISPLAY_IDENTIFIER TarTqETractSys2NControlStatic_raw /end MEASUREMENT
/begin MEASUREMENT cap_canApiMsg_TracEMacElectc2Time10msNo1_PT.PwrLossPrednETractSys2Mot_phy "description" FLOAT32_IEEE cal_signal_objects_CM_single 0 0 0 4294967295 ECU_ADDRESS 0x00 DISPLAY_IDENTIFIER PwrLossPrednETractSys2Mot_phy /end MEASUREMENT
/begin MEASUREMENT cap_canApiMsg_TracEMacElectc2Time10msNo1_PT.PwrLossPrednETractSys2Mot_raw "description" FLOAT32_IEEE cal_signal_objects_CM_single 0 0 0 4294967295 ECU_ADDRESS 0x00 DISPLAY_IDENTIFIER PwrLossPrednETractSys2Mot_raw /end MEASUREMENT
/begin MEASUREMENT cap_canApiMsg_TracEMacElectc2Time10msNo1_PT.PwrLossPrednETractSys2Genr_phy "description" FLOAT32_IEEE cal_signal_objects_CM_single 0 0 0 4294967295 ECU_ADDRESS 0x00 DISPLAY_IDENTIFIER PwrLossPrednETractSys2Genr_phy /end MEASUREMENT
/begin MEASUREMENT cap_canApiMsg_TracEMacElectc2Time10msNo1_PT.PwrLossPrednETractSys2Genr_raw "description" FLOAT32_IEEE cal_signal_objects_CM_single 0 0 0 4294967295 ECU_ADDRESS 0x00 DISPLAY_IDENTIFIER PwrLossPrednETractSys2Genr_raw /end MEASUREMENT
/begin MEASUREMENT cap_canApiMsg_BMS_PowerCont_PT.BMS_MaxDischgCurrentLim_phy "description" FLOAT32_IEEE cal_signal_objects_CM_single 0 0 0 4294967295 ECU_ADDRESS 0x00 DISPLAY_IDENTIFIER BMS_MaxDischgCurrentLim_phy /end MEASUREMENT
/begin MEASUREMENT cap_canApiMsg_BMS_PowerCont_PT.BMS_MaxDischgCurrentLim_raw "description" FLOAT32_IEEE cal_signal_objects_CM_single 0 0 0 4294967295 ECU_ADDRESS 0x00 DISPLAY_IDENTIFIER BMS_MaxDischgCurrentLim_raw /end MEASUREMENT
/begin MEASUREMENT cap_canApiMsg_BMS_PowerCont_PT.BMS_MaxDischgCurrentLimPeak_phy "description" FLOAT32_IEEE cal_signal_objects_CM_single 0 0 0 4294967295 ECU_ADDRESS 0x00 DISPLAY_IDENTIFIER BMS_MaxDischgCurrentLimPeak_phy /end MEASUREMENT
/begin MEASUREMENT cap_canApiMsg_BMS_PowerCont_PT.BMS_MaxDischgCurrentLimPeak_raw "description" FLOAT32_IEEE cal_signal_objects_CM_single 0 0 0 4294967295 ECU_ADDRESS 0x00 DISPLAY_IDENTIFIER BMS_MaxDischgCurrentLimPeak_raw /end MEASUREMENT
/begin MEASUREMENT cap_canApiMsg_BMS_PowerCont_PT.BMS_MaxDischgCurrent2s_phy "description" FLOAT32_IEEE cal_signal_objects_CM_single 0 0 0 4294967295 ECU_ADDRESS 0x00 DISPLAY_IDENTIFIER BMS_MaxDischgCurrent2s_phy /end MEASUREMENT
/begin MEASUREMENT cap_canApiMsg_BMS_PowerCont_PT.BMS_MaxDischgCurrent2s_raw "description" FLOAT32_IEEE cal_signal_objects_CM_single 0 0 0 4294967295 ECU_ADDRESS 0x00 DISPLAY_IDENTIFIER BMS_MaxDischgCurrent2s_raw /end MEASUREMENT
/begin MEASUREMENT cap_canApiMsg_BMS_PowerCont_PT.BMS_MaxDischgCurrent10s_phy "description" FLOAT32_IEEE cal_signal_objects_CM_single 0 0 0 4294967295 ECU_ADDRESS 0x00 DISPLAY_IDENTIFIER BMS_MaxDischgCurrent10s_phy /end MEASUREMENT
/begin MEASUREMENT cap_canApiMsg_BMS_PowerCont_PT.BMS_MaxDischgCurrent10s_raw "description" FLOAT32_IEEE cal_signal_objects_CM_single 0 0 0 4294967295 ECU_ADDRESS 0x00 DISPLAY_IDENTIFIER BMS_MaxDischgCurrent10s_raw /end MEASUREMENT
/begin MEASUREMENT cap_canApiMsg_BMS_PowerCont_PT.BMS_MaxDischgCurrent30s_phy "description" FLOAT32_IEEE cal_signal_objects_CM_single 0 0 0 4294967295 ECU_ADDRESS 0x00 DISPLAY_IDENTIFIER BMS_MaxDischgCurrent30s_phy /end MEASUREMENT
/begin MEASUREMENT cap_canApiMsg_BMS_PowerCont_PT.BMS_MaxDischgCurrent30s_raw "description" FLOAT32_IEEE cal_signal_objects_CM_single 0 0 0 4294967295 ECU_ADDRESS 0x00 DISPLAY_IDENTIFIER BMS_MaxDischgCurrent30s_raw /end MEASUREMENT
/begin MEASUREMENT cap_canApiMsg_BMS_PowerCont_PT.BMS_MaxDischgPwrLim_phy "description" FLOAT32_IEEE cal_signal_objects_CM_single 0 0 0 4294967295 ECU_ADDRESS 0x00 DISPLAY_IDENTIFIER BMS_MaxDischgPwrLim_phy /end MEASUREMENT
/begin MEASUREMENT cap_canApiMsg_BMS_PowerCont_PT.BMS_MaxDischgPwrLim_raw "description" FLOAT32_IEEE cal_signal_objects_CM_single 0 0 0 4294967295 ECU_ADDRESS 0x00 DISPLAY_IDENTIFIER BMS_MaxDischgPwrLim_raw /end MEASUREMENT
/begin MEASUREMENT cap_canApiMsg_BMS_PowerCont_PT.BMS_MaxDischgPwrLimPeak_phy "description" FLOAT32_IEEE cal_signal_objects_CM_single 0 0 0 4294967295 ECU_ADDRESS 0x00 DISPLAY_IDENTIFIER BMS_MaxDischgPwrLimPeak_phy /end MEASUREMENT
/begin MEASUREMENT cap_canApiMsg_BMS_PowerCont_PT.BMS_MaxDischgPwrLimPeak_raw "description" FLOAT32_IEEE cal_signal_objects_CM_single 0 0 0 4294967295 ECU_ADDRESS 0x00 DISPLAY_IDENTIFIER BMS_MaxDischgPwrLimPeak_raw /end MEASUREMENT
/begin MEASUREMENT cap_canApiMsg_BMS_PowerCont_PT.BMS_MaxDischgPwr2s_phy "description" FLOAT32_IEEE cal_signal_objects_CM_single 0 0 0 4294967295 ECU_ADDRESS 0x00 DISPLAY_IDENTIFIER BMS_MaxDischgPwr2s_phy /end MEASUREMENT
/begin MEASUREMENT cap_canApiMsg_BMS_PowerCont_PT.BMS_MaxDischgPwr2s_raw "description" FLOAT32_IEEE cal_signal_objects_CM_single 0 0 0 4294967295 ECU_ADDRESS 0x00 DISPLAY_IDENTIFIER BMS_MaxDischgPwr2s_raw /end MEASUREMENT
/begin MEASUREMENT cap_canApiMsg_BMS_PowerCont_PT.BMS_MaxDischgPwr10s_phy "description" FLOAT32_IEEE cal_signal_objects_CM_single 0 0 0 4294967295 ECU_ADDRESS 0x00 DISPLAY_IDENTIFIER BMS_MaxDischgPwr10s_phy /end MEASUREMENT
/begin MEASUREMENT cap_canApiMsg_BMS_PowerCont_PT.BMS_MaxDischgPwr10s_raw "description" FLOAT32_IEEE cal_signal_objects_CM_single 0 0 0 4294967295 ECU_ADDRESS 0x00 DISPLAY_IDENTIFIER BMS_MaxDischgPwr10s_raw /end MEASUREMENT
/begin MEASUREMENT cap_canApiMsg_BMS_PowerCont_PT.BMS_MaxDischgPwr30s_phy "description" FLOAT32_IEEE cal_signal_objects_CM_single 0 0 0 4294967295 ECU_ADDRESS 0x00 DISPLAY_IDENTIFIER BMS_MaxDischgPwr30s_phy /end MEASUREMENT
/begin MEASUREMENT cap_canApiMsg_BMS_PowerCont_PT.BMS_MaxDischgPwr30s_raw "description" FLOAT32_IEEE cal_signal_objects_CM_single 0 0 0 4294967295 ECU_ADDRESS 0x00 DISPLAY_IDENTIFIER BMS_MaxDischgPwr30s_raw /end MEASUREMENT
/begin MEASUREMENT cap_canApiMsg_BMS_Sts_PT.BMS_SocActualEst_phy "description" FLOAT32_IEEE cal_signal_objects_CM_single 0 0 0 4294967295 ECU_ADDRESS 0x00 DISPLAY_IDENTIFIER BMS_SocActualEst_phy /end MEASUREMENT
/begin MEASUREMENT cap_canApiMsg_BMS_Sts_PT.BMS_SocActualEst_raw "description" FLOAT32_IEEE cal_signal_objects_CM_single 0 0 0 4294967295 ECU_ADDRESS 0x00 DISPLAY_IDENTIFIER BMS_SocActualEst_raw /end MEASUREMENT
/begin MEASUREMENT cap_canApiMsg_BMS_Sts_PT.BMS_SocRelativeEst_phy "description" FLOAT32_IEEE cal_signal_objects_CM_single 0 0 0 4294967295 ECU_ADDRESS 0x00 DISPLAY_IDENTIFIER BMS_SocRelativeEst_phy /end MEASUREMENT
/begin MEASUREMENT cap_canApiMsg_BMS_Sts_PT.BMS_SocRelativeEst_raw "description" FLOAT32_IEEE cal_signal_objects_CM_single 0 0 0 4294967295 ECU_ADDRESS 0x00 DISPLAY_IDENTIFIER BMS_SocRelativeEst_raw /end MEASUREMENT
/begin MEASUREMENT cap_canApiMsg_BMS_Sts_PT.BMS_SOH_phy "description" FLOAT32_IEEE cal_signal_objects_CM_single 0 0 0 4294967295 ECU_ADDRESS 0x00 DISPLAY_IDENTIFIER BMS_SOH_phy /end MEASUREMENT
/begin MEASUREMENT cap_canApiMsg_BMS_Sts_PT.BMS_SOH_raw "description" FLOAT32_IEEE cal_signal_objects_CM_single 0 0 0 4294967295 ECU_ADDRESS 0x00 DISPLAY_IDENTIFIER BMS_SOH_raw /end MEASUREMENT
/begin MEASUREMENT cap_canApiMsg_BMS_Sts_PT.BMS_SOE_phy "description" FLOAT32_IEEE cal_signal_objects_CM_single 0 0 0 4294967295 ECU_ADDRESS 0x00 DISPLAY_IDENTIFIER BMS_SOE_phy /end MEASUREMENT
/begin MEASUREMENT cap_canApiMsg_BMS_Sts_PT.BMS_SOE_raw "description" FLOAT32_IEEE cal_signal_objects_CM_single 0 0 0 4294967295 ECU_ADDRESS 0x00 DISPLAY_IDENTIFIER BMS_SOE_raw /end MEASUREMENT
/begin MEASUREMENT cap_canApiMsg_WMOM_PT_AVL_PT.AVL_WMOM_PT_SUM_phy "description" FLOAT32_IEEE cal_signal_objects_CM_single 0 0 0 4294967295 ECU_ADDRESS 0x00 DISPLAY_IDENTIFIER AVL_WMOM_PT_SUM_phy /end MEASUREMENT
/begin MEASUREMENT cap_canApiMsg_WMOM_PT_AVL_PT.AVL_WMOM_PT_SUM_raw "description" FLOAT32_IEEE cal_signal_objects_CM_single 0 0 0 4294967295 ECU_ADDRESS 0x00 DISPLAY_IDENTIFIER AVL_WMOM_PT_SUM_raw /end MEASUREMENT
/begin MEASUREMENT cap_canApiMsg_DCDC_VCU_Measure_Fbk_PT.DCDC_MeasVs_phy "description" FLOAT32_IEEE cal_signal_objects_CM_single 0 0 0 4294967295 ECU_ADDRESS 0x00 DISPLAY_IDENTIFIER DCDC_MeasVs_phy /end MEASUREMENT
/begin MEASUREMENT cap_canApiMsg_DCDC_VCU_Measure_Fbk_PT.DCDC_MeasVs_raw "description" FLOAT32_IEEE cal_signal_objects_CM_single 0 0 0 4294967295 ECU_ADDRESS 0x00 DISPLAY_IDENTIFIER DCDC_MeasVs_raw /end MEASUREMENT
/begin MEASUREMENT cap_canApiMsg_DCDC_VCU_Measure_Fbk_PT.DCDC_MeasOutCurr_phy "description" FLOAT32_IEEE cal_signal_objects_CM_single 0 0 0 4294967295 ECU_ADDRESS 0x00 DISPLAY_IDENTIFIER DCDC_MeasOutCurr_phy /end MEASUREMENT
/begin MEASUREMENT cap_canApiMsg_DCDC_VCU_Measure_Fbk_PT.DCDC_MeasOutCurr_raw "description" FLOAT32_IEEE cal_signal_objects_CM_single 0 0 0 4294967295 ECU_ADDRESS 0x00 DISPLAY_IDENTIFIER DCDC_MeasOutCurr_raw /end MEASUREMENT
/begin MEASUREMENT cap_canApiMsg_DCDC_VCU_Measure_Fbk_PT.DCDC_MeasInVltg_phy "description" FLOAT32_IEEE cal_signal_objects_CM_single 0 0 0 4294967295 ECU_ADDRESS 0x00 DISPLAY_IDENTIFIER DCDC_MeasInVltg_phy /end MEASUREMENT
/begin MEASUREMENT cap_canApiMsg_DCDC_VCU_Measure_Fbk_PT.DCDC_MeasInVltg_raw "description" FLOAT32_IEEE cal_signal_objects_CM_single 0 0 0 4294967295 ECU_ADDRESS 0x00 DISPLAY_IDENTIFIER DCDC_MeasInVltg_raw /end MEASUREMENT
/begin MEASUREMENT cap_canApiMsg_DCDC_VCU_Measure_Fbk_PT.DCDC_MeasInCurrent_phy "description" FLOAT32_IEEE cal_signal_objects_CM_single 0 0 0 4294967295 ECU_ADDRESS 0x00 DISPLAY_IDENTIFIER DCDC_MeasInCurrent_phy /end MEASUREMENT
/begin MEASUREMENT cap_canApiMsg_DCDC_VCU_Measure_Fbk_PT.DCDC_MeasInCurrent_raw "description" FLOAT32_IEEE cal_signal_objects_CM_single 0 0 0 4294967295 ECU_ADDRESS 0x00 DISPLAY_IDENTIFIER DCDC_MeasInCurrent_raw /end MEASUREMENT
/begin MEASUREMENT cap_canApiMsg_DCDC_VCU_Req_Fbk_PT.DCDC_OutVltgReqFbk_phy "description" FLOAT32_IEEE cal_signal_objects_CM_single 0 0 0 4294967295 ECU_ADDRESS 0x00 DISPLAY_IDENTIFIER DCDC_OutVltgReqFbk_phy /end MEASUREMENT
/begin MEASUREMENT cap_canApiMsg_DCDC_VCU_Req_Fbk_PT.DCDC_OutVltgReqFbk_raw "description" FLOAT32_IEEE cal_signal_objects_CM_single 0 0 0 4294967295 ECU_ADDRESS 0x00 DISPLAY_IDENTIFIER DCDC_OutVltgReqFbk_raw /end MEASUREMENT
/begin MEASUREMENT cap_canApiMsg_DCDC_VCU_Req_Fbk_PT.DCDC_OutCurrReqFbk_phy "description" FLOAT32_IEEE cal_signal_objects_CM_single 0 0 0 4294967295 ECU_ADDRESS 0x00 DISPLAY_IDENTIFIER DCDC_OutCurrReqFbk_phy /end MEASUREMENT
/begin MEASUREMENT cap_canApiMsg_DCDC_VCU_Req_Fbk_PT.DCDC_OutCurrReqFbk_raw "description" FLOAT32_IEEE cal_signal_objects_CM_single 0 0 0 4294967295 ECU_ADDRESS 0x00 DISPLAY_IDENTIFIER DCDC_OutCurrReqFbk_raw /end MEASUREMENT
/begin MEASUREMENT cap_canApiMsg_DCDC_VCU_Req_Fbk_PT.DCDC_MaxCurrentOut_phy "description" FLOAT32_IEEE cal_signal_objects_CM_single 0 0 0 4294967295 ECU_ADDRESS 0x00 DISPLAY_IDENTIFIER DCDC_MaxCurrentOut_phy /end MEASUREMENT
/begin MEASUREMENT cap_canApiMsg_DCDC_VCU_Req_Fbk_PT.DCDC_MaxCurrentOut_raw "description" FLOAT32_IEEE cal_signal_objects_CM_single 0 0 0 4294967295 ECU_ADDRESS 0x00 DISPLAY_IDENTIFIER DCDC_MaxCurrentOut_raw /end MEASUREMENT
/begin MEASUREMENT cap_canApiMsg_BundleEAFlexrayToCANFD20msNo1_PT.V_VEH_COG_phy "description" FLOAT32_IEEE cal_signal_objects_CM_single 0 0 0 4294967295 ECU_ADDRESS 0x00 DISPLAY_IDENTIFIER V_VEH_COG_phy /end MEASUREMENT
/begin MEASUREMENT cap_canApiMsg_BundleEAFlexrayToCANFD20msNo1_PT.V_VEH_COG_raw "description" FLOAT32_IEEE cal_signal_objects_CM_single 0 0 0 4294967295 ECU_ADDRESS 0x00 DISPLAY_IDENTIFIER V_VEH_COG_raw /end MEASUREMENT
/begin MEASUREMENT cap_canApiMsg_CombinedChargerUnit10msNo2_PT.PowerETractSys2LimGenMax_phy "description" FLOAT32_IEEE cal_signal_objects_CM_single 0 0 0 4294967295 ECU_ADDRESS 0x00 DISPLAY_IDENTIFIER PowerETractSys2LimGenMax_phy /end MEASUREMENT
/begin MEASUREMENT cap_canApiMsg_CombinedChargerUnit10msNo2_PT.PowerETractSys2LimGenMax_raw "description" FLOAT32_IEEE cal_signal_objects_CM_single 0 0 0 4294967295 ECU_ADDRESS 0x00 DISPLAY_IDENTIFIER PowerETractSys2LimGenMax_raw /end MEASUREMENT
/begin MEASUREMENT cap_canApiMsg_CombinedChargerUnit10msNo2_PT.PowerETractSys2LimMotMax_phy "description" FLOAT32_IEEE cal_signal_objects_CM_single 0 0 0 4294967295 ECU_ADDRESS 0x00 DISPLAY_IDENTIFIER PowerETractSys2LimMotMax_phy /end MEASUREMENT
/begin MEASUREMENT cap_canApiMsg_CombinedChargerUnit10msNo2_PT.PowerETractSys2LimMotMax_raw "description" FLOAT32_IEEE cal_signal_objects_CM_single 0 0 0 4294967295 ECU_ADDRESS 0x00 DISPLAY_IDENTIFIER PowerETractSys2LimMotMax_raw /end MEASUREMENT
/begin MEASUREMENT cap_canApiMsg_CombinedChargerUnit10msNo2_PT.PowerETractSys1LimGenMax_phy "description" FLOAT32_IEEE cal_signal_objects_CM_single 0 0 0 4294967295 ECU_ADDRESS 0x00 DISPLAY_IDENTIFIER PowerETractSys1LimGenMax_phy /end MEASUREMENT
/begin MEASUREMENT cap_canApiMsg_CombinedChargerUnit10msNo2_PT.PowerETractSys1LimGenMax_raw "description" FLOAT32_IEEE cal_signal_objects_CM_single 0 0 0 4294967295 ECU_ADDRESS 0x00 DISPLAY_IDENTIFIER PowerETractSys1LimGenMax_raw /end MEASUREMENT
/begin MEASUREMENT cap_canApiMsg_CombinedChargerUnit10msNo2_PT.PowerETractSys1LimMotMax_phy "description" FLOAT32_IEEE cal_signal_objects_CM_single 0 0 0 4294967295 ECU_ADDRESS 0x00 DISPLAY_IDENTIFIER PowerETractSys1LimMotMax_phy /end MEASUREMENT
/begin MEASUREMENT cap_canApiMsg_CombinedChargerUnit10msNo2_PT.PowerETractSys1LimMotMax_raw "description" FLOAT32_IEEE cal_signal_objects_CM_single 0 0 0 4294967295 ECU_ADDRESS 0x00 DISPLAY_IDENTIFIER PowerETractSys1LimMotMax_raw /end MEASUREMENT
/begin MEASUREMENT cap_canApiMsg_BundleEAFlexrayToAECANFD10msNo1_PT.AVL_BRTORQ_WHL_RS_LH_EXT_phy "description" FLOAT32_IEEE cal_signal_objects_CM_single 0 0 0 4294967295 ECU_ADDRESS 0x00 DISPLAY_IDENTIFIER AVL_BRTORQ_WHL_RS_LH_EXT_phy /end MEASUREMENT
/begin MEASUREMENT cap_canApiMsg_BundleEAFlexrayToAECANFD10msNo1_PT.AVL_BRTORQ_WHL_RS_LH_EXT_raw "description" FLOAT32_IEEE cal_signal_objects_CM_single 0 0 0 4294967295 ECU_ADDRESS 0x00 DISPLAY_IDENTIFIER AVL_BRTORQ_WHL_RS_LH_EXT_raw /end MEASUREMENT
/begin MEASUREMENT cap_canApiMsg_BundleEAFlexrayToAECANFD10msNo1_PT.AVL_BRTORQ_WHL_RS_RH_EXT_phy "description" FLOAT32_IEEE cal_signal_objects_CM_single 0 0 0 4294967295 ECU_ADDRESS 0x00 DISPLAY_IDENTIFIER AVL_BRTORQ_WHL_RS_RH_EXT_phy /end MEASUREMENT
/begin MEASUREMENT cap_canApiMsg_BundleEAFlexrayToAECANFD10msNo1_PT.AVL_BRTORQ_WHL_RS_RH_EXT_raw "description" FLOAT32_IEEE cal_signal_objects_CM_single 0 0 0 4294967295 ECU_ADDRESS 0x00 DISPLAY_IDENTIFIER AVL_BRTORQ_WHL_RS_RH_EXT_raw /end MEASUREMENT
/begin MEASUREMENT cap_canApiMsg_BundleEAFlexrayToAECANFD10msNo1_PT.AVL_BRTORQ_WHL_FS_LH_EXT_phy "description" FLOAT32_IEEE cal_signal_objects_CM_single 0 0 0 4294967295 ECU_ADDRESS 0x00 DISPLAY_IDENTIFIER AVL_BRTORQ_WHL_FS_LH_EXT_phy /end MEASUREMENT
/begin MEASUREMENT cap_canApiMsg_BundleEAFlexrayToAECANFD10msNo1_PT.AVL_BRTORQ_WHL_FS_LH_EXT_raw "description" FLOAT32_IEEE cal_signal_objects_CM_single 0 0 0 4294967295 ECU_ADDRESS 0x00 DISPLAY_IDENTIFIER AVL_BRTORQ_WHL_FS_LH_EXT_raw /end MEASUREMENT
/begin MEASUREMENT cap_canApiMsg_BundleEAFlexrayToAECANFD10msNo1_PT.AVL_BRTORQ_WHL_FS_RH_EXT_phy "description" FLOAT32_IEEE cal_signal_objects_CM_single 0 0 0 4294967295 ECU_ADDRESS 0x00 DISPLAY_IDENTIFIER AVL_BRTORQ_WHL_FS_RH_EXT_phy /end MEASUREMENT
/begin MEASUREMENT cap_canApiMsg_BundleEAFlexrayToAECANFD10msNo1_PT.AVL_BRTORQ_WHL_FS_RH_EXT_raw "description" FLOAT32_IEEE cal_signal_objects_CM_single 0 0 0 4294967295 ECU_ADDRESS 0x00 DISPLAY_IDENTIFIER AVL_BRTORQ_WHL_FS_RH_EXT_raw /end MEASUREMENT
/begin MEASUREMENT cap_canApiMsg_BundleEAFlexrayToAECANFD10msNo1_PT.TAR_RPM_MAX_BAX_phy "description" FLOAT32_IEEE cal_signal_objects_CM_single 0 0 0 4294967295 ECU_ADDRESS 0x00 DISPLAY_IDENTIFIER TAR_RPM_MAX_BAX_phy /end MEASUREMENT
/begin MEASUREMENT cap_canApiMsg_BundleEAFlexrayToAECANFD10msNo1_PT.TAR_RPM_MAX_BAX_raw "description" FLOAT32_IEEE cal_signal_objects_CM_single 0 0 0 4294967295 ECU_ADDRESS 0x00 DISPLAY_IDENTIFIER TAR_RPM_MAX_BAX_raw /end MEASUREMENT
/begin MEASUREMENT cap_canApiMsg_BundleEAFlexrayToAECANFD10msNo1_PT.TAR_RPM_MIN_BAX_phy "description" FLOAT32_IEEE cal_signal_objects_CM_single 0 0 0 4294967295 ECU_ADDRESS 0x00 DISPLAY_IDENTIFIER TAR_RPM_MIN_BAX_phy /end MEASUREMENT
/begin MEASUREMENT cap_canApiMsg_BundleEAFlexrayToAECANFD10msNo1_PT.TAR_RPM_MIN_BAX_raw "description" FLOAT32_IEEE cal_signal_objects_CM_single 0 0 0 4294967295 ECU_ADDRESS 0x00 DISPLAY_IDENTIFIER TAR_RPM_MIN_BAX_raw /end MEASUREMENT
/begin MEASUREMENT cap_canApiMsg_BundleEAFlexrayToAECANFD10msNo1_PT.TAR_RPM_MAX_FTAX_phy "description" FLOAT32_IEEE cal_signal_objects_CM_single 0 0 0 4294967295 ECU_ADDRESS 0x00 DISPLAY_IDENTIFIER TAR_RPM_MAX_FTAX_phy /end MEASUREMENT
/begin MEASUREMENT cap_canApiMsg_BundleEAFlexrayToAECANFD10msNo1_PT.TAR_RPM_MAX_FTAX_raw "description" FLOAT32_IEEE cal_signal_objects_CM_single 0 0 0 4294967295 ECU_ADDRESS 0x00 DISPLAY_IDENTIFIER TAR_RPM_MAX_FTAX_raw /end MEASUREMENT
/begin MEASUREMENT cap_canApiMsg_BundleEAFlexrayToAECANFD10msNo1_PT.TAR_RPM_MIN_FTAX_phy "description" FLOAT32_IEEE cal_signal_objects_CM_single 0 0 0 4294967295 ECU_ADDRESS 0x00 DISPLAY_IDENTIFIER TAR_RPM_MIN_FTAX_phy /end MEASUREMENT
/begin MEASUREMENT cap_canApiMsg_BundleEAFlexrayToAECANFD10msNo1_PT.TAR_RPM_MIN_FTAX_raw "description" FLOAT32_IEEE cal_signal_objects_CM_single 0 0 0 4294967295 ECU_ADDRESS 0x00 DISPLAY_IDENTIFIER TAR_RPM_MIN_FTAX_raw /end MEASUREMENT
/begin MEASUREMENT cap_canApiMsg_BundleEAFlexrayToAECANFD20msNo2_PT.ACLNX_COG_phy "description" FLOAT32_IEEE cal_signal_objects_CM_single 0 0 0 4294967295 ECU_ADDRESS 0x00 DISPLAY_IDENTIFIER ACLNX_COG_phy /end MEASUREMENT
/begin MEASUREMENT cap_canApiMsg_BundleEAFlexrayToAECANFD20msNo2_PT.ACLNX_COG_raw "description" FLOAT32_IEEE cal_signal_objects_CM_single 0 0 0 4294967295 ECU_ADDRESS 0x00 DISPLAY_IDENTIFIER ACLNX_COG_raw /end MEASUREMENT
/begin MEASUREMENT cap_canApiMsg_BundleEAFlexrayToAECANFD20msNo2_PT.ACLNY_COG_phy "description" FLOAT32_IEEE cal_signal_objects_CM_single 0 0 0 4294967295 ECU_ADDRESS 0x00 DISPLAY_IDENTIFIER ACLNY_COG_phy /end MEASUREMENT
/begin MEASUREMENT cap_canApiMsg_BundleEAFlexrayToAECANFD20msNo2_PT.ACLNY_COG_raw "description" FLOAT32_IEEE cal_signal_objects_CM_single 0 0 0 4294967295 ECU_ADDRESS 0x00 DISPLAY_IDENTIFIER ACLNY_COG_raw /end MEASUREMENT
/begin MEASUREMENT cap_canApiMsg_TracEMacElectc1Time100msNo1_PT.TETractSys1CoolantWaterInpActVal_phy "description" FLOAT32_IEEE cal_signal_objects_CM_single 0 0 0 4294967295 ECU_ADDRESS 0x00 DISPLAY_IDENTIFIER TETractSys1CoolantWaterInpActVal_phy /end MEASUREMENT
/begin MEASUREMENT cap_canApiMsg_TracEMacElectc1Time100msNo1_PT.TETractSys1CoolantWaterInpActVal_raw "description" FLOAT32_IEEE cal_signal_objects_CM_single 0 0 0 4294967295 ECU_ADDRESS 0x00 DISPLAY_IDENTIFIER TETractSys1CoolantWaterInpActVal_raw /end MEASUREMENT
/begin MEASUREMENT cap_canApiMsg_TracEMacElectc1Time100msNo1_PT.PowerETractSys1MaximumLossActive_phy "description" FLOAT32_IEEE cal_signal_objects_CM_single 0 0 0 4294967295 ECU_ADDRESS 0x00 DISPLAY_IDENTIFIER PowerETractSys1MaximumLossActive_phy /end MEASUREMENT
/begin MEASUREMENT cap_canApiMsg_TracEMacElectc1Time100msNo1_PT.PowerETractSys1MaximumLossActive_raw "description" FLOAT32_IEEE cal_signal_objects_CM_single 0 0 0 4294967295 ECU_ADDRESS 0x00 DISPLAY_IDENTIFIER PowerETractSys1MaximumLossActive_raw /end MEASUREMENT
/begin MEASUREMENT cap_canApiMsg_TracEMacElectc1Time100msNo1_PT.WhlRatElAxlEtractSys1ActVal_phy "description" FLOAT32_IEEE cal_signal_objects_CM_single 0 0 0 4294967295 ECU_ADDRESS 0x00 DISPLAY_IDENTIFIER WhlRatElAxlEtractSys1ActVal_phy /end MEASUREMENT
/begin MEASUREMENT cap_canApiMsg_TracEMacElectc1Time100msNo1_PT.WhlRatElAxlEtractSys1ActVal_raw "description" FLOAT32_IEEE cal_signal_objects_CM_single 0 0 0 4294967295 ECU_ADDRESS 0x00 DISPLAY_IDENTIFIER WhlRatElAxlEtractSys1ActVal_raw /end MEASUREMENT
/begin MEASUREMENT cap_canApiMsg_TracEMacElectc1Time100msNo1_PT.PercentUsedExtraBoostETractSys1_phy "description" FLOAT32_IEEE cal_signal_objects_CM_single 0 0 0 4294967295 ECU_ADDRESS 0x00 DISPLAY_IDENTIFIER PercentUsedExtraBoostETractSys1_phy /end MEASUREMENT
/begin MEASUREMENT cap_canApiMsg_TracEMacElectc1Time100msNo1_PT.PercentUsedExtraBoostETractSys1_raw "description" FLOAT32_IEEE cal_signal_objects_CM_single 0 0 0 4294967295 ECU_ADDRESS 0x00 DISPLAY_IDENTIFIER PercentUsedExtraBoostETractSys1_raw /end MEASUREMENT
/begin MEASUREMENT cap_canApiMsg_TracEMacElectc1Time100msNo1_PT.TETractSys1EmRotorActVal_phy "description" FLOAT32_IEEE cal_signal_objects_CM_single 0 0 0 4294967295 ECU_ADDRESS 0x00 DISPLAY_IDENTIFIER TETractSys1EmRotorActVal_phy /end MEASUREMENT
/begin MEASUREMENT cap_canApiMsg_TracEMacElectc1Time100msNo1_PT.TETractSys1EmRotorActVal_raw "description" FLOAT32_IEEE cal_signal_objects_CM_single 0 0 0 4294967295 ECU_ADDRESS 0x00 DISPLAY_IDENTIFIER TETractSys1EmRotorActVal_raw /end MEASUREMENT
/begin MEASUREMENT cap_canApiMsg_TracEMacElectc1Time100msNo1_PT.ThermalStressLevelETractSys1_phy "description" FLOAT32_IEEE cal_signal_objects_CM_single 0 0 0 4294967295 ECU_ADDRESS 0x00 DISPLAY_IDENTIFIER ThermalStressLevelETractSys1_phy /end MEASUREMENT
/begin MEASUREMENT cap_canApiMsg_TracEMacElectc1Time100msNo1_PT.ThermalStressLevelETractSys1_raw "description" FLOAT32_IEEE cal_signal_objects_CM_single 0 0 0 4294967295 ECU_ADDRESS 0x00 DISPLAY_IDENTIFIER ThermalStressLevelETractSys1_raw /end MEASUREMENT
/begin MEASUREMENT cap_canApiMsg_TracEMacElectc1Time100msNo1_PT.TETractSys1EmStatorActVal_phy "description" FLOAT32_IEEE cal_signal_objects_CM_single 0 0 0 4294967295 ECU_ADDRESS 0x00 DISPLAY_IDENTIFIER TETractSys1EmStatorActVal_phy /end MEASUREMENT
/begin MEASUREMENT cap_canApiMsg_TracEMacElectc1Time100msNo1_PT.TETractSys1EmStatorActVal_raw "description" FLOAT32_IEEE cal_signal_objects_CM_single 0 0 0 4294967295 ECU_ADDRESS 0x00 DISPLAY_IDENTIFIER TETractSys1EmStatorActVal_raw /end MEASUREMENT
/begin MEASUREMENT cap_canApiMsg_TracEMacElectc1Time100msNo1_PT.TETractSys1InverterActVal_phy "description" FLOAT32_IEEE cal_signal_objects_CM_single 0 0 0 4294967295 ECU_ADDRESS 0x00 DISPLAY_IDENTIFIER TETractSys1InverterActVal_phy /end MEASUREMENT
/begin MEASUREMENT cap_canApiMsg_TracEMacElectc1Time100msNo1_PT.TETractSys1InverterActVal_raw "description" FLOAT32_IEEE cal_signal_objects_CM_single 0 0 0 4294967295 ECU_ADDRESS 0x00 DISPLAY_IDENTIFIER TETractSys1InverterActVal_raw /end MEASUREMENT
/begin MEASUREMENT cap_canApiMsg_TracEMacElectc1Time100msNo1_PT.TETractSys1GbxOilActVal_phy "description" FLOAT32_IEEE cal_signal_objects_CM_single 0 0 0 4294967295 ECU_ADDRESS 0x00 DISPLAY_IDENTIFIER TETractSys1GbxOilActVal_phy /end MEASUREMENT
/begin MEASUREMENT cap_canApiMsg_TracEMacElectc1Time100msNo1_PT.TETractSys1GbxOilActVal_raw "description" FLOAT32_IEEE cal_signal_objects_CM_single 0 0 0 4294967295 ECU_ADDRESS 0x00 DISPLAY_IDENTIFIER TETractSys1GbxOilActVal_raw /end MEASUREMENT
/begin MEASUREMENT cap_canApiMsg_TracEMacElectc2Time100msNo1_PT.TETractSys2CoolantWaterInpActVal_phy "description" FLOAT32_IEEE cal_signal_objects_CM_single 0 0 0 4294967295 ECU_ADDRESS 0x00 DISPLAY_IDENTIFIER TETractSys2CoolantWaterInpActVal_phy /end MEASUREMENT
/begin MEASUREMENT cap_canApiMsg_TracEMacElectc2Time100msNo1_PT.TETractSys2CoolantWaterInpActVal_raw "description" FLOAT32_IEEE cal_signal_objects_CM_single 0 0 0 4294967295 ECU_ADDRESS 0x00 DISPLAY_IDENTIFIER TETractSys2CoolantWaterInpActVal_raw /end MEASUREMENT
/begin MEASUREMENT cap_canApiMsg_TracEMacElectc2Time100msNo1_PT.PowerETractSys2MaximumLossActive_phy "description" FLOAT32_IEEE cal_signal_objects_CM_single 0 0 0 4294967295 ECU_ADDRESS 0x00 DISPLAY_IDENTIFIER PowerETractSys2MaximumLossActive_phy /end MEASUREMENT
/begin MEASUREMENT cap_canApiMsg_TracEMacElectc2Time100msNo1_PT.PowerETractSys2MaximumLossActive_raw "description" FLOAT32_IEEE cal_signal_objects_CM_single 0 0 0 4294967295 ECU_ADDRESS 0x00 DISPLAY_IDENTIFIER PowerETractSys2MaximumLossActive_raw /end MEASUREMENT
/begin MEASUREMENT cap_canApiMsg_TracEMacElectc2Time100msNo1_PT.WhlRatElAxlEtractSys2ActVal_phy "description" FLOAT32_IEEE cal_signal_objects_CM_single 0 0 0 4294967295 ECU_ADDRESS 0x00 DISPLAY_IDENTIFIER WhlRatElAxlEtractSys2ActVal_phy /end MEASUREMENT
/begin MEASUREMENT cap_canApiMsg_TracEMacElectc2Time100msNo1_PT.WhlRatElAxlEtractSys2ActVal_raw "description" FLOAT32_IEEE cal_signal_objects_CM_single 0 0 0 4294967295 ECU_ADDRESS 0x00 DISPLAY_IDENTIFIER WhlRatElAxlEtractSys2ActVal_raw /end MEASUREMENT
/begin MEASUREMENT cap_canApiMsg_TracEMacElectc2Time100msNo1_PT.PercentUsedExtraBoostETractSys2_phy "description" FLOAT32_IEEE cal_signal_objects_CM_single 0 0 0 4294967295 ECU_ADDRESS 0x00 DISPLAY_IDENTIFIER PercentUsedExtraBoostETractSys2_phy /end MEASUREMENT
/begin MEASUREMENT cap_canApiMsg_TracEMacElectc2Time100msNo1_PT.PercentUsedExtraBoostETractSys2_raw "description" FLOAT32_IEEE cal_signal_objects_CM_single 0 0 0 4294967295 ECU_ADDRESS 0x00 DISPLAY_IDENTIFIER PercentUsedExtraBoostETractSys2_raw /end MEASUREMENT
/begin MEASUREMENT cap_canApiMsg_TracEMacElectc2Time100msNo1_PT.TETractSys2EmRotorActVal_phy "description" FLOAT32_IEEE cal_signal_objects_CM_single 0 0 0 4294967295 ECU_ADDRESS 0x00 DISPLAY_IDENTIFIER TETractSys2EmRotorActVal_phy /end MEASUREMENT
/begin MEASUREMENT cap_canApiMsg_TracEMacElectc2Time100msNo1_PT.TETractSys2EmRotorActVal_raw "description" FLOAT32_IEEE cal_signal_objects_CM_single 0 0 0 4294967295 ECU_ADDRESS 0x00 DISPLAY_IDENTIFIER TETractSys2EmRotorActVal_raw /end MEASUREMENT
/begin MEASUREMENT cap_canApiMsg_TracEMacElectc2Time100msNo1_PT.ThermalStressLevelETractSys2_phy "description" FLOAT32_IEEE cal_signal_objects_CM_single 0 0 0 4294967295 ECU_ADDRESS 0x00 DISPLAY_IDENTIFIER ThermalStressLevelETractSys2_phy /end MEASUREMENT
/begin MEASUREMENT cap_canApiMsg_TracEMacElectc2Time100msNo1_PT.ThermalStressLevelETractSys2_raw "description" FLOAT32_IEEE cal_signal_objects_CM_single 0 0 0 4294967295 ECU_ADDRESS 0x00 DISPLAY_IDENTIFIER ThermalStressLevelETractSys2_raw /end MEASUREMENT
/begin MEASUREMENT cap_canApiMsg_TracEMacElectc2Time100msNo1_PT.TETractSys2EmStatorActVal_phy "description" FLOAT32_IEEE cal_signal_objects_CM_single 0 0 0 4294967295 ECU_ADDRESS 0x00 DISPLAY_IDENTIFIER TETractSys2EmStatorActVal_phy /end MEASUREMENT
/begin MEASUREMENT cap_canApiMsg_TracEMacElectc2Time100msNo1_PT.TETractSys2EmStatorActVal_raw "description" FLOAT32_IEEE cal_signal_objects_CM_single 0 0 0 4294967295 ECU_ADDRESS 0x00 DISPLAY_IDENTIFIER TETractSys2EmStatorActVal_raw /end MEASUREMENT
/begin MEASUREMENT cap_canApiMsg_TracEMacElectc2Time100msNo1_PT.TETractSys2InverterActVal_phy "description" FLOAT32_IEEE cal_signal_objects_CM_single 0 0 0 4294967295 ECU_ADDRESS 0x00 DISPLAY_IDENTIFIER TETractSys2InverterActVal_phy /end MEASUREMENT
/begin MEASUREMENT cap_canApiMsg_TracEMacElectc2Time100msNo1_PT.TETractSys2InverterActVal_raw "description" FLOAT32_IEEE cal_signal_objects_CM_single 0 0 0 4294967295 ECU_ADDRESS 0x00 DISPLAY_IDENTIFIER TETractSys2InverterActVal_raw /end MEASUREMENT
/begin MEASUREMENT cap_canApiMsg_TracEMacElectc2Time100msNo1_PT.TETractSys2GbxOilActVal_phy "description" FLOAT32_IEEE cal_signal_objects_CM_single 0 0 0 4294967295 ECU_ADDRESS 0x00 DISPLAY_IDENTIFIER TETractSys2GbxOilActVal_phy /end MEASUREMENT
/begin MEASUREMENT cap_canApiMsg_TracEMacElectc2Time100msNo1_PT.TETractSys2GbxOilActVal_raw "description" FLOAT32_IEEE cal_signal_objects_CM_single 0 0 0 4294967295 ECU_ADDRESS 0x00 DISPLAY_IDENTIFIER TETractSys2GbxOilActVal_raw /end MEASUREMENT
/begin MEASUREMENT cap_canApiMsg_BMS_CellTemp_PT.BMS_MinCellTemp_phy "description" FLOAT32_IEEE cal_signal_objects_CM_single 0 0 0 4294967295 ECU_ADDRESS 0x00 DISPLAY_IDENTIFIER BMS_MinCellTemp_phy /end MEASUREMENT
/begin MEASUREMENT cap_canApiMsg_BMS_CellTemp_PT.BMS_MinCellTemp_raw "description" FLOAT32_IEEE cal_signal_objects_CM_single 0 0 0 4294967295 ECU_ADDRESS 0x00 DISPLAY_IDENTIFIER BMS_MinCellTemp_raw /end MEASUREMENT
/begin MEASUREMENT cap_canApiMsg_BMS_CellTemp_PT.BMS_PackTemp_phy "description" FLOAT32_IEEE cal_signal_objects_CM_single 0 0 0 4294967295 ECU_ADDRESS 0x00 DISPLAY_IDENTIFIER BMS_PackTemp_phy /end MEASUREMENT
/begin MEASUREMENT cap_canApiMsg_BMS_CellTemp_PT.BMS_PackTemp_raw "description" FLOAT32_IEEE cal_signal_objects_CM_single 0 0 0 4294967295 ECU_ADDRESS 0x00 DISPLAY_IDENTIFIER BMS_PackTemp_raw /end MEASUREMENT
/begin MEASUREMENT cap_canApiMsg_BMS_CellTemp_PT.BMS_MaxCellTemp_phy "description" FLOAT32_IEEE cal_signal_objects_CM_single 0 0 0 4294967295 ECU_ADDRESS 0x00 DISPLAY_IDENTIFIER BMS_MaxCellTemp_phy /end MEASUREMENT
/begin MEASUREMENT cap_canApiMsg_BMS_CellTemp_PT.BMS_MaxCellTemp_raw "description" FLOAT32_IEEE cal_signal_objects_CM_single 0 0 0 4294967295 ECU_ADDRESS 0x00 DISPLAY_IDENTIFIER BMS_MaxCellTemp_raw /end MEASUREMENT
/begin MEASUREMENT cap_canApiMsg_BMS_CellTemp_PT.BMS_MaxMinDiffCellTemp_phy "description" FLOAT32_IEEE cal_signal_objects_CM_single 0 0 0 4294967295 ECU_ADDRESS 0x00 DISPLAY_IDENTIFIER BMS_MaxMinDiffCellTemp_phy /end MEASUREMENT
/begin MEASUREMENT cap_canApiMsg_BMS_CellTemp_PT.BMS_MaxMinDiffCellTemp_raw "description" FLOAT32_IEEE cal_signal_objects_CM_single 0 0 0 4294967295 ECU_ADDRESS 0x00 DISPLAY_IDENTIFIER BMS_MaxMinDiffCellTemp_raw /end MEASUREMENT
/begin MEASUREMENT cap_canApiMsg_BMS_CellTempMeas_PT.BMS_CellTemp1_phy "description" FLOAT32_IEEE cal_signal_objects_CM_single 0 0 0 4294967295 ECU_ADDRESS 0x00 DISPLAY_IDENTIFIER BMS_CellTemp1_phy /end MEASUREMENT
/begin MEASUREMENT cap_canApiMsg_BMS_CellTempMeas_PT.BMS_CellTemp1_raw "description" FLOAT32_IEEE cal_signal_objects_CM_single 0 0 0 4294967295 ECU_ADDRESS 0x00 DISPLAY_IDENTIFIER BMS_CellTemp1_raw /end MEASUREMENT
/begin MEASUREMENT cap_canApiMsg_BMS_CellTempMeas_PT.BMS_CellTemp2_phy "description" FLOAT32_IEEE cal_signal_objects_CM_single 0 0 0 4294967295 ECU_ADDRESS 0x00 DISPLAY_IDENTIFIER BMS_CellTemp2_phy /end MEASUREMENT
/begin MEASUREMENT cap_canApiMsg_BMS_CellTempMeas_PT.BMS_CellTemp2_raw "description" FLOAT32_IEEE cal_signal_objects_CM_single 0 0 0 4294967295 ECU_ADDRESS 0x00 DISPLAY_IDENTIFIER BMS_CellTemp2_raw /end MEASUREMENT
/begin MEASUREMENT cap_canApiMsg_BMS_CellTempMeas_PT.BMS_CellTemp3_phy "description" FLOAT32_IEEE cal_signal_objects_CM_single 0 0 0 4294967295 ECU_ADDRESS 0x00 DISPLAY_IDENTIFIER BMS_CellTemp3_phy /end MEASUREMENT
/begin MEASUREMENT cap_canApiMsg_BMS_CellTempMeas_PT.BMS_CellTemp3_raw "description" FLOAT32_IEEE cal_signal_objects_CM_single 0 0 0 4294967295 ECU_ADDRESS 0x00 DISPLAY_IDENTIFIER BMS_CellTemp3_raw /end MEASUREMENT
/begin MEASUREMENT cap_canApiMsg_BMS_CellTempMeas_PT.BMS_CellTemp4_phy "description" FLOAT32_IEEE cal_signal_objects_CM_single 0 0 0 4294967295 ECU_ADDRESS 0x00 DISPLAY_IDENTIFIER BMS_CellTemp4_phy /end MEASUREMENT
/begin MEASUREMENT cap_canApiMsg_BMS_CellTempMeas_PT.BMS_CellTemp4_raw "description" FLOAT32_IEEE cal_signal_objects_CM_single 0 0 0 4294967295 ECU_ADDRESS 0x00 DISPLAY_IDENTIFIER BMS_CellTemp4_raw /end MEASUREMENT
/begin MEASUREMENT cap_canApiMsg_BMS_CellTempMeas_PT.BMS_CellTemp5_phy "description" FLOAT32_IEEE cal_signal_objects_CM_single 0 0 0 4294967295 ECU_ADDRESS 0x00 DISPLAY_IDENTIFIER BMS_CellTemp5_phy /end MEASUREMENT
/begin MEASUREMENT cap_canApiMsg_BMS_CellTempMeas_PT.BMS_CellTemp5_raw "description" FLOAT32_IEEE cal_signal_objects_CM_single 0 0 0 4294967295 ECU_ADDRESS 0x00 DISPLAY_IDENTIFIER BMS_CellTemp5_raw /end MEASUREMENT
/begin MEASUREMENT cap_canApiMsg_BMS_CellTempMeas_PT.BMS_CellTemp6_phy "description" FLOAT32_IEEE cal_signal_objects_CM_single 0 0 0 4294967295 ECU_ADDRESS 0x00 DISPLAY_IDENTIFIER BMS_CellTemp6_phy /end MEASUREMENT
/begin MEASUREMENT cap_canApiMsg_BMS_CellTempMeas_PT.BMS_CellTemp6_raw "description" FLOAT32_IEEE cal_signal_objects_CM_single 0 0 0 4294967295 ECU_ADDRESS 0x00 DISPLAY_IDENTIFIER BMS_CellTemp6_raw /end MEASUREMENT
/begin MEASUREMENT cap_canApiMsg_BMS_CellTempMeas_PT.BMS_CellTemp7_phy "description" FLOAT32_IEEE cal_signal_objects_CM_single 0 0 0 4294967295 ECU_ADDRESS 0x00 DISPLAY_IDENTIFIER BMS_CellTemp7_phy /end MEASUREMENT
/begin MEASUREMENT cap_canApiMsg_BMS_CellTempMeas_PT.BMS_CellTemp7_raw "description" FLOAT32_IEEE cal_signal_objects_CM_single 0 0 0 4294967295 ECU_ADDRESS 0x00 DISPLAY_IDENTIFIER BMS_CellTemp7_raw /end MEASUREMENT
/begin MEASUREMENT cap_canApiMsg_BMS_CellTempMeas_PT.BMS_CellTemp8_phy "description" FLOAT32_IEEE cal_signal_objects_CM_single 0 0 0 4294967295 ECU_ADDRESS 0x00 DISPLAY_IDENTIFIER BMS_CellTemp8_phy /end MEASUREMENT
/begin MEASUREMENT cap_canApiMsg_BMS_CellTempMeas_PT.BMS_CellTemp8_raw "description" FLOAT32_IEEE cal_signal_objects_CM_single 0 0 0 4294967295 ECU_ADDRESS 0x00 DISPLAY_IDENTIFIER BMS_CellTemp8_raw /end MEASUREMENT
/begin MEASUREMENT cap_canApiMsg_BMS_CellTempMeas_PT.BMS_CellTemp9_phy "description" FLOAT32_IEEE cal_signal_objects_CM_single 0 0 0 4294967295 ECU_ADDRESS 0x00 DISPLAY_IDENTIFIER BMS_CellTemp9_phy /end MEASUREMENT
/begin MEASUREMENT cap_canApiMsg_BMS_CellTempMeas_PT.BMS_CellTemp9_raw "description" FLOAT32_IEEE cal_signal_objects_CM_single 0 0 0 4294967295 ECU_ADDRESS 0x00 DISPLAY_IDENTIFIER BMS_CellTemp9_raw /end MEASUREMENT
/begin MEASUREMENT cap_canApiMsg_BMS_CellTempMeas_PT.BMS_CellTemp10_phy "description" FLOAT32_IEEE cal_signal_objects_CM_single 0 0 0 4294967295 ECU_ADDRESS 0x00 DISPLAY_IDENTIFIER BMS_CellTemp10_phy /end MEASUREMENT
/begin MEASUREMENT cap_canApiMsg_BMS_CellTempMeas_PT.BMS_CellTemp10_raw "description" FLOAT32_IEEE cal_signal_objects_CM_single 0 0 0 4294967295 ECU_ADDRESS 0x00 DISPLAY_IDENTIFIER BMS_CellTemp10_raw /end MEASUREMENT
/begin MEASUREMENT cap_canApiMsg_BMS_CellTempMeas_PT.BMS_CellTemp11_phy "description" FLOAT32_IEEE cal_signal_objects_CM_single 0 0 0 4294967295 ECU_ADDRESS 0x00 DISPLAY_IDENTIFIER BMS_CellTemp11_phy /end MEASUREMENT
/begin MEASUREMENT cap_canApiMsg_BMS_CellTempMeas_PT.BMS_CellTemp11_raw "description" FLOAT32_IEEE cal_signal_objects_CM_single 0 0 0 4294967295 ECU_ADDRESS 0x00 DISPLAY_IDENTIFIER BMS_CellTemp11_raw /end MEASUREMENT
/begin MEASUREMENT cap_canApiMsg_BMS_CellTempMeas_PT.BMS_CellTemp12_phy "description" FLOAT32_IEEE cal_signal_objects_CM_single 0 0 0 4294967295 ECU_ADDRESS 0x00 DISPLAY_IDENTIFIER BMS_CellTemp12_phy /end MEASUREMENT
/begin MEASUREMENT cap_canApiMsg_BMS_CellTempMeas_PT.BMS_CellTemp12_raw "description" FLOAT32_IEEE cal_signal_objects_CM_single 0 0 0 4294967295 ECU_ADDRESS 0x00 DISPLAY_IDENTIFIER BMS_CellTemp12_raw /end MEASUREMENT
/begin MEASUREMENT cap_canApiMsg_BMS_CellTempMeas_PT.BMS_CellTemp13_phy "description" FLOAT32_IEEE cal_signal_objects_CM_single 0 0 0 4294967295 ECU_ADDRESS 0x00 DISPLAY_IDENTIFIER BMS_CellTemp13_phy /end MEASUREMENT
/begin MEASUREMENT cap_canApiMsg_BMS_CellTempMeas_PT.BMS_CellTemp13_raw "description" FLOAT32_IEEE cal_signal_objects_CM_single 0 0 0 4294967295 ECU_ADDRESS 0x00 DISPLAY_IDENTIFIER BMS_CellTemp13_raw /end MEASUREMENT
/begin MEASUREMENT cap_canApiMsg_BMS_CellTempMeas_PT.BMS_CellTemp14_phy "description" FLOAT32_IEEE cal_signal_objects_CM_single 0 0 0 4294967295 ECU_ADDRESS 0x00 DISPLAY_IDENTIFIER BMS_CellTemp14_phy /end MEASUREMENT
/begin MEASUREMENT cap_canApiMsg_BMS_CellTempMeas_PT.BMS_CellTemp14_raw "description" FLOAT32_IEEE cal_signal_objects_CM_single 0 0 0 4294967295 ECU_ADDRESS 0x00 DISPLAY_IDENTIFIER BMS_CellTemp14_raw /end MEASUREMENT
/begin MEASUREMENT cap_canApiMsg_BMS_CellTempMeas_PT.BMS_CellTemp15_phy "description" FLOAT32_IEEE cal_signal_objects_CM_single 0 0 0 4294967295 ECU_ADDRESS 0x00 DISPLAY_IDENTIFIER BMS_CellTemp15_phy /end MEASUREMENT
/begin MEASUREMENT cap_canApiMsg_BMS_CellTempMeas_PT.BMS_CellTemp15_raw "description" FLOAT32_IEEE cal_signal_objects_CM_single 0 0 0 4294967295 ECU_ADDRESS 0x00 DISPLAY_IDENTIFIER BMS_CellTemp15_raw /end MEASUREMENT
/begin MEASUREMENT cap_canApiMsg_BMS_CellTempMeas_PT.BMS_CellTemp16_phy "description" FLOAT32_IEEE cal_signal_objects_CM_single 0 0 0 4294967295 ECU_ADDRESS 0x00 DISPLAY_IDENTIFIER BMS_CellTemp16_phy /end MEASUREMENT
/begin MEASUREMENT cap_canApiMsg_BMS_CellTempMeas_PT.BMS_CellTemp16_raw "description" FLOAT32_IEEE cal_signal_objects_CM_single 0 0 0 4294967295 ECU_ADDRESS 0x00 DISPLAY_IDENTIFIER BMS_CellTemp16_raw /end MEASUREMENT
/begin MEASUREMENT cap_canApiMsg_BMS_CellTempMeas_PT.BMS_CellTemp17_phy "description" FLOAT32_IEEE cal_signal_objects_CM_single 0 0 0 4294967295 ECU_ADDRESS 0x00 DISPLAY_IDENTIFIER BMS_CellTemp17_phy /end MEASUREMENT
/begin MEASUREMENT cap_canApiMsg_BMS_CellTempMeas_PT.BMS_CellTemp17_raw "description" FLOAT32_IEEE cal_signal_objects_CM_single 0 0 0 4294967295 ECU_ADDRESS 0x00 DISPLAY_IDENTIFIER BMS_CellTemp17_raw /end MEASUREMENT
/begin MEASUREMENT cap_canApiMsg_BMS_CellTempMeas_PT.BMS_CellTemp18_phy "description" FLOAT32_IEEE cal_signal_objects_CM_single 0 0 0 4294967295 ECU_ADDRESS 0x00 DISPLAY_IDENTIFIER BMS_CellTemp18_phy /end MEASUREMENT
/begin MEASUREMENT cap_canApiMsg_BMS_CellTempMeas_PT.BMS_CellTemp18_raw "description" FLOAT32_IEEE cal_signal_objects_CM_single 0 0 0 4294967295 ECU_ADDRESS 0x00 DISPLAY_IDENTIFIER BMS_CellTemp18_raw /end MEASUREMENT
/begin MEASUREMENT cap_canApiMsg_BMS_CellTempMeas_PT.BMS_CellTemp19_phy "description" FLOAT32_IEEE cal_signal_objects_CM_single 0 0 0 4294967295 ECU_ADDRESS 0x00 DISPLAY_IDENTIFIER BMS_CellTemp19_phy /end MEASUREMENT
/begin MEASUREMENT cap_canApiMsg_BMS_CellTempMeas_PT.BMS_CellTemp19_raw "description" FLOAT32_IEEE cal_signal_objects_CM_single 0 0 0 4294967295 ECU_ADDRESS 0x00 DISPLAY_IDENTIFIER BMS_CellTemp19_raw /end MEASUREMENT
/begin MEASUREMENT cap_canApiMsg_BMS_CellTempMeas_PT.BMS_CellTemp20_phy "description" FLOAT32_IEEE cal_signal_objects_CM_single 0 0 0 4294967295 ECU_ADDRESS 0x00 DISPLAY_IDENTIFIER BMS_CellTemp20_phy /end MEASUREMENT
/begin MEASUREMENT cap_canApiMsg_BMS_CellTempMeas_PT.BMS_CellTemp20_raw "description" FLOAT32_IEEE cal_signal_objects_CM_single 0 0 0 4294967295 ECU_ADDRESS 0x00 DISPLAY_IDENTIFIER BMS_CellTemp20_raw /end MEASUREMENT
/begin MEASUREMENT cap_canApiMsg_BMS_CellTempMeas_PT.BMS_CellTemp21_phy "description" FLOAT32_IEEE cal_signal_objects_CM_single 0 0 0 4294967295 ECU_ADDRESS 0x00 DISPLAY_IDENTIFIER BMS_CellTemp21_phy /end MEASUREMENT
/begin MEASUREMENT cap_canApiMsg_BMS_CellTempMeas_PT.BMS_CellTemp21_raw "description" FLOAT32_IEEE cal_signal_objects_CM_single 0 0 0 4294967295 ECU_ADDRESS 0x00 DISPLAY_IDENTIFIER BMS_CellTemp21_raw /end MEASUREMENT
/begin MEASUREMENT cap_canApiMsg_BMS_CellTempMeas_PT.BMS_CellTemp22_phy "description" FLOAT32_IEEE cal_signal_objects_CM_single 0 0 0 4294967295 ECU_ADDRESS 0x00 DISPLAY_IDENTIFIER BMS_CellTemp22_phy /end MEASUREMENT
/begin MEASUREMENT cap_canApiMsg_BMS_CellTempMeas_PT.BMS_CellTemp22_raw "description" FLOAT32_IEEE cal_signal_objects_CM_single 0 0 0 4294967295 ECU_ADDRESS 0x00 DISPLAY_IDENTIFIER BMS_CellTemp22_raw /end MEASUREMENT
/begin MEASUREMENT cap_canApiMsg_BMS_CellTempMeas_PT.BMS_CellTemp23_phy "description" FLOAT32_IEEE cal_signal_objects_CM_single 0 0 0 4294967295 ECU_ADDRESS 0x00 DISPLAY_IDENTIFIER BMS_CellTemp23_phy /end MEASUREMENT
/begin MEASUREMENT cap_canApiMsg_BMS_CellTempMeas_PT.BMS_CellTemp23_raw "description" FLOAT32_IEEE cal_signal_objects_CM_single 0 0 0 4294967295 ECU_ADDRESS 0x00 DISPLAY_IDENTIFIER BMS_CellTemp23_raw /end MEASUREMENT
/begin MEASUREMENT cap_canApiMsg_BMS_CellTempMeas_PT.BMS_CellTemp24_phy "description" FLOAT32_IEEE cal_signal_objects_CM_single 0 0 0 4294967295 ECU_ADDRESS 0x00 DISPLAY_IDENTIFIER BMS_CellTemp24_phy /end MEASUREMENT
/begin MEASUREMENT cap_canApiMsg_BMS_CellTempMeas_PT.BMS_CellTemp24_raw "description" FLOAT32_IEEE cal_signal_objects_CM_single 0 0 0 4294967295 ECU_ADDRESS 0x00 DISPLAY_IDENTIFIER BMS_CellTemp24_raw /end MEASUREMENT
/begin MEASUREMENT cap_canApiMsg_BMS_CellTempMeas_PT.BMS_CellTemp25_phy "description" FLOAT32_IEEE cal_signal_objects_CM_single 0 0 0 4294967295 ECU_ADDRESS 0x00 DISPLAY_IDENTIFIER BMS_CellTemp25_phy /end MEASUREMENT
/begin MEASUREMENT cap_canApiMsg_BMS_CellTempMeas_PT.BMS_CellTemp25_raw "description" FLOAT32_IEEE cal_signal_objects_CM_single 0 0 0 4294967295 ECU_ADDRESS 0x00 DISPLAY_IDENTIFIER BMS_CellTemp25_raw /end MEASUREMENT
/begin MEASUREMENT cap_canApiMsg_BMS_CellTempMeas_PT.BMS_CellTemp26_phy "description" FLOAT32_IEEE cal_signal_objects_CM_single 0 0 0 4294967295 ECU_ADDRESS 0x00 DISPLAY_IDENTIFIER BMS_CellTemp26_phy /end MEASUREMENT
/begin MEASUREMENT cap_canApiMsg_BMS_CellTempMeas_PT.BMS_CellTemp26_raw "description" FLOAT32_IEEE cal_signal_objects_CM_single 0 0 0 4294967295 ECU_ADDRESS 0x00 DISPLAY_IDENTIFIER BMS_CellTemp26_raw /end MEASUREMENT
/begin MEASUREMENT cap_canApiMsg_BMS_CellTempMeas_PT.BMS_CellTemp27_phy "description" FLOAT32_IEEE cal_signal_objects_CM_single 0 0 0 4294967295 ECU_ADDRESS 0x00 DISPLAY_IDENTIFIER BMS_CellTemp27_phy /end MEASUREMENT
/begin MEASUREMENT cap_canApiMsg_BMS_CellTempMeas_PT.BMS_CellTemp27_raw "description" FLOAT32_IEEE cal_signal_objects_CM_single 0 0 0 4294967295 ECU_ADDRESS 0x00 DISPLAY_IDENTIFIER BMS_CellTemp27_raw /end MEASUREMENT
/begin MEASUREMENT cap_canApiMsg_BMS_CellTempMeas_PT.BMS_CellTemp28_phy "description" FLOAT32_IEEE cal_signal_objects_CM_single 0 0 0 4294967295 ECU_ADDRESS 0x00 DISPLAY_IDENTIFIER BMS_CellTemp28_phy /end MEASUREMENT
/begin MEASUREMENT cap_canApiMsg_BMS_CellTempMeas_PT.BMS_CellTemp28_raw "description" FLOAT32_IEEE cal_signal_objects_CM_single 0 0 0 4294967295 ECU_ADDRESS 0x00 DISPLAY_IDENTIFIER BMS_CellTemp28_raw /end MEASUREMENT
/begin MEASUREMENT cap_canApiMsg_BMS_CellTempMeas_PT.BMS_CellTemp29_phy "description" FLOAT32_IEEE cal_signal_objects_CM_single 0 0 0 4294967295 ECU_ADDRESS 0x00 DISPLAY_IDENTIFIER BMS_CellTemp29_phy /end MEASUREMENT
/begin MEASUREMENT cap_canApiMsg_BMS_CellTempMeas_PT.BMS_CellTemp29_raw "description" FLOAT32_IEEE cal_signal_objects_CM_single 0 0 0 4294967295 ECU_ADDRESS 0x00 DISPLAY_IDENTIFIER BMS_CellTemp29_raw /end MEASUREMENT
/begin MEASUREMENT cap_canApiMsg_BMS_CellTempMeas_PT.BMS_CellTemp30_phy "description" FLOAT32_IEEE cal_signal_objects_CM_single 0 0 0 4294967295 ECU_ADDRESS 0x00 DISPLAY_IDENTIFIER BMS_CellTemp30_phy /end MEASUREMENT
/begin MEASUREMENT cap_canApiMsg_BMS_CellTempMeas_PT.BMS_CellTemp30_raw "description" FLOAT32_IEEE cal_signal_objects_CM_single 0 0 0 4294967295 ECU_ADDRESS 0x00 DISPLAY_IDENTIFIER BMS_CellTemp30_raw /end MEASUREMENT
/begin MEASUREMENT cap_canApiMsg_BMS_CellTempMeas_PT.BMS_CellTemp31_phy "description" FLOAT32_IEEE cal_signal_objects_CM_single 0 0 0 4294967295 ECU_ADDRESS 0x00 DISPLAY_IDENTIFIER BMS_CellTemp31_phy /end MEASUREMENT
/begin MEASUREMENT cap_canApiMsg_BMS_CellTempMeas_PT.BMS_CellTemp31_raw "description" FLOAT32_IEEE cal_signal_objects_CM_single 0 0 0 4294967295 ECU_ADDRESS 0x00 DISPLAY_IDENTIFIER BMS_CellTemp31_raw /end MEASUREMENT
/begin MEASUREMENT cap_canApiMsg_BMS_CellTempMeas_PT.BMS_CellTemp32_phy "description" FLOAT32_IEEE cal_signal_objects_CM_single 0 0 0 4294967295 ECU_ADDRESS 0x00 DISPLAY_IDENTIFIER BMS_CellTemp32_phy /end MEASUREMENT
/begin MEASUREMENT cap_canApiMsg_BMS_CellTempMeas_PT.BMS_CellTemp32_raw "description" FLOAT32_IEEE cal_signal_objects_CM_single 0 0 0 4294967295 ECU_ADDRESS 0x00 DISPLAY_IDENTIFIER BMS_CellTemp32_raw /end MEASUREMENT
/begin MEASUREMENT cap_canApiMsg_BMS_CellTempMeas_PT.BMS_CellTemp33_phy "description" FLOAT32_IEEE cal_signal_objects_CM_single 0 0 0 4294967295 ECU_ADDRESS 0x00 DISPLAY_IDENTIFIER BMS_CellTemp33_phy /end MEASUREMENT
/begin MEASUREMENT cap_canApiMsg_BMS_CellTempMeas_PT.BMS_CellTemp33_raw "description" FLOAT32_IEEE cal_signal_objects_CM_single 0 0 0 4294967295 ECU_ADDRESS 0x00 DISPLAY_IDENTIFIER BMS_CellTemp33_raw /end MEASUREMENT
/begin MEASUREMENT cap_canApiMsg_BMS_CellTempMeas_PT.BMS_CellTemp34_phy "description" FLOAT32_IEEE cal_signal_objects_CM_single 0 0 0 4294967295 ECU_ADDRESS 0x00 DISPLAY_IDENTIFIER BMS_CellTemp34_phy /end MEASUREMENT
/begin MEASUREMENT cap_canApiMsg_BMS_CellTempMeas_PT.BMS_CellTemp34_raw "description" FLOAT32_IEEE cal_signal_objects_CM_single 0 0 0 4294967295 ECU_ADDRESS 0x00 DISPLAY_IDENTIFIER BMS_CellTemp34_raw /end MEASUREMENT
/begin MEASUREMENT cap_canApiMsg_BMS_CellTempMeas_PT.BMS_CellTemp35_phy "description" FLOAT32_IEEE cal_signal_objects_CM_single 0 0 0 4294967295 ECU_ADDRESS 0x00 DISPLAY_IDENTIFIER BMS_CellTemp35_phy /end MEASUREMENT
/begin MEASUREMENT cap_canApiMsg_BMS_CellTempMeas_PT.BMS_CellTemp35_raw "description" FLOAT32_IEEE cal_signal_objects_CM_single 0 0 0 4294967295 ECU_ADDRESS 0x00 DISPLAY_IDENTIFIER BMS_CellTemp35_raw /end MEASUREMENT
/begin MEASUREMENT cap_canApiMsg_BMS_CellTempMeas_PT.BMS_CellTemp36_phy "description" FLOAT32_IEEE cal_signal_objects_CM_single 0 0 0 4294967295 ECU_ADDRESS 0x00 DISPLAY_IDENTIFIER BMS_CellTemp36_phy /end MEASUREMENT
/begin MEASUREMENT cap_canApiMsg_BMS_CellTempMeas_PT.BMS_CellTemp36_raw "description" FLOAT32_IEEE cal_signal_objects_CM_single 0 0 0 4294967295 ECU_ADDRESS 0x00 DISPLAY_IDENTIFIER BMS_CellTemp36_raw /end MEASUREMENT
/begin MEASUREMENT cap_canApiMsg_BMS_CellTempMeas_PT.BMS_CellTemp37_phy "description" FLOAT32_IEEE cal_signal_objects_CM_single 0 0 0 4294967295 ECU_ADDRESS 0x00 DISPLAY_IDENTIFIER BMS_CellTemp37_phy /end MEASUREMENT
/begin MEASUREMENT cap_canApiMsg_BMS_CellTempMeas_PT.BMS_CellTemp37_raw "description" FLOAT32_IEEE cal_signal_objects_CM_single 0 0 0 4294967295 ECU_ADDRESS 0x00 DISPLAY_IDENTIFIER BMS_CellTemp37_raw /end MEASUREMENT
/begin MEASUREMENT cap_canApiMsg_BMS_CellTempMeas_PT.BMS_CellTemp38_phy "description" FLOAT32_IEEE cal_signal_objects_CM_single 0 0 0 4294967295 ECU_ADDRESS 0x00 DISPLAY_IDENTIFIER BMS_CellTemp38_phy /end MEASUREMENT
/begin MEASUREMENT cap_canApiMsg_BMS_CellTempMeas_PT.BMS_CellTemp38_raw "description" FLOAT32_IEEE cal_signal_objects_CM_single 0 0 0 4294967295 ECU_ADDRESS 0x00 DISPLAY_IDENTIFIER BMS_CellTemp38_raw /end MEASUREMENT
/begin MEASUREMENT cap_canApiMsg_BMS_CellTempMeas_PT.BMS_CellTemp39_phy "description" FLOAT32_IEEE cal_signal_objects_CM_single 0 0 0 4294967295 ECU_ADDRESS 0x00 DISPLAY_IDENTIFIER BMS_CellTemp39_phy /end MEASUREMENT
/begin MEASUREMENT cap_canApiMsg_BMS_CellTempMeas_PT.BMS_CellTemp39_raw "description" FLOAT32_IEEE cal_signal_objects_CM_single 0 0 0 4294967295 ECU_ADDRESS 0x00 DISPLAY_IDENTIFIER BMS_CellTemp39_raw /end MEASUREMENT
/begin MEASUREMENT cap_canApiMsg_BMS_CellTempMeas_PT.BMS_CellTemp40_phy "description" FLOAT32_IEEE cal_signal_objects_CM_single 0 0 0 4294967295 ECU_ADDRESS 0x00 DISPLAY_IDENTIFIER BMS_CellTemp40_phy /end MEASUREMENT
/begin MEASUREMENT cap_canApiMsg_BMS_CellTempMeas_PT.BMS_CellTemp40_raw "description" FLOAT32_IEEE cal_signal_objects_CM_single 0 0 0 4294967295 ECU_ADDRESS 0x00 DISPLAY_IDENTIFIER BMS_CellTemp40_raw /end MEASUREMENT
/begin MEASUREMENT cap_canApiMsg_BMS_CellTempMeas_PT.BMS_CellTemp41_phy "description" FLOAT32_IEEE cal_signal_objects_CM_single 0 0 0 4294967295 ECU_ADDRESS 0x00 DISPLAY_IDENTIFIER BMS_CellTemp41_phy /end MEASUREMENT
/begin MEASUREMENT cap_canApiMsg_BMS_CellTempMeas_PT.BMS_CellTemp41_raw "description" FLOAT32_IEEE cal_signal_objects_CM_single 0 0 0 4294967295 ECU_ADDRESS 0x00 DISPLAY_IDENTIFIER BMS_CellTemp41_raw /end MEASUREMENT
/begin MEASUREMENT cap_canApiMsg_BMS_CellVolMeas1_PT.BMS_CellVol1_phy "description" FLOAT32_IEEE cal_signal_objects_CM_single 0 0 0 4294967295 ECU_ADDRESS 0x00 DISPLAY_IDENTIFIER BMS_CellVol1_phy /end MEASUREMENT
/begin MEASUREMENT cap_canApiMsg_BMS_CellVolMeas1_PT.BMS_CellVol1_raw "description" FLOAT32_IEEE cal_signal_objects_CM_single 0 0 0 4294967295 ECU_ADDRESS 0x00 DISPLAY_IDENTIFIER BMS_CellVol1_raw /end MEASUREMENT
/begin MEASUREMENT cap_canApiMsg_BMS_CellVolMeas1_PT.BMS_CellVol2_phy "description" FLOAT32_IEEE cal_signal_objects_CM_single 0 0 0 4294967295 ECU_ADDRESS 0x00 DISPLAY_IDENTIFIER BMS_CellVol2_phy /end MEASUREMENT
/begin MEASUREMENT cap_canApiMsg_BMS_CellVolMeas1_PT.BMS_CellVol2_raw "description" FLOAT32_IEEE cal_signal_objects_CM_single 0 0 0 4294967295 ECU_ADDRESS 0x00 DISPLAY_IDENTIFIER BMS_CellVol2_raw /end MEASUREMENT
/begin MEASUREMENT cap_canApiMsg_BMS_CellVolMeas1_PT.BMS_CellVol3_phy "description" FLOAT32_IEEE cal_signal_objects_CM_single 0 0 0 4294967295 ECU_ADDRESS 0x00 DISPLAY_IDENTIFIER BMS_CellVol3_phy /end MEASUREMENT
/begin MEASUREMENT cap_canApiMsg_BMS_CellVolMeas1_PT.BMS_CellVol3_raw "description" FLOAT32_IEEE cal_signal_objects_CM_single 0 0 0 4294967295 ECU_ADDRESS 0x00 DISPLAY_IDENTIFIER BMS_CellVol3_raw /end MEASUREMENT
/begin MEASUREMENT cap_canApiMsg_BMS_CellVolMeas1_PT.BMS_CellVol4_phy "description" FLOAT32_IEEE cal_signal_objects_CM_single 0 0 0 4294967295 ECU_ADDRESS 0x00 DISPLAY_IDENTIFIER BMS_CellVol4_phy /end MEASUREMENT
/begin MEASUREMENT cap_canApiMsg_BMS_CellVolMeas1_PT.BMS_CellVol4_raw "description" FLOAT32_IEEE cal_signal_objects_CM_single 0 0 0 4294967295 ECU_ADDRESS 0x00 DISPLAY_IDENTIFIER BMS_CellVol4_raw /end MEASUREMENT
/begin MEASUREMENT cap_canApiMsg_BMS_CellVolMeas1_PT.BMS_CellVol5_phy "description" FLOAT32_IEEE cal_signal_objects_CM_single 0 0 0 4294967295 ECU_ADDRESS 0x00 DISPLAY_IDENTIFIER BMS_CellVol5_phy /end MEASUREMENT
/begin MEASUREMENT cap_canApiMsg_BMS_CellVolMeas1_PT.BMS_CellVol5_raw "description" FLOAT32_IEEE cal_signal_objects_CM_single 0 0 0 4294967295 ECU_ADDRESS 0x00 DISPLAY_IDENTIFIER BMS_CellVol5_raw /end MEASUREMENT
/begin MEASUREMENT cap_canApiMsg_BMS_CellVolMeas1_PT.BMS_CellVol6_phy "description" FLOAT32_IEEE cal_signal_objects_CM_single 0 0 0 4294967295 ECU_ADDRESS 0x00 DISPLAY_IDENTIFIER BMS_CellVol6_phy /end MEASUREMENT
/begin MEASUREMENT cap_canApiMsg_BMS_CellVolMeas1_PT.BMS_CellVol6_raw "description" FLOAT32_IEEE cal_signal_objects_CM_single 0 0 0 4294967295 ECU_ADDRESS 0x00 DISPLAY_IDENTIFIER BMS_CellVol6_raw /end MEASUREMENT
/begin MEASUREMENT cap_canApiMsg_BMS_CellVolMeas1_PT.BMS_CellVol7_phy "description" FLOAT32_IEEE cal_signal_objects_CM_single 0 0 0 4294967295 ECU_ADDRESS 0x00 DISPLAY_IDENTIFIER BMS_CellVol7_phy /end MEASUREMENT
/begin MEASUREMENT cap_canApiMsg_BMS_CellVolMeas1_PT.BMS_CellVol7_raw "description" FLOAT32_IEEE cal_signal_objects_CM_single 0 0 0 4294967295 ECU_ADDRESS 0x00 DISPLAY_IDENTIFIER BMS_CellVol7_raw /end MEASUREMENT
/begin MEASUREMENT cap_canApiMsg_BMS_CellVolMeas1_PT.BMS_CellVol8_phy "description" FLOAT32_IEEE cal_signal_objects_CM_single 0 0 0 4294967295 ECU_ADDRESS 0x00 DISPLAY_IDENTIFIER BMS_CellVol8_phy /end MEASUREMENT
/begin MEASUREMENT cap_canApiMsg_BMS_CellVolMeas1_PT.BMS_CellVol8_raw "description" FLOAT32_IEEE cal_signal_objects_CM_single 0 0 0 4294967295 ECU_ADDRESS 0x00 DISPLAY_IDENTIFIER BMS_CellVol8_raw /end MEASUREMENT
/begin MEASUREMENT cap_canApiMsg_BMS_CellVolMeas1_PT.BMS_CellVol9_phy "description" FLOAT32_IEEE cal_signal_objects_CM_single 0 0 0 4294967295 ECU_ADDRESS 0x00 DISPLAY_IDENTIFIER BMS_CellVol9_phy /end MEASUREMENT
/begin MEASUREMENT cap_canApiMsg_BMS_CellVolMeas1_PT.BMS_CellVol9_raw "description" FLOAT32_IEEE cal_signal_objects_CM_single 0 0 0 4294967295 ECU_ADDRESS 0x00 DISPLAY_IDENTIFIER BMS_CellVol9_raw /end MEASUREMENT
/begin MEASUREMENT cap_canApiMsg_BMS_CellVolMeas1_PT.BMS_CellVol10_phy "description" FLOAT32_IEEE cal_signal_objects_CM_single 0 0 0 4294967295 ECU_ADDRESS 0x00 DISPLAY_IDENTIFIER BMS_CellVol10_phy /end MEASUREMENT
/begin MEASUREMENT cap_canApiMsg_BMS_CellVolMeas1_PT.BMS_CellVol10_raw "description" FLOAT32_IEEE cal_signal_objects_CM_single 0 0 0 4294967295 ECU_ADDRESS 0x00 DISPLAY_IDENTIFIER BMS_CellVol10_raw /end MEASUREMENT
/begin MEASUREMENT cap_canApiMsg_BMS_CellVolMeas1_PT.BMS_CellVol11_phy "description" FLOAT32_IEEE cal_signal_objects_CM_single 0 0 0 4294967295 ECU_ADDRESS 0x00 DISPLAY_IDENTIFIER BMS_CellVol11_phy /end MEASUREMENT
/begin MEASUREMENT cap_canApiMsg_BMS_CellVolMeas1_PT.BMS_CellVol11_raw "description" FLOAT32_IEEE cal_signal_objects_CM_single 0 0 0 4294967295 ECU_ADDRESS 0x00 DISPLAY_IDENTIFIER BMS_CellVol11_raw /end MEASUREMENT
/begin MEASUREMENT cap_canApiMsg_BMS_CellVolMeas1_PT.BMS_CellVol12_phy "description" FLOAT32_IEEE cal_signal_objects_CM_single 0 0 0 4294967295 ECU_ADDRESS 0x00 DISPLAY_IDENTIFIER BMS_CellVol12_phy /end MEASUREMENT
/begin MEASUREMENT cap_canApiMsg_BMS_CellVolMeas1_PT.BMS_CellVol12_raw "description" FLOAT32_IEEE cal_signal_objects_CM_single 0 0 0 4294967295 ECU_ADDRESS 0x00 DISPLAY_IDENTIFIER BMS_CellVol12_raw /end MEASUREMENT
/begin MEASUREMENT cap_canApiMsg_BMS_CellVolMeas1_PT.BMS_CellVol13_phy "description" FLOAT32_IEEE cal_signal_objects_CM_single 0 0 0 4294967295 ECU_ADDRESS 0x00 DISPLAY_IDENTIFIER BMS_CellVol13_phy /end MEASUREMENT
/begin MEASUREMENT cap_canApiMsg_BMS_CellVolMeas1_PT.BMS_CellVol13_raw "description" FLOAT32_IEEE cal_signal_objects_CM_single 0 0 0 4294967295 ECU_ADDRESS 0x00 DISPLAY_IDENTIFIER BMS_CellVol13_raw /end MEASUREMENT
/begin MEASUREMENT cap_canApiMsg_BMS_CellVolMeas1_PT.BMS_CellVol14_phy "description" FLOAT32_IEEE cal_signal_objects_CM_single 0 0 0 4294967295 ECU_ADDRESS 0x00 DISPLAY_IDENTIFIER BMS_CellVol14_phy /end MEASUREMENT
/begin MEASUREMENT cap_canApiMsg_BMS_CellVolMeas1_PT.BMS_CellVol14_raw "description" FLOAT32_IEEE cal_signal_objects_CM_single 0 0 0 4294967295 ECU_ADDRESS 0x00 DISPLAY_IDENTIFIER BMS_CellVol14_raw /end MEASUREMENT
/begin MEASUREMENT cap_canApiMsg_BMS_CellVolMeas1_PT.BMS_CellVol15_phy "description" FLOAT32_IEEE cal_signal_objects_CM_single 0 0 0 4294967295 ECU_ADDRESS 0x00 DISPLAY_IDENTIFIER BMS_CellVol15_phy /end MEASUREMENT
/begin MEASUREMENT cap_canApiMsg_BMS_CellVolMeas1_PT.BMS_CellVol15_raw "description" FLOAT32_IEEE cal_signal_objects_CM_single 0 0 0 4294967295 ECU_ADDRESS 0x00 DISPLAY_IDENTIFIER BMS_CellVol15_raw /end MEASUREMENT
/begin MEASUREMENT cap_canApiMsg_BMS_CellVolMeas1_PT.BMS_CellVol16_phy "description" FLOAT32_IEEE cal_signal_objects_CM_single 0 0 0 4294967295 ECU_ADDRESS 0x00 DISPLAY_IDENTIFIER BMS_CellVol16_phy /end MEASUREMENT
/begin MEASUREMENT cap_canApiMsg_BMS_CellVolMeas1_PT.BMS_CellVol16_raw "description" FLOAT32_IEEE cal_signal_objects_CM_single 0 0 0 4294967295 ECU_ADDRESS 0x00 DISPLAY_IDENTIFIER BMS_CellVol16_raw /end MEASUREMENT
/begin MEASUREMENT cap_canApiMsg_BMS_CellVolMeas1_PT.BMS_CellVol17_phy "description" FLOAT32_IEEE cal_signal_objects_CM_single 0 0 0 4294967295 ECU_ADDRESS 0x00 DISPLAY_IDENTIFIER BMS_CellVol17_phy /end MEASUREMENT
/begin MEASUREMENT cap_canApiMsg_BMS_CellVolMeas1_PT.BMS_CellVol17_raw "description" FLOAT32_IEEE cal_signal_objects_CM_single 0 0 0 4294967295 ECU_ADDRESS 0x00 DISPLAY_IDENTIFIER BMS_CellVol17_raw /end MEASUREMENT
/begin MEASUREMENT cap_canApiMsg_BMS_CellVolMeas1_PT.BMS_CellVol18_phy "description" FLOAT32_IEEE cal_signal_objects_CM_single 0 0 0 4294967295 ECU_ADDRESS 0x00 DISPLAY_IDENTIFIER BMS_CellVol18_phy /end MEASUREMENT
/begin MEASUREMENT cap_canApiMsg_BMS_CellVolMeas1_PT.BMS_CellVol18_raw "description" FLOAT32_IEEE cal_signal_objects_CM_single 0 0 0 4294967295 ECU_ADDRESS 0x00 DISPLAY_IDENTIFIER BMS_CellVol18_raw /end MEASUREMENT
/begin MEASUREMENT cap_canApiMsg_BMS_CellVolMeas1_PT.BMS_CellVol19_phy "description" FLOAT32_IEEE cal_signal_objects_CM_single 0 0 0 4294967295 ECU_ADDRESS 0x00 DISPLAY_IDENTIFIER BMS_CellVol19_phy /end MEASUREMENT
/begin MEASUREMENT cap_canApiMsg_BMS_CellVolMeas1_PT.BMS_CellVol19_raw "description" FLOAT32_IEEE cal_signal_objects_CM_single 0 0 0 4294967295 ECU_ADDRESS 0x00 DISPLAY_IDENTIFIER BMS_CellVol19_raw /end MEASUREMENT
/begin MEASUREMENT cap_canApiMsg_BMS_CellVolMeas1_PT.BMS_CellVol20_phy "description" FLOAT32_IEEE cal_signal_objects_CM_single 0 0 0 4294967295 ECU_ADDRESS 0x00 DISPLAY_IDENTIFIER BMS_CellVol20_phy /end MEASUREMENT
/begin MEASUREMENT cap_canApiMsg_BMS_CellVolMeas1_PT.BMS_CellVol20_raw "description" FLOAT32_IEEE cal_signal_objects_CM_single 0 0 0 4294967295 ECU_ADDRESS 0x00 DISPLAY_IDENTIFIER BMS_CellVol20_raw /end MEASUREMENT
/begin MEASUREMENT cap_canApiMsg_BMS_CellVolMeas1_PT.BMS_CellVol21_phy "description" FLOAT32_IEEE cal_signal_objects_CM_single 0 0 0 4294967295 ECU_ADDRESS 0x00 DISPLAY_IDENTIFIER BMS_CellVol21_phy /end MEASUREMENT
/begin MEASUREMENT cap_canApiMsg_BMS_CellVolMeas1_PT.BMS_CellVol21_raw "description" FLOAT32_IEEE cal_signal_objects_CM_single 0 0 0 4294967295 ECU_ADDRESS 0x00 DISPLAY_IDENTIFIER BMS_CellVol21_raw /end MEASUREMENT
/begin MEASUREMENT cap_canApiMsg_BMS_CellVolMeas1_PT.BMS_CellVol22_phy "description" FLOAT32_IEEE cal_signal_objects_CM_single 0 0 0 4294967295 ECU_ADDRESS 0x00 DISPLAY_IDENTIFIER BMS_CellVol22_phy /end MEASUREMENT
/begin MEASUREMENT cap_canApiMsg_BMS_CellVolMeas1_PT.BMS_CellVol22_raw "description" FLOAT32_IEEE cal_signal_objects_CM_single 0 0 0 4294967295 ECU_ADDRESS 0x00 DISPLAY_IDENTIFIER BMS_CellVol22_raw /end MEASUREMENT
/begin MEASUREMENT cap_canApiMsg_BMS_CellVolMeas1_PT.BMS_CellVol23_phy "description" FLOAT32_IEEE cal_signal_objects_CM_single 0 0 0 4294967295 ECU_ADDRESS 0x00 DISPLAY_IDENTIFIER BMS_CellVol23_phy /end MEASUREMENT
/begin MEASUREMENT cap_canApiMsg_BMS_CellVolMeas1_PT.BMS_CellVol23_raw "description" FLOAT32_IEEE cal_signal_objects_CM_single 0 0 0 4294967295 ECU_ADDRESS 0x00 DISPLAY_IDENTIFIER BMS_CellVol23_raw /end MEASUREMENT
/begin MEASUREMENT cap_canApiMsg_BMS_CellVolMeas1_PT.BMS_CellVol24_phy "description" FLOAT32_IEEE cal_signal_objects_CM_single 0 0 0 4294967295 ECU_ADDRESS 0x00 DISPLAY_IDENTIFIER BMS_CellVol24_phy /end MEASUREMENT
/begin MEASUREMENT cap_canApiMsg_BMS_CellVolMeas1_PT.BMS_CellVol24_raw "description" FLOAT32_IEEE cal_signal_objects_CM_single 0 0 0 4294967295 ECU_ADDRESS 0x00 DISPLAY_IDENTIFIER BMS_CellVol24_raw /end MEASUREMENT
/begin MEASUREMENT cap_canApiMsg_BMS_CellVolMeas1_PT.BMS_CellVol25_phy "description" FLOAT32_IEEE cal_signal_objects_CM_single 0 0 0 4294967295 ECU_ADDRESS 0x00 DISPLAY_IDENTIFIER BMS_CellVol25_phy /end MEASUREMENT
/begin MEASUREMENT cap_canApiMsg_BMS_CellVolMeas1_PT.BMS_CellVol25_raw "description" FLOAT32_IEEE cal_signal_objects_CM_single 0 0 0 4294967295 ECU_ADDRESS 0x00 DISPLAY_IDENTIFIER BMS_CellVol25_raw /end MEASUREMENT
/begin MEASUREMENT cap_canApiMsg_BMS_CellVolMeas1_PT.BMS_CellVol26_phy "description" FLOAT32_IEEE cal_signal_objects_CM_single 0 0 0 4294967295 ECU_ADDRESS 0x00 DISPLAY_IDENTIFIER BMS_CellVol26_phy /end MEASUREMENT
/begin MEASUREMENT cap_canApiMsg_BMS_CellVolMeas1_PT.BMS_CellVol26_raw "description" FLOAT32_IEEE cal_signal_objects_CM_single 0 0 0 4294967295 ECU_ADDRESS 0x00 DISPLAY_IDENTIFIER BMS_CellVol26_raw /end MEASUREMENT
/begin MEASUREMENT cap_canApiMsg_BMS_CellVolMeas1_PT.BMS_CellVol27_phy "description" FLOAT32_IEEE cal_signal_objects_CM_single 0 0 0 4294967295 ECU_ADDRESS 0x00 DISPLAY_IDENTIFIER BMS_CellVol27_phy /end MEASUREMENT
/begin MEASUREMENT cap_canApiMsg_BMS_CellVolMeas1_PT.BMS_CellVol27_raw "description" FLOAT32_IEEE cal_signal_objects_CM_single 0 0 0 4294967295 ECU_ADDRESS 0x00 DISPLAY_IDENTIFIER BMS_CellVol27_raw /end MEASUREMENT
/begin MEASUREMENT cap_canApiMsg_BMS_CellVolMeas1_PT.BMS_CellVol28_phy "description" FLOAT32_IEEE cal_signal_objects_CM_single 0 0 0 4294967295 ECU_ADDRESS 0x00 DISPLAY_IDENTIFIER BMS_CellVol28_phy /end MEASUREMENT
/begin MEASUREMENT cap_canApiMsg_BMS_CellVolMeas1_PT.BMS_CellVol28_raw "description" FLOAT32_IEEE cal_signal_objects_CM_single 0 0 0 4294967295 ECU_ADDRESS 0x00 DISPLAY_IDENTIFIER BMS_CellVol28_raw /end MEASUREMENT
/begin MEASUREMENT cap_canApiMsg_BMS_CellVolMeas1_PT.BMS_CellVol29_phy "description" FLOAT32_IEEE cal_signal_objects_CM_single 0 0 0 4294967295 ECU_ADDRESS 0x00 DISPLAY_IDENTIFIER BMS_CellVol29_phy /end MEASUREMENT
/begin MEASUREMENT cap_canApiMsg_BMS_CellVolMeas1_PT.BMS_CellVol29_raw "description" FLOAT32_IEEE cal_signal_objects_CM_single 0 0 0 4294967295 ECU_ADDRESS 0x00 DISPLAY_IDENTIFIER BMS_CellVol29_raw /end MEASUREMENT
/begin MEASUREMENT cap_canApiMsg_BMS_CellVolMeas1_PT.BMS_CellVol30_phy "description" FLOAT32_IEEE cal_signal_objects_CM_single 0 0 0 4294967295 ECU_ADDRESS 0x00 DISPLAY_IDENTIFIER BMS_CellVol30_phy /end MEASUREMENT
/begin MEASUREMENT cap_canApiMsg_BMS_CellVolMeas1_PT.BMS_CellVol30_raw "description" FLOAT32_IEEE cal_signal_objects_CM_single 0 0 0 4294967295 ECU_ADDRESS 0x00 DISPLAY_IDENTIFIER BMS_CellVol30_raw /end MEASUREMENT
/begin MEASUREMENT cap_canApiMsg_BMS_CellVolMeas2_PT.BMS_CellVol31_phy "description" FLOAT32_IEEE cal_signal_objects_CM_single 0 0 0 4294967295 ECU_ADDRESS 0x00 DISPLAY_IDENTIFIER BMS_CellVol31_phy /end MEASUREMENT
/begin MEASUREMENT cap_canApiMsg_BMS_CellVolMeas2_PT.BMS_CellVol31_raw "description" FLOAT32_IEEE cal_signal_objects_CM_single 0 0 0 4294967295 ECU_ADDRESS 0x00 DISPLAY_IDENTIFIER BMS_CellVol31_raw /end MEASUREMENT
/begin MEASUREMENT cap_canApiMsg_BMS_CellVolMeas2_PT.BMS_CellVol32_phy "description" FLOAT32_IEEE cal_signal_objects_CM_single 0 0 0 4294967295 ECU_ADDRESS 0x00 DISPLAY_IDENTIFIER BMS_CellVol32_phy /end MEASUREMENT
/begin MEASUREMENT cap_canApiMsg_BMS_CellVolMeas2_PT.BMS_CellVol32_raw "description" FLOAT32_IEEE cal_signal_objects_CM_single 0 0 0 4294967295 ECU_ADDRESS 0x00 DISPLAY_IDENTIFIER BMS_CellVol32_raw /end MEASUREMENT
/begin MEASUREMENT cap_canApiMsg_BMS_CellVolMeas2_PT.BMS_CellVol33_phy "description" FLOAT32_IEEE cal_signal_objects_CM_single 0 0 0 4294967295 ECU_ADDRESS 0x00 DISPLAY_IDENTIFIER BMS_CellVol33_phy /end MEASUREMENT
/begin MEASUREMENT cap_canApiMsg_BMS_CellVolMeas2_PT.BMS_CellVol33_raw "description" FLOAT32_IEEE cal_signal_objects_CM_single 0 0 0 4294967295 ECU_ADDRESS 0x00 DISPLAY_IDENTIFIER BMS_CellVol33_raw /end MEASUREMENT
/begin MEASUREMENT cap_canApiMsg_BMS_CellVolMeas2_PT.BMS_CellVol34_phy "description" FLOAT32_IEEE cal_signal_objects_CM_single 0 0 0 4294967295 ECU_ADDRESS 0x00 DISPLAY_IDENTIFIER BMS_CellVol34_phy /end MEASUREMENT
/begin MEASUREMENT cap_canApiMsg_BMS_CellVolMeas2_PT.BMS_CellVol34_raw "description" FLOAT32_IEEE cal_signal_objects_CM_single 0 0 0 4294967295 ECU_ADDRESS 0x00 DISPLAY_IDENTIFIER BMS_CellVol34_raw /end MEASUREMENT
/begin MEASUREMENT cap_canApiMsg_BMS_CellVolMeas2_PT.BMS_CellVol35_phy "description" FLOAT32_IEEE cal_signal_objects_CM_single 0 0 0 4294967295 ECU_ADDRESS 0x00 DISPLAY_IDENTIFIER BMS_CellVol35_phy /end MEASUREMENT
/begin MEASUREMENT cap_canApiMsg_BMS_CellVolMeas2_PT.BMS_CellVol35_raw "description" FLOAT32_IEEE cal_signal_objects_CM_single 0 0 0 4294967295 ECU_ADDRESS 0x00 DISPLAY_IDENTIFIER BMS_CellVol35_raw /end MEASUREMENT
/begin MEASUREMENT cap_canApiMsg_BMS_CellVolMeas2_PT.BMS_CellVol36_phy "description" FLOAT32_IEEE cal_signal_objects_CM_single 0 0 0 4294967295 ECU_ADDRESS 0x00 DISPLAY_IDENTIFIER BMS_CellVol36_phy /end MEASUREMENT
/begin MEASUREMENT cap_canApiMsg_BMS_CellVolMeas2_PT.BMS_CellVol36_raw "description" FLOAT32_IEEE cal_signal_objects_CM_single 0 0 0 4294967295 ECU_ADDRESS 0x00 DISPLAY_IDENTIFIER BMS_CellVol36_raw /end MEASUREMENT
/begin MEASUREMENT cap_canApiMsg_BMS_CellVolMeas2_PT.BMS_CellVol37_phy "description" FLOAT32_IEEE cal_signal_objects_CM_single 0 0 0 4294967295 ECU_ADDRESS 0x00 DISPLAY_IDENTIFIER BMS_CellVol37_phy /end MEASUREMENT
/begin MEASUREMENT cap_canApiMsg_BMS_CellVolMeas2_PT.BMS_CellVol37_raw "description" FLOAT32_IEEE cal_signal_objects_CM_single 0 0 0 4294967295 ECU_ADDRESS 0x00 DISPLAY_IDENTIFIER BMS_CellVol37_raw /end MEASUREMENT
/begin MEASUREMENT cap_canApiMsg_BMS_CellVolMeas2_PT.BMS_CellVol38_phy "description" FLOAT32_IEEE cal_signal_objects_CM_single 0 0 0 4294967295 ECU_ADDRESS 0x00 DISPLAY_IDENTIFIER BMS_CellVol38_phy /end MEASUREMENT
/begin MEASUREMENT cap_canApiMsg_BMS_CellVolMeas2_PT.BMS_CellVol38_raw "description" FLOAT32_IEEE cal_signal_objects_CM_single 0 0 0 4294967295 ECU_ADDRESS 0x00 DISPLAY_IDENTIFIER BMS_CellVol38_raw /end MEASUREMENT
/begin MEASUREMENT cap_canApiMsg_BMS_CellVolMeas2_PT.BMS_CellVol39_phy "description" FLOAT32_IEEE cal_signal_objects_CM_single 0 0 0 4294967295 ECU_ADDRESS 0x00 DISPLAY_IDENTIFIER BMS_CellVol39_phy /end MEASUREMENT
/begin MEASUREMENT cap_canApiMsg_BMS_CellVolMeas2_PT.BMS_CellVol39_raw "description" FLOAT32_IEEE cal_signal_objects_CM_single 0 0 0 4294967295 ECU_ADDRESS 0x00 DISPLAY_IDENTIFIER BMS_CellVol39_raw /end MEASUREMENT
/begin MEASUREMENT cap_canApiMsg_BMS_CellVolMeas2_PT.BMS_CellVol40_phy "description" FLOAT32_IEEE cal_signal_objects_CM_single 0 0 0 4294967295 ECU_ADDRESS 0x00 DISPLAY_IDENTIFIER BMS_CellVol40_phy /end MEASUREMENT
/begin MEASUREMENT cap_canApiMsg_BMS_CellVolMeas2_PT.BMS_CellVol40_raw "description" FLOAT32_IEEE cal_signal_objects_CM_single 0 0 0 4294967295 ECU_ADDRESS 0x00 DISPLAY_IDENTIFIER BMS_CellVol40_raw /end MEASUREMENT
/begin MEASUREMENT cap_canApiMsg_BMS_CellVolMeas2_PT.BMS_CellVol41_phy "description" FLOAT32_IEEE cal_signal_objects_CM_single 0 0 0 4294967295 ECU_ADDRESS 0x00 DISPLAY_IDENTIFIER BMS_CellVol41_phy /end MEASUREMENT
/begin MEASUREMENT cap_canApiMsg_BMS_CellVolMeas2_PT.BMS_CellVol41_raw "description" FLOAT32_IEEE cal_signal_objects_CM_single 0 0 0 4294967295 ECU_ADDRESS 0x00 DISPLAY_IDENTIFIER BMS_CellVol41_raw /end MEASUREMENT
/begin MEASUREMENT cap_canApiMsg_BMS_CellVolMeas2_PT.BMS_CellVol42_phy "description" FLOAT32_IEEE cal_signal_objects_CM_single 0 0 0 4294967295 ECU_ADDRESS 0x00 DISPLAY_IDENTIFIER BMS_CellVol42_phy /end MEASUREMENT
/begin MEASUREMENT cap_canApiMsg_BMS_CellVolMeas2_PT.BMS_CellVol42_raw "description" FLOAT32_IEEE cal_signal_objects_CM_single 0 0 0 4294967295 ECU_ADDRESS 0x00 DISPLAY_IDENTIFIER BMS_CellVol42_raw /end MEASUREMENT
/begin MEASUREMENT cap_canApiMsg_BMS_CellVolMeas2_PT.BMS_CellVol43_phy "description" FLOAT32_IEEE cal_signal_objects_CM_single 0 0 0 4294967295 ECU_ADDRESS 0x00 DISPLAY_IDENTIFIER BMS_CellVol43_phy /end MEASUREMENT
/begin MEASUREMENT cap_canApiMsg_BMS_CellVolMeas2_PT.BMS_CellVol43_raw "description" FLOAT32_IEEE cal_signal_objects_CM_single 0 0 0 4294967295 ECU_ADDRESS 0x00 DISPLAY_IDENTIFIER BMS_CellVol43_raw /end MEASUREMENT
/begin MEASUREMENT cap_canApiMsg_BMS_CellVolMeas2_PT.BMS_CellVol44_phy "description" FLOAT32_IEEE cal_signal_objects_CM_single 0 0 0 4294967295 ECU_ADDRESS 0x00 DISPLAY_IDENTIFIER BMS_CellVol44_phy /end MEASUREMENT
/begin MEASUREMENT cap_canApiMsg_BMS_CellVolMeas2_PT.BMS_CellVol44_raw "description" FLOAT32_IEEE cal_signal_objects_CM_single 0 0 0 4294967295 ECU_ADDRESS 0x00 DISPLAY_IDENTIFIER BMS_CellVol44_raw /end MEASUREMENT
/begin MEASUREMENT cap_canApiMsg_BMS_CellVolMeas2_PT.BMS_CellVol45_phy "description" FLOAT32_IEEE cal_signal_objects_CM_single 0 0 0 4294967295 ECU_ADDRESS 0x00 DISPLAY_IDENTIFIER BMS_CellVol45_phy /end MEASUREMENT
/begin MEASUREMENT cap_canApiMsg_BMS_CellVolMeas2_PT.BMS_CellVol45_raw "description" FLOAT32_IEEE cal_signal_objects_CM_single 0 0 0 4294967295 ECU_ADDRESS 0x00 DISPLAY_IDENTIFIER BMS_CellVol45_raw /end MEASUREMENT
/begin MEASUREMENT cap_canApiMsg_BMS_CellVolMeas2_PT.BMS_CellVol46_phy "description" FLOAT32_IEEE cal_signal_objects_CM_single 0 0 0 4294967295 ECU_ADDRESS 0x00 DISPLAY_IDENTIFIER BMS_CellVol46_phy /end MEASUREMENT
/begin MEASUREMENT cap_canApiMsg_BMS_CellVolMeas2_PT.BMS_CellVol46_raw "description" FLOAT32_IEEE cal_signal_objects_CM_single 0 0 0 4294967295 ECU_ADDRESS 0x00 DISPLAY_IDENTIFIER BMS_CellVol46_raw /end MEASUREMENT
/begin MEASUREMENT cap_canApiMsg_BMS_CellVolMeas2_PT.BMS_CellVol47_phy "description" FLOAT32_IEEE cal_signal_objects_CM_single 0 0 0 4294967295 ECU_ADDRESS 0x00 DISPLAY_IDENTIFIER BMS_CellVol47_phy /end MEASUREMENT
/begin MEASUREMENT cap_canApiMsg_BMS_CellVolMeas2_PT.BMS_CellVol47_raw "description" FLOAT32_IEEE cal_signal_objects_CM_single 0 0 0 4294967295 ECU_ADDRESS 0x00 DISPLAY_IDENTIFIER BMS_CellVol47_raw /end MEASUREMENT
/begin MEASUREMENT cap_canApiMsg_BMS_CellVolMeas2_PT.BMS_CellVol48_phy "description" FLOAT32_IEEE cal_signal_objects_CM_single 0 0 0 4294967295 ECU_ADDRESS 0x00 DISPLAY_IDENTIFIER BMS_CellVol48_phy /end MEASUREMENT
/begin MEASUREMENT cap_canApiMsg_BMS_CellVolMeas2_PT.BMS_CellVol48_raw "description" FLOAT32_IEEE cal_signal_objects_CM_single 0 0 0 4294967295 ECU_ADDRESS 0x00 DISPLAY_IDENTIFIER BMS_CellVol48_raw /end MEASUREMENT
/begin MEASUREMENT cap_canApiMsg_BMS_CellVolMeas2_PT.BMS_CellVol49_phy "description" FLOAT32_IEEE cal_signal_objects_CM_single 0 0 0 4294967295 ECU_ADDRESS 0x00 DISPLAY_IDENTIFIER BMS_CellVol49_phy /end MEASUREMENT
/begin MEASUREMENT cap_canApiMsg_BMS_CellVolMeas2_PT.BMS_CellVol49_raw "description" FLOAT32_IEEE cal_signal_objects_CM_single 0 0 0 4294967295 ECU_ADDRESS 0x00 DISPLAY_IDENTIFIER BMS_CellVol49_raw /end MEASUREMENT
/begin MEASUREMENT cap_canApiMsg_BMS_CellVolMeas2_PT.BMS_CellVol50_phy "description" FLOAT32_IEEE cal_signal_objects_CM_single 0 0 0 4294967295 ECU_ADDRESS 0x00 DISPLAY_IDENTIFIER BMS_CellVol50_phy /end MEASUREMENT
/begin MEASUREMENT cap_canApiMsg_BMS_CellVolMeas2_PT.BMS_CellVol50_raw "description" FLOAT32_IEEE cal_signal_objects_CM_single 0 0 0 4294967295 ECU_ADDRESS 0x00 DISPLAY_IDENTIFIER BMS_CellVol50_raw /end MEASUREMENT
/begin MEASUREMENT cap_canApiMsg_BMS_CellVolMeas2_PT.BMS_CellVol51_phy "description" FLOAT32_IEEE cal_signal_objects_CM_single 0 0 0 4294967295 ECU_ADDRESS 0x00 DISPLAY_IDENTIFIER BMS_CellVol51_phy /end MEASUREMENT
/begin MEASUREMENT cap_canApiMsg_BMS_CellVolMeas2_PT.BMS_CellVol51_raw "description" FLOAT32_IEEE cal_signal_objects_CM_single 0 0 0 4294967295 ECU_ADDRESS 0x00 DISPLAY_IDENTIFIER BMS_CellVol51_raw /end MEASUREMENT
/begin MEASUREMENT cap_canApiMsg_BMS_CellVolMeas2_PT.BMS_CellVol52_phy "description" FLOAT32_IEEE cal_signal_objects_CM_single 0 0 0 4294967295 ECU_ADDRESS 0x00 DISPLAY_IDENTIFIER BMS_CellVol52_phy /end MEASUREMENT
/begin MEASUREMENT cap_canApiMsg_BMS_CellVolMeas2_PT.BMS_CellVol52_raw "description" FLOAT32_IEEE cal_signal_objects_CM_single 0 0 0 4294967295 ECU_ADDRESS 0x00 DISPLAY_IDENTIFIER BMS_CellVol52_raw /end MEASUREMENT
/begin MEASUREMENT cap_canApiMsg_BMS_CellVolMeas2_PT.BMS_CellVol53_phy "description" FLOAT32_IEEE cal_signal_objects_CM_single 0 0 0 4294967295 ECU_ADDRESS 0x00 DISPLAY_IDENTIFIER BMS_CellVol53_phy /end MEASUREMENT
/begin MEASUREMENT cap_canApiMsg_BMS_CellVolMeas2_PT.BMS_CellVol53_raw "description" FLOAT32_IEEE cal_signal_objects_CM_single 0 0 0 4294967295 ECU_ADDRESS 0x00 DISPLAY_IDENTIFIER BMS_CellVol53_raw /end MEASUREMENT
/begin MEASUREMENT cap_canApiMsg_BMS_CellVolMeas2_PT.BMS_CellVol54_phy "description" FLOAT32_IEEE cal_signal_objects_CM_single 0 0 0 4294967295 ECU_ADDRESS 0x00 DISPLAY_IDENTIFIER BMS_CellVol54_phy /end MEASUREMENT
/begin MEASUREMENT cap_canApiMsg_BMS_CellVolMeas2_PT.BMS_CellVol54_raw "description" FLOAT32_IEEE cal_signal_objects_CM_single 0 0 0 4294967295 ECU_ADDRESS 0x00 DISPLAY_IDENTIFIER BMS_CellVol54_raw /end MEASUREMENT
/begin MEASUREMENT cap_canApiMsg_BMS_CellVolMeas2_PT.BMS_CellVol55_phy "description" FLOAT32_IEEE cal_signal_objects_CM_single 0 0 0 4294967295 ECU_ADDRESS 0x00 DISPLAY_IDENTIFIER BMS_CellVol55_phy /end MEASUREMENT
/begin MEASUREMENT cap_canApiMsg_BMS_CellVolMeas2_PT.BMS_CellVol55_raw "description" FLOAT32_IEEE cal_signal_objects_CM_single 0 0 0 4294967295 ECU_ADDRESS 0x00 DISPLAY_IDENTIFIER BMS_CellVol55_raw /end MEASUREMENT
/begin MEASUREMENT cap_canApiMsg_BMS_CellVolMeas2_PT.BMS_CellVol56_phy "description" FLOAT32_IEEE cal_signal_objects_CM_single 0 0 0 4294967295 ECU_ADDRESS 0x00 DISPLAY_IDENTIFIER BMS_CellVol56_phy /end MEASUREMENT
/begin MEASUREMENT cap_canApiMsg_BMS_CellVolMeas2_PT.BMS_CellVol56_raw "description" FLOAT32_IEEE cal_signal_objects_CM_single 0 0 0 4294967295 ECU_ADDRESS 0x00 DISPLAY_IDENTIFIER BMS_CellVol56_raw /end MEASUREMENT
/begin MEASUREMENT cap_canApiMsg_BMS_CellVolMeas2_PT.BMS_CellVol57_phy "description" FLOAT32_IEEE cal_signal_objects_CM_single 0 0 0 4294967295 ECU_ADDRESS 0x00 DISPLAY_IDENTIFIER BMS_CellVol57_phy /end MEASUREMENT
/begin MEASUREMENT cap_canApiMsg_BMS_CellVolMeas2_PT.BMS_CellVol57_raw "description" FLOAT32_IEEE cal_signal_objects_CM_single 0 0 0 4294967295 ECU_ADDRESS 0x00 DISPLAY_IDENTIFIER BMS_CellVol57_raw /end MEASUREMENT
/begin MEASUREMENT cap_canApiMsg_BMS_CellVolMeas2_PT.BMS_CellVol58_phy "description" FLOAT32_IEEE cal_signal_objects_CM_single 0 0 0 4294967295 ECU_ADDRESS 0x00 DISPLAY_IDENTIFIER BMS_CellVol58_phy /end MEASUREMENT
/begin MEASUREMENT cap_canApiMsg_BMS_CellVolMeas2_PT.BMS_CellVol58_raw "description" FLOAT32_IEEE cal_signal_objects_CM_single 0 0 0 4294967295 ECU_ADDRESS 0x00 DISPLAY_IDENTIFIER BMS_CellVol58_raw /end MEASUREMENT
/begin MEASUREMENT cap_canApiMsg_BMS_CellVolMeas2_PT.BMS_CellVol59_phy "description" FLOAT32_IEEE cal_signal_objects_CM_single 0 0 0 4294967295 ECU_ADDRESS 0x00 DISPLAY_IDENTIFIER BMS_CellVol59_phy /end MEASUREMENT
/begin MEASUREMENT cap_canApiMsg_BMS_CellVolMeas2_PT.BMS_CellVol59_raw "description" FLOAT32_IEEE cal_signal_objects_CM_single 0 0 0 4294967295 ECU_ADDRESS 0x00 DISPLAY_IDENTIFIER BMS_CellVol59_raw /end MEASUREMENT
/begin MEASUREMENT cap_canApiMsg_BMS_CellVolMeas2_PT.BMS_CellVol60_phy "description" FLOAT32_IEEE cal_signal_objects_CM_single 0 0 0 4294967295 ECU_ADDRESS 0x00 DISPLAY_IDENTIFIER BMS_CellVol60_phy /end MEASUREMENT
/begin MEASUREMENT cap_canApiMsg_BMS_CellVolMeas2_PT.BMS_CellVol60_raw "description" FLOAT32_IEEE cal_signal_objects_CM_single 0 0 0 4294967295 ECU_ADDRESS 0x00 DISPLAY_IDENTIFIER BMS_CellVol60_raw /end MEASUREMENT
/begin MEASUREMENT cap_canApiMsg_BMS_CellVolMeas2_PT.BMS_CellVol61_phy "description" FLOAT32_IEEE cal_signal_objects_CM_single 0 0 0 4294967295 ECU_ADDRESS 0x00 DISPLAY_IDENTIFIER BMS_CellVol61_phy /end MEASUREMENT
/begin MEASUREMENT cap_canApiMsg_BMS_CellVolMeas2_PT.BMS_CellVol61_raw "description" FLOAT32_IEEE cal_signal_objects_CM_single 0 0 0 4294967295 ECU_ADDRESS 0x00 DISPLAY_IDENTIFIER BMS_CellVol61_raw /end MEASUREMENT
/begin MEASUREMENT cap_canApiMsg_BMS_CellVolMeas2_PT.BMS_CellVol62_phy "description" FLOAT32_IEEE cal_signal_objects_CM_single 0 0 0 4294967295 ECU_ADDRESS 0x00 DISPLAY_IDENTIFIER BMS_CellVol62_phy /end MEASUREMENT
/begin MEASUREMENT cap_canApiMsg_BMS_CellVolMeas2_PT.BMS_CellVol62_raw "description" FLOAT32_IEEE cal_signal_objects_CM_single 0 0 0 4294967295 ECU_ADDRESS 0x00 DISPLAY_IDENTIFIER BMS_CellVol62_raw /end MEASUREMENT
/begin MEASUREMENT cap_canApiMsg_OBC_Status_PT.OBC_Max_Current_Out_phy "description" FLOAT32_IEEE cal_signal_objects_CM_single 0 0 0 4294967295 ECU_ADDRESS 0x00 DISPLAY_IDENTIFIER OBC_Max_Current_Out_phy /end MEASUREMENT
/begin MEASUREMENT cap_canApiMsg_OBC_Status_PT.OBC_Max_Current_Out_raw "description" FLOAT32_IEEE cal_signal_objects_CM_single 0 0 0 4294967295 ECU_ADDRESS 0x00 DISPLAY_IDENTIFIER OBC_Max_Current_Out_raw /end MEASUREMENT
/begin MEASUREMENT cap_canApiMsg_OBC_Status_PT.OBC_VCU_iAC_L1_phy "description" FLOAT32_IEEE cal_signal_objects_CM_single 0 0 0 4294967295 ECU_ADDRESS 0x00 DISPLAY_IDENTIFIER OBC_VCU_iAC_L1_phy /end MEASUREMENT
/begin MEASUREMENT cap_canApiMsg_OBC_Status_PT.OBC_VCU_iAC_L1_raw "description" FLOAT32_IEEE cal_signal_objects_CM_single 0 0 0 4294967295 ECU_ADDRESS 0x00 DISPLAY_IDENTIFIER OBC_VCU_iAC_L1_raw /end MEASUREMENT
/begin MEASUREMENT cap_canApiMsg_OBC_Status_PT.OBC_VCU_iAC_L2_phy "description" FLOAT32_IEEE cal_signal_objects_CM_single 0 0 0 4294967295 ECU_ADDRESS 0x00 DISPLAY_IDENTIFIER OBC_VCU_iAC_L2_phy /end MEASUREMENT
/begin MEASUREMENT cap_canApiMsg_OBC_Status_PT.OBC_VCU_iAC_L2_raw "description" FLOAT32_IEEE cal_signal_objects_CM_single 0 0 0 4294967295 ECU_ADDRESS 0x00 DISPLAY_IDENTIFIER OBC_VCU_iAC_L2_raw /end MEASUREMENT
/begin MEASUREMENT cap_canApiMsg_OBC_Status_PT.OBC_VCU_iAC_L3_phy "description" FLOAT32_IEEE cal_signal_objects_CM_single 0 0 0 4294967295 ECU_ADDRESS 0x00 DISPLAY_IDENTIFIER OBC_VCU_iAC_L3_phy /end MEASUREMENT
/begin MEASUREMENT cap_canApiMsg_OBC_Status_PT.OBC_VCU_iAC_L3_raw "description" FLOAT32_IEEE cal_signal_objects_CM_single 0 0 0 4294967295 ECU_ADDRESS 0x00 DISPLAY_IDENTIFIER OBC_VCU_iAC_L3_raw /end MEASUREMENT
/begin MEASUREMENT cap_canApiMsg_OBC_Status_PT.OBC_VCU_iDC_phy "description" FLOAT32_IEEE cal_signal_objects_CM_single 0 0 0 4294967295 ECU_ADDRESS 0x00 DISPLAY_IDENTIFIER OBC_VCU_iDC_phy /end MEASUREMENT
/begin MEASUREMENT cap_canApiMsg_OBC_Status_PT.OBC_VCU_iDC_raw "description" FLOAT32_IEEE cal_signal_objects_CM_single 0 0 0 4294967295 ECU_ADDRESS 0x00 DISPLAY_IDENTIFIER OBC_VCU_iDC_raw /end MEASUREMENT
/begin MEASUREMENT cap_canApiMsg_BMS_CellVolMeas3_PT.BMS_CellVol63_phy "description" FLOAT32_IEEE cal_signal_objects_CM_single 0 0 0 4294967295 ECU_ADDRESS 0x00 DISPLAY_IDENTIFIER BMS_CellVol63_phy /end MEASUREMENT
/begin MEASUREMENT cap_canApiMsg_BMS_CellVolMeas3_PT.BMS_CellVol63_raw "description" FLOAT32_IEEE cal_signal_objects_CM_single 0 0 0 4294967295 ECU_ADDRESS 0x00 DISPLAY_IDENTIFIER BMS_CellVol63_raw /end MEASUREMENT
/begin MEASUREMENT cap_canApiMsg_BMS_CellVolMeas3_PT.BMS_CellVol64_phy "description" FLOAT32_IEEE cal_signal_objects_CM_single 0 0 0 4294967295 ECU_ADDRESS 0x00 DISPLAY_IDENTIFIER BMS_CellVol64_phy /end MEASUREMENT
/begin MEASUREMENT cap_canApiMsg_BMS_CellVolMeas3_PT.BMS_CellVol64_raw "description" FLOAT32_IEEE cal_signal_objects_CM_single 0 0 0 4294967295 ECU_ADDRESS 0x00 DISPLAY_IDENTIFIER BMS_CellVol64_raw /end MEASUREMENT
/begin MEASUREMENT cap_canApiMsg_BMS_CellVolMeas3_PT.BMS_CellVol65_phy "description" FLOAT32_IEEE cal_signal_objects_CM_single 0 0 0 4294967295 ECU_ADDRESS 0x00 DISPLAY_IDENTIFIER BMS_CellVol65_phy /end MEASUREMENT
/begin MEASUREMENT cap_canApiMsg_BMS_CellVolMeas3_PT.BMS_CellVol65_raw "description" FLOAT32_IEEE cal_signal_objects_CM_single 0 0 0 4294967295 ECU_ADDRESS 0x00 DISPLAY_IDENTIFIER BMS_CellVol65_raw /end MEASUREMENT
/begin MEASUREMENT cap_canApiMsg_BMS_CellVolMeas3_PT.BMS_CellVol66_phy "description" FLOAT32_IEEE cal_signal_objects_CM_single 0 0 0 4294967295 ECU_ADDRESS 0x00 DISPLAY_IDENTIFIER BMS_CellVol66_phy /end MEASUREMENT
/begin MEASUREMENT cap_canApiMsg_BMS_CellVolMeas3_PT.BMS_CellVol66_raw "description" FLOAT32_IEEE cal_signal_objects_CM_single 0 0 0 4294967295 ECU_ADDRESS 0x00 DISPLAY_IDENTIFIER BMS_CellVol66_raw /end MEASUREMENT
/begin MEASUREMENT cap_canApiMsg_BMS_CellVolMeas3_PT.BMS_CellVol67_phy "description" FLOAT32_IEEE cal_signal_objects_CM_single 0 0 0 4294967295 ECU_ADDRESS 0x00 DISPLAY_IDENTIFIER BMS_CellVol67_phy /end MEASUREMENT
/begin MEASUREMENT cap_canApiMsg_BMS_CellVolMeas3_PT.BMS_CellVol67_raw "description" FLOAT32_IEEE cal_signal_objects_CM_single 0 0 0 4294967295 ECU_ADDRESS 0x00 DISPLAY_IDENTIFIER BMS_CellVol67_raw /end MEASUREMENT
/begin MEASUREMENT cap_canApiMsg_BMS_CellVolMeas3_PT.BMS_CellVol68_phy "description" FLOAT32_IEEE cal_signal_objects_CM_single 0 0 0 4294967295 ECU_ADDRESS 0x00 DISPLAY_IDENTIFIER BMS_CellVol68_phy /end MEASUREMENT
/begin MEASUREMENT cap_canApiMsg_BMS_CellVolMeas3_PT.BMS_CellVol68_raw "description" FLOAT32_IEEE cal_signal_objects_CM_single 0 0 0 4294967295 ECU_ADDRESS 0x00 DISPLAY_IDENTIFIER BMS_CellVol68_raw /end MEASUREMENT
/begin MEASUREMENT cap_canApiMsg_BMS_CellVolMeas3_PT.BMS_CellVol69_phy "description" FLOAT32_IEEE cal_signal_objects_CM_single 0 0 0 4294967295 ECU_ADDRESS 0x00 DISPLAY_IDENTIFIER BMS_CellVol69_phy /end MEASUREMENT
/begin MEASUREMENT cap_canApiMsg_BMS_CellVolMeas3_PT.BMS_CellVol69_raw "description" FLOAT32_IEEE cal_signal_objects_CM_single 0 0 0 4294967295 ECU_ADDRESS 0x00 DISPLAY_IDENTIFIER BMS_CellVol69_raw /end MEASUREMENT
/begin MEASUREMENT cap_canApiMsg_BMS_CellVolMeas3_PT.BMS_CellVol70_phy "description" FLOAT32_IEEE cal_signal_objects_CM_single 0 0 0 4294967295 ECU_ADDRESS 0x00 DISPLAY_IDENTIFIER BMS_CellVol70_phy /end MEASUREMENT
/begin MEASUREMENT cap_canApiMsg_BMS_CellVolMeas3_PT.BMS_CellVol70_raw "description" FLOAT32_IEEE cal_signal_objects_CM_single 0 0 0 4294967295 ECU_ADDRESS 0x00 DISPLAY_IDENTIFIER BMS_CellVol70_raw /end MEASUREMENT
/begin MEASUREMENT cap_canApiMsg_BMS_CellVolMeas3_PT.BMS_CellVol71_phy "description" FLOAT32_IEEE cal_signal_objects_CM_single 0 0 0 4294967295 ECU_ADDRESS 0x00 DISPLAY_IDENTIFIER BMS_CellVol71_phy /end MEASUREMENT
/begin MEASUREMENT cap_canApiMsg_BMS_CellVolMeas3_PT.BMS_CellVol71_raw "description" FLOAT32_IEEE cal_signal_objects_CM_single 0 0 0 4294967295 ECU_ADDRESS 0x00 DISPLAY_IDENTIFIER BMS_CellVol71_raw /end MEASUREMENT
/begin MEASUREMENT cap_canApiMsg_BMS_CellVolMeas3_PT.BMS_CellVol72_phy "description" FLOAT32_IEEE cal_signal_objects_CM_single 0 0 0 4294967295 ECU_ADDRESS 0x00 DISPLAY_IDENTIFIER BMS_CellVol72_phy /end MEASUREMENT
/begin MEASUREMENT cap_canApiMsg_BMS_CellVolMeas3_PT.BMS_CellVol72_raw "description" FLOAT32_IEEE cal_signal_objects_CM_single 0 0 0 4294967295 ECU_ADDRESS 0x00 DISPLAY_IDENTIFIER BMS_CellVol72_raw /end MEASUREMENT
/begin MEASUREMENT cap_canApiMsg_BMS_CellVolMeas3_PT.BMS_CellVol73_phy "description" FLOAT32_IEEE cal_signal_objects_CM_single 0 0 0 4294967295 ECU_ADDRESS 0x00 DISPLAY_IDENTIFIER BMS_CellVol73_phy /end MEASUREMENT
/begin MEASUREMENT cap_canApiMsg_BMS_CellVolMeas3_PT.BMS_CellVol73_raw "description" FLOAT32_IEEE cal_signal_objects_CM_single 0 0 0 4294967295 ECU_ADDRESS 0x00 DISPLAY_IDENTIFIER BMS_CellVol73_raw /end MEASUREMENT
/begin MEASUREMENT cap_canApiMsg_BMS_CellVolMeas3_PT.BMS_CellVol74_phy "description" FLOAT32_IEEE cal_signal_objects_CM_single 0 0 0 4294967295 ECU_ADDRESS 0x00 DISPLAY_IDENTIFIER BMS_CellVol74_phy /end MEASUREMENT
/begin MEASUREMENT cap_canApiMsg_BMS_CellVolMeas3_PT.BMS_CellVol74_raw "description" FLOAT32_IEEE cal_signal_objects_CM_single 0 0 0 4294967295 ECU_ADDRESS 0x00 DISPLAY_IDENTIFIER BMS_CellVol74_raw /end MEASUREMENT
/begin MEASUREMENT cap_canApiMsg_BMS_CellVolMeas3_PT.BMS_CellVol75_phy "description" FLOAT32_IEEE cal_signal_objects_CM_single 0 0 0 4294967295 ECU_ADDRESS 0x00 DISPLAY_IDENTIFIER BMS_CellVol75_phy /end MEASUREMENT
/begin MEASUREMENT cap_canApiMsg_BMS_CellVolMeas3_PT.BMS_CellVol75_raw "description" FLOAT32_IEEE cal_signal_objects_CM_single 0 0 0 4294967295 ECU_ADDRESS 0x00 DISPLAY_IDENTIFIER BMS_CellVol75_raw /end MEASUREMENT
/begin MEASUREMENT cap_canApiMsg_BMS_CellVolMeas3_PT.BMS_CellVol76_phy "description" FLOAT32_IEEE cal_signal_objects_CM_single 0 0 0 4294967295 ECU_ADDRESS 0x00 DISPLAY_IDENTIFIER BMS_CellVol76_phy /end MEASUREMENT
/begin MEASUREMENT cap_canApiMsg_BMS_CellVolMeas3_PT.BMS_CellVol76_raw "description" FLOAT32_IEEE cal_signal_objects_CM_single 0 0 0 4294967295 ECU_ADDRESS 0x00 DISPLAY_IDENTIFIER BMS_CellVol76_raw /end MEASUREMENT
/begin MEASUREMENT cap_canApiMsg_BMS_CellVolMeas3_PT.BMS_CellVol77_phy "description" FLOAT32_IEEE cal_signal_objects_CM_single 0 0 0 4294967295 ECU_ADDRESS 0x00 DISPLAY_IDENTIFIER BMS_CellVol77_phy /end MEASUREMENT
/begin MEASUREMENT cap_canApiMsg_BMS_CellVolMeas3_PT.BMS_CellVol77_raw "description" FLOAT32_IEEE cal_signal_objects_CM_single 0 0 0 4294967295 ECU_ADDRESS 0x00 DISPLAY_IDENTIFIER BMS_CellVol77_raw /end MEASUREMENT
/begin MEASUREMENT cap_canApiMsg_BMS_CellVolMeas3_PT.BMS_CellVol78_phy "description" FLOAT32_IEEE cal_signal_objects_CM_single 0 0 0 4294967295 ECU_ADDRESS 0x00 DISPLAY_IDENTIFIER BMS_CellVol78_phy /end MEASUREMENT
/begin MEASUREMENT cap_canApiMsg_BMS_CellVolMeas3_PT.BMS_CellVol78_raw "description" FLOAT32_IEEE cal_signal_objects_CM_single 0 0 0 4294967295 ECU_ADDRESS 0x00 DISPLAY_IDENTIFIER BMS_CellVol78_raw /end MEASUREMENT
/begin MEASUREMENT cap_canApiMsg_BMS_CellVolMeas3_PT.BMS_CellVol79_phy "description" FLOAT32_IEEE cal_signal_objects_CM_single 0 0 0 4294967295 ECU_ADDRESS 0x00 DISPLAY_IDENTIFIER BMS_CellVol79_phy /end MEASUREMENT
/begin MEASUREMENT cap_canApiMsg_BMS_CellVolMeas3_PT.BMS_CellVol79_raw "description" FLOAT32_IEEE cal_signal_objects_CM_single 0 0 0 4294967295 ECU_ADDRESS 0x00 DISPLAY_IDENTIFIER BMS_CellVol79_raw /end MEASUREMENT
/begin MEASUREMENT cap_canApiMsg_BMS_CellVolMeas3_PT.BMS_CellVol80_phy "description" FLOAT32_IEEE cal_signal_objects_CM_single 0 0 0 4294967295 ECU_ADDRESS 0x00 DISPLAY_IDENTIFIER BMS_CellVol80_phy /end MEASUREMENT
/begin MEASUREMENT cap_canApiMsg_BMS_CellVolMeas3_PT.BMS_CellVol80_raw "description" FLOAT32_IEEE cal_signal_objects_CM_single 0 0 0 4294967295 ECU_ADDRESS 0x00 DISPLAY_IDENTIFIER BMS_CellVol80_raw /end MEASUREMENT
/begin MEASUREMENT cap_canApiMsg_BMS_CellVolMeas3_PT.BMS_CellVol81_phy "description" FLOAT32_IEEE cal_signal_objects_CM_single 0 0 0 4294967295 ECU_ADDRESS 0x00 DISPLAY_IDENTIFIER BMS_CellVol81_phy /end MEASUREMENT
/begin MEASUREMENT cap_canApiMsg_BMS_CellVolMeas3_PT.BMS_CellVol81_raw "description" FLOAT32_IEEE cal_signal_objects_CM_single 0 0 0 4294967295 ECU_ADDRESS 0x00 DISPLAY_IDENTIFIER BMS_CellVol81_raw /end MEASUREMENT
/begin MEASUREMENT cap_canApiMsg_BMS_CellVolMeas3_PT.BMS_CellVol82_phy "description" FLOAT32_IEEE cal_signal_objects_CM_single 0 0 0 4294967295 ECU_ADDRESS 0x00 DISPLAY_IDENTIFIER BMS_CellVol82_phy /end MEASUREMENT
/begin MEASUREMENT cap_canApiMsg_BMS_CellVolMeas3_PT.BMS_CellVol82_raw "description" FLOAT32_IEEE cal_signal_objects_CM_single 0 0 0 4294967295 ECU_ADDRESS 0x00 DISPLAY_IDENTIFIER BMS_CellVol82_raw /end MEASUREMENT
/begin MEASUREMENT cap_canApiMsg_BMS_CellVolMeas3_PT.BMS_CellVol83_phy "description" FLOAT32_IEEE cal_signal_objects_CM_single 0 0 0 4294967295 ECU_ADDRESS 0x00 DISPLAY_IDENTIFIER BMS_CellVol83_phy /end MEASUREMENT
/begin MEASUREMENT cap_canApiMsg_BMS_CellVolMeas3_PT.BMS_CellVol83_raw "description" FLOAT32_IEEE cal_signal_objects_CM_single 0 0 0 4294967295 ECU_ADDRESS 0x00 DISPLAY_IDENTIFIER BMS_CellVol83_raw /end MEASUREMENT
/begin MEASUREMENT cap_canApiMsg_BMS_CellVolMeas3_PT.BMS_CellVol84_phy "description" FLOAT32_IEEE cal_signal_objects_CM_single 0 0 0 4294967295 ECU_ADDRESS 0x00 DISPLAY_IDENTIFIER BMS_CellVol84_phy /end MEASUREMENT
/begin MEASUREMENT cap_canApiMsg_BMS_CellVolMeas3_PT.BMS_CellVol84_raw "description" FLOAT32_IEEE cal_signal_objects_CM_single 0 0 0 4294967295 ECU_ADDRESS 0x00 DISPLAY_IDENTIFIER BMS_CellVol84_raw /end MEASUREMENT
/begin MEASUREMENT cap_canApiMsg_BMS_CellVolMeas3_PT.BMS_CellVol85_phy "description" FLOAT32_IEEE cal_signal_objects_CM_single 0 0 0 4294967295 ECU_ADDRESS 0x00 DISPLAY_IDENTIFIER BMS_CellVol85_phy /end MEASUREMENT
/begin MEASUREMENT cap_canApiMsg_BMS_CellVolMeas3_PT.BMS_CellVol85_raw "description" FLOAT32_IEEE cal_signal_objects_CM_single 0 0 0 4294967295 ECU_ADDRESS 0x00 DISPLAY_IDENTIFIER BMS_CellVol85_raw /end MEASUREMENT
/begin MEASUREMENT cap_canApiMsg_BMS_CellVolMeas3_PT.BMS_CellVol86_phy "description" FLOAT32_IEEE cal_signal_objects_CM_single 0 0 0 4294967295 ECU_ADDRESS 0x00 DISPLAY_IDENTIFIER BMS_CellVol86_phy /end MEASUREMENT
/begin MEASUREMENT cap_canApiMsg_BMS_CellVolMeas3_PT.BMS_CellVol86_raw "description" FLOAT32_IEEE cal_signal_objects_CM_single 0 0 0 4294967295 ECU_ADDRESS 0x00 DISPLAY_IDENTIFIER BMS_CellVol86_raw /end MEASUREMENT
/begin MEASUREMENT cap_canApiMsg_BMS_CellVolMeas3_PT.BMS_CellVol87_phy "description" FLOAT32_IEEE cal_signal_objects_CM_single 0 0 0 4294967295 ECU_ADDRESS 0x00 DISPLAY_IDENTIFIER BMS_CellVol87_phy /end MEASUREMENT
/begin MEASUREMENT cap_canApiMsg_BMS_CellVolMeas3_PT.BMS_CellVol87_raw "description" FLOAT32_IEEE cal_signal_objects_CM_single 0 0 0 4294967295 ECU_ADDRESS 0x00 DISPLAY_IDENTIFIER BMS_CellVol87_raw /end MEASUREMENT
/begin MEASUREMENT cap_canApiMsg_BMS_CellVolMeas3_PT.BMS_CellVol88_phy "description" FLOAT32_IEEE cal_signal_objects_CM_single 0 0 0 4294967295 ECU_ADDRESS 0x00 DISPLAY_IDENTIFIER BMS_CellVol88_phy /end MEASUREMENT
/begin MEASUREMENT cap_canApiMsg_BMS_CellVolMeas3_PT.BMS_CellVol88_raw "description" FLOAT32_IEEE cal_signal_objects_CM_single 0 0 0 4294967295 ECU_ADDRESS 0x00 DISPLAY_IDENTIFIER BMS_CellVol88_raw /end MEASUREMENT
/begin MEASUREMENT cap_canApiMsg_BMS_CellVolMeas3_PT.BMS_CellVol89_phy "description" FLOAT32_IEEE cal_signal_objects_CM_single 0 0 0 4294967295 ECU_ADDRESS 0x00 DISPLAY_IDENTIFIER BMS_CellVol89_phy /end MEASUREMENT
/begin MEASUREMENT cap_canApiMsg_BMS_CellVolMeas3_PT.BMS_CellVol89_raw "description" FLOAT32_IEEE cal_signal_objects_CM_single 0 0 0 4294967295 ECU_ADDRESS 0x00 DISPLAY_IDENTIFIER BMS_CellVol89_raw /end MEASUREMENT
/begin MEASUREMENT cap_canApiMsg_BMS_CellVolMeas3_PT.BMS_CellVol90_phy "description" FLOAT32_IEEE cal_signal_objects_CM_single 0 0 0 4294967295 ECU_ADDRESS 0x00 DISPLAY_IDENTIFIER BMS_CellVol90_phy /end MEASUREMENT
/begin MEASUREMENT cap_canApiMsg_BMS_CellVolMeas3_PT.BMS_CellVol90_raw "description" FLOAT32_IEEE cal_signal_objects_CM_single 0 0 0 4294967295 ECU_ADDRESS 0x00 DISPLAY_IDENTIFIER BMS_CellVol90_raw /end MEASUREMENT
/begin MEASUREMENT cap_canApiMsg_BMS_CellVolMeas3_PT.BMS_CellVol91_phy "description" FLOAT32_IEEE cal_signal_objects_CM_single 0 0 0 4294967295 ECU_ADDRESS 0x00 DISPLAY_IDENTIFIER BMS_CellVol91_phy /end MEASUREMENT
/begin MEASUREMENT cap_canApiMsg_BMS_CellVolMeas3_PT.BMS_CellVol91_raw "description" FLOAT32_IEEE cal_signal_objects_CM_single 0 0 0 4294967295 ECU_ADDRESS 0x00 DISPLAY_IDENTIFIER BMS_CellVol91_raw /end MEASUREMENT
/begin MEASUREMENT cap_canApiMsg_BMS_CellVolMeas3_PT.BMS_CellVol92_phy "description" FLOAT32_IEEE cal_signal_objects_CM_single 0 0 0 4294967295 ECU_ADDRESS 0x00 DISPLAY_IDENTIFIER BMS_CellVol92_phy /end MEASUREMENT
/begin MEASUREMENT cap_canApiMsg_BMS_CellVolMeas3_PT.BMS_CellVol92_raw "description" FLOAT32_IEEE cal_signal_objects_CM_single 0 0 0 4294967295 ECU_ADDRESS 0x00 DISPLAY_IDENTIFIER BMS_CellVol92_raw /end MEASUREMENT
/begin MEASUREMENT cap_canApiMsg_BMS_CellVolMeas3_PT.BMS_CellVol93_phy "description" FLOAT32_IEEE cal_signal_objects_CM_single 0 0 0 4294967295 ECU_ADDRESS 0x00 DISPLAY_IDENTIFIER BMS_CellVol93_phy /end MEASUREMENT
/begin MEASUREMENT cap_canApiMsg_BMS_CellVolMeas3_PT.BMS_CellVol93_raw "description" FLOAT32_IEEE cal_signal_objects_CM_single 0 0 0 4294967295 ECU_ADDRESS 0x00 DISPLAY_IDENTIFIER BMS_CellVol93_raw /end MEASUREMENT
/begin MEASUREMENT cap_canApiMsg_BMS_CellVolMeas3_PT.BMS_CellVol94_phy "description" FLOAT32_IEEE cal_signal_objects_CM_single 0 0 0 4294967295 ECU_ADDRESS 0x00 DISPLAY_IDENTIFIER BMS_CellVol94_phy /end MEASUREMENT
/begin MEASUREMENT cap_canApiMsg_BMS_CellVolMeas3_PT.BMS_CellVol94_raw "description" FLOAT32_IEEE cal_signal_objects_CM_single 0 0 0 4294967295 ECU_ADDRESS 0x00 DISPLAY_IDENTIFIER BMS_CellVol94_raw /end MEASUREMENT
/begin MEASUREMENT cap_canApiMsg_BMS_CellVolMeas3_PT.BMS_CellVol95_phy "description" FLOAT32_IEEE cal_signal_objects_CM_single 0 0 0 4294967295 ECU_ADDRESS 0x00 DISPLAY_IDENTIFIER BMS_CellVol95_phy /end MEASUREMENT
/begin MEASUREMENT cap_canApiMsg_BMS_CellVolMeas3_PT.BMS_CellVol95_raw "description" FLOAT32_IEEE cal_signal_objects_CM_single 0 0 0 4294967295 ECU_ADDRESS 0x00 DISPLAY_IDENTIFIER BMS_CellVol95_raw /end MEASUREMENT
/begin MEASUREMENT cap_canApiMsg_BMS_CellVolMeas3_PT.BMS_CellVol96_phy "description" FLOAT32_IEEE cal_signal_objects_CM_single 0 0 0 4294967295 ECU_ADDRESS 0x00 DISPLAY_IDENTIFIER BMS_CellVol96_phy /end MEASUREMENT
/begin MEASUREMENT cap_canApiMsg_BMS_CellVolMeas3_PT.BMS_CellVol96_raw "description" FLOAT32_IEEE cal_signal_objects_CM_single 0 0 0 4294967295 ECU_ADDRESS 0x00 DISPLAY_IDENTIFIER BMS_CellVol96_raw /end MEASUREMENT
/begin MEASUREMENT cap_canApiMsg_BMS_CellVolMeas3_PT.BMS_CellVol97_phy "description" FLOAT32_IEEE cal_signal_objects_CM_single 0 0 0 4294967295 ECU_ADDRESS 0x00 DISPLAY_IDENTIFIER BMS_CellVol97_phy /end MEASUREMENT
/begin MEASUREMENT cap_canApiMsg_BMS_CellVolMeas3_PT.BMS_CellVol97_raw "description" FLOAT32_IEEE cal_signal_objects_CM_single 0 0 0 4294967295 ECU_ADDRESS 0x00 DISPLAY_IDENTIFIER BMS_CellVol97_raw /end MEASUREMENT
/begin MEASUREMENT cap_canApiMsg_BMS_CellVolMeas3_PT.BMS_CellVol98_phy "description" FLOAT32_IEEE cal_signal_objects_CM_single 0 0 0 4294967295 ECU_ADDRESS 0x00 DISPLAY_IDENTIFIER BMS_CellVol98_phy /end MEASUREMENT
/begin MEASUREMENT cap_canApiMsg_BMS_CellVolMeas3_PT.BMS_CellVol98_raw "description" FLOAT32_IEEE cal_signal_objects_CM_single 0 0 0 4294967295 ECU_ADDRESS 0x00 DISPLAY_IDENTIFIER BMS_CellVol98_raw /end MEASUREMENT
/begin MEASUREMENT cap_canApiMsg_BMS_CellVolMeas3_PT.BMS_CellVol99_phy "description" FLOAT32_IEEE cal_signal_objects_CM_single 0 0 0 4294967295 ECU_ADDRESS 0x00 DISPLAY_IDENTIFIER BMS_CellVol99_phy /end MEASUREMENT
/begin MEASUREMENT cap_canApiMsg_BMS_CellVolMeas3_PT.BMS_CellVol99_raw "description" FLOAT32_IEEE cal_signal_objects_CM_single 0 0 0 4294967295 ECU_ADDRESS 0x00 DISPLAY_IDENTIFIER BMS_CellVol99_raw /end MEASUREMENT
/begin MEASUREMENT cap_canApiMsg_BMS_CellVolMeas3_PT.BMS_CellVol100_phy "description" FLOAT32_IEEE cal_signal_objects_CM_single 0 0 0 4294967295 ECU_ADDRESS 0x00 DISPLAY_IDENTIFIER BMS_CellVol100_phy /end MEASUREMENT
/begin MEASUREMENT cap_canApiMsg_BMS_CellVolMeas3_PT.BMS_CellVol100_raw "description" FLOAT32_IEEE cal_signal_objects_CM_single 0 0 0 4294967295 ECU_ADDRESS 0x00 DISPLAY_IDENTIFIER BMS_CellVol100_raw /end MEASUREMENT
/begin MEASUREMENT cap_canApiMsg_BMS_CellVolMeas3_PT.BMS_CellVol101_phy "description" FLOAT32_IEEE cal_signal_objects_CM_single 0 0 0 4294967295 ECU_ADDRESS 0x00 DISPLAY_IDENTIFIER BMS_CellVol101_phy /end MEASUREMENT
/begin MEASUREMENT cap_canApiMsg_BMS_CellVolMeas3_PT.BMS_CellVol101_raw "description" FLOAT32_IEEE cal_signal_objects_CM_single 0 0 0 4294967295 ECU_ADDRESS 0x00 DISPLAY_IDENTIFIER BMS_CellVol101_raw /end MEASUREMENT
/begin MEASUREMENT cap_canApiMsg_BMS_CellVolMeas3_PT.BMS_CellVol102_phy "description" FLOAT32_IEEE cal_signal_objects_CM_single 0 0 0 4294967295 ECU_ADDRESS 0x00 DISPLAY_IDENTIFIER BMS_CellVol102_phy /end MEASUREMENT
/begin MEASUREMENT cap_canApiMsg_BMS_CellVolMeas3_PT.BMS_CellVol102_raw "description" FLOAT32_IEEE cal_signal_objects_CM_single 0 0 0 4294967295 ECU_ADDRESS 0x00 DISPLAY_IDENTIFIER BMS_CellVol102_raw /end MEASUREMENT
/begin MEASUREMENT cap_canApiMsg_BMS_CellVolMeas3_PT.BMS_CellVol103_phy "description" FLOAT32_IEEE cal_signal_objects_CM_single 0 0 0 4294967295 ECU_ADDRESS 0x00 DISPLAY_IDENTIFIER BMS_CellVol103_phy /end MEASUREMENT
/begin MEASUREMENT cap_canApiMsg_BMS_CellVolMeas3_PT.BMS_CellVol103_raw "description" FLOAT32_IEEE cal_signal_objects_CM_single 0 0 0 4294967295 ECU_ADDRESS 0x00 DISPLAY_IDENTIFIER BMS_CellVol103_raw /end MEASUREMENT
/begin MEASUREMENT cap_canApiMsg_BMS_CellVolMeas3_PT.BMS_CellVol104_phy "description" FLOAT32_IEEE cal_signal_objects_CM_single 0 0 0 4294967295 ECU_ADDRESS 0x00 DISPLAY_IDENTIFIER BMS_CellVol104_phy /end MEASUREMENT
/begin MEASUREMENT cap_canApiMsg_BMS_CellVolMeas3_PT.BMS_CellVol104_raw "description" FLOAT32_IEEE cal_signal_objects_CM_single 0 0 0 4294967295 ECU_ADDRESS 0x00 DISPLAY_IDENTIFIER BMS_CellVol104_raw /end MEASUREMENT
/begin MEASUREMENT cap_canApiMsg_BMS_CellVolMeas3_PT.BMS_CellVol105_phy "description" FLOAT32_IEEE cal_signal_objects_CM_single 0 0 0 4294967295 ECU_ADDRESS 0x00 DISPLAY_IDENTIFIER BMS_CellVol105_phy /end MEASUREMENT
/begin MEASUREMENT cap_canApiMsg_BMS_CellVolMeas3_PT.BMS_CellVol105_raw "description" FLOAT32_IEEE cal_signal_objects_CM_single 0 0 0 4294967295 ECU_ADDRESS 0x00 DISPLAY_IDENTIFIER BMS_CellVol105_raw /end MEASUREMENT
/begin MEASUREMENT cap_canApiMsg_BMS_CellVolMeas3_PT.BMS_CellVol106_phy "description" FLOAT32_IEEE cal_signal_objects_CM_single 0 0 0 4294967295 ECU_ADDRESS 0x00 DISPLAY_IDENTIFIER BMS_CellVol106_phy /end MEASUREMENT
/begin MEASUREMENT cap_canApiMsg_BMS_CellVolMeas3_PT.BMS_CellVol106_raw "description" FLOAT32_IEEE cal_signal_objects_CM_single 0 0 0 4294967295 ECU_ADDRESS 0x00 DISPLAY_IDENTIFIER BMS_CellVol106_raw /end MEASUREMENT
/begin MEASUREMENT cap_canApiMsg_BMS_CellVolMeas3_PT.BMS_CellVol107_phy "description" FLOAT32_IEEE cal_signal_objects_CM_single 0 0 0 4294967295 ECU_ADDRESS 0x00 DISPLAY_IDENTIFIER BMS_CellVol107_phy /end MEASUREMENT
/begin MEASUREMENT cap_canApiMsg_BMS_CellVolMeas3_PT.BMS_CellVol107_raw "description" FLOAT32_IEEE cal_signal_objects_CM_single 0 0 0 4294967295 ECU_ADDRESS 0x00 DISPLAY_IDENTIFIER BMS_CellVol107_raw /end MEASUREMENT
/begin MEASUREMENT cap_canApiMsg_BMS_CellVolMeas3_PT.BMS_CellVol108_phy "description" FLOAT32_IEEE cal_signal_objects_CM_single 0 0 0 4294967295 ECU_ADDRESS 0x00 DISPLAY_IDENTIFIER BMS_CellVol108_phy /end MEASUREMENT
/begin MEASUREMENT cap_canApiMsg_BMS_CellVolMeas3_PT.BMS_CellVol108_raw "description" FLOAT32_IEEE cal_signal_objects_CM_single 0 0 0 4294967295 ECU_ADDRESS 0x00 DISPLAY_IDENTIFIER BMS_CellVol108_raw /end MEASUREMENT
/begin MEASUREMENT cap_canApiMsg_VCU_OBC_Req_PT.VCU_OBC_iLineLimit_phy "description" FLOAT32_IEEE cal_signal_objects_CM_single 0 0 0 4294967295 ECU_ADDRESS 0x00 DISPLAY_IDENTIFIER VCU_OBC_iLineLimit_phy /end MEASUREMENT
/begin MEASUREMENT cap_canApiMsg_VCU_OBC_Req_PT.VCU_OBC_iLineLimit_raw "description" FLOAT32_IEEE cal_signal_objects_CM_single 0 0 0 4294967295 ECU_ADDRESS 0x00 DISPLAY_IDENTIFIER VCU_OBC_iLineLimit_raw /end MEASUREMENT
/begin MEASUREMENT cap_canApiMsg_VCU_OBC_Req_PT.VCU_OBC_vOBC_Request_phy "description" FLOAT32_IEEE cal_signal_objects_CM_single 0 0 0 4294967295 ECU_ADDRESS 0x00 DISPLAY_IDENTIFIER VCU_OBC_vOBC_Request_phy /end MEASUREMENT
/begin MEASUREMENT cap_canApiMsg_VCU_OBC_Req_PT.VCU_OBC_vOBC_Request_raw "description" FLOAT32_IEEE cal_signal_objects_CM_single 0 0 0 4294967295 ECU_ADDRESS 0x00 DISPLAY_IDENTIFIER VCU_OBC_vOBC_Request_raw /end MEASUREMENT
/begin MEASUREMENT cap_canApiMsg_VCU_OBC_Req_PT.VCU_OBC_iOBC_Request_phy "description" FLOAT32_IEEE cal_signal_objects_CM_single 0 0 0 4294967295 ECU_ADDRESS 0x00 DISPLAY_IDENTIFIER VCU_OBC_iOBC_Request_phy /end MEASUREMENT
/begin MEASUREMENT cap_canApiMsg_VCU_OBC_Req_PT.VCU_OBC_iOBC_Request_raw "description" FLOAT32_IEEE cal_signal_objects_CM_single 0 0 0 4294967295 ECU_ADDRESS 0x00 DISPLAY_IDENTIFIER VCU_OBC_iOBC_Request_raw /end MEASUREMENT
/begin MEASUREMENT cap_canApiMsg_BMS_CoolantInletOutletTmp_PT.BMS_CoolantInletTemp_phy "description" FLOAT32_IEEE cal_signal_objects_CM_single 0 0 0 4294967295 ECU_ADDRESS 0x00 DISPLAY_IDENTIFIER BMS_CoolantInletTemp_phy /end MEASUREMENT
/begin MEASUREMENT cap_canApiMsg_BMS_CoolantInletOutletTmp_PT.BMS_CoolantInletTemp_raw "description" FLOAT32_IEEE cal_signal_objects_CM_single 0 0 0 4294967295 ECU_ADDRESS 0x00 DISPLAY_IDENTIFIER BMS_CoolantInletTemp_raw /end MEASUREMENT
/begin MEASUREMENT cap_canApiMsg_BMS_CoolantInletOutletTmp_PT.BMS_CoolantOutletTemp_phy "description" FLOAT32_IEEE cal_signal_objects_CM_single 0 0 0 4294967295 ECU_ADDRESS 0x00 DISPLAY_IDENTIFIER BMS_CoolantOutletTemp_phy /end MEASUREMENT
/begin MEASUREMENT cap_canApiMsg_BMS_CoolantInletOutletTmp_PT.BMS_CoolantOutletTemp_raw "description" FLOAT32_IEEE cal_signal_objects_CM_single 0 0 0 4294967295 ECU_ADDRESS 0x00 DISPLAY_IDENTIFIER BMS_CoolantOutletTemp_raw /end MEASUREMENT
/begin MEASUREMENT cap_canApiMsg_VCU_BMS_ChargingParams_PT.VCU_TargetASOC_phy "description" FLOAT32_IEEE cal_signal_objects_CM_single 0 0 0 4294967295 ECU_ADDRESS 0x00 DISPLAY_IDENTIFIER VCU_TargetASOC_phy /end MEASUREMENT
/begin MEASUREMENT cap_canApiMsg_VCU_BMS_ChargingParams_PT.VCU_TargetASOC_raw "description" FLOAT32_IEEE cal_signal_objects_CM_single 0 0 0 4294967295 ECU_ADDRESS 0x00 DISPLAY_IDENTIFIER VCU_TargetASOC_raw /end MEASUREMENT
/begin MEASUREMENT cap_canApiMsg_BMS_VCU_THMReq_PT.BMS_CoolPwrDemand_phy "description" FLOAT32_IEEE cal_signal_objects_CM_single 0 0 0 4294967295 ECU_ADDRESS 0x00 DISPLAY_IDENTIFIER BMS_CoolPwrDemand_phy /end MEASUREMENT
/begin MEASUREMENT cap_canApiMsg_BMS_VCU_THMReq_PT.BMS_CoolPwrDemand_raw "description" FLOAT32_IEEE cal_signal_objects_CM_single 0 0 0 4294967295 ECU_ADDRESS 0x00 DISPLAY_IDENTIFIER BMS_CoolPwrDemand_raw /end MEASUREMENT
/begin MEASUREMENT cap_canApiMsg_BMS_VCU_THMReq_PT.BMS_HeatPwrDemand_phy "description" FLOAT32_IEEE cal_signal_objects_CM_single 0 0 0 4294967295 ECU_ADDRESS 0x00 DISPLAY_IDENTIFIER BMS_HeatPwrDemand_phy /end MEASUREMENT
/begin MEASUREMENT cap_canApiMsg_BMS_VCU_THMReq_PT.BMS_HeatPwrDemand_raw "description" FLOAT32_IEEE cal_signal_objects_CM_single 0 0 0 4294967295 ECU_ADDRESS 0x00 DISPLAY_IDENTIFIER BMS_HeatPwrDemand_raw /end MEASUREMENT
/begin MEASUREMENT cap_canApiMsg_BMS_VolMeas_PT.BMS_MinCellVol_phy "description" FLOAT32_IEEE cal_signal_objects_CM_single 0 0 0 4294967295 ECU_ADDRESS 0x00 DISPLAY_IDENTIFIER BMS_MinCellVol_phy /end MEASUREMENT
/begin MEASUREMENT cap_canApiMsg_BMS_VolMeas_PT.BMS_MinCellVol_raw "description" FLOAT32_IEEE cal_signal_objects_CM_single 0 0 0 4294967295 ECU_ADDRESS 0x00 DISPLAY_IDENTIFIER BMS_MinCellVol_raw /end MEASUREMENT
/begin MEASUREMENT cap_canApiMsg_BMS_VolMeas_PT.BMS_MaxCellVol_phy "description" FLOAT32_IEEE cal_signal_objects_CM_single 0 0 0 4294967295 ECU_ADDRESS 0x00 DISPLAY_IDENTIFIER BMS_MaxCellVol_phy /end MEASUREMENT
/begin MEASUREMENT cap_canApiMsg_BMS_VolMeas_PT.BMS_MaxCellVol_raw "description" FLOAT32_IEEE cal_signal_objects_CM_single 0 0 0 4294967295 ECU_ADDRESS 0x00 DISPLAY_IDENTIFIER BMS_MaxCellVol_raw /end MEASUREMENT
/begin MEASUREMENT cap_canApiMsg_BMS_VolMeas_PT.BMS_MaxMinDiffCellVol_phy "description" FLOAT32_IEEE cal_signal_objects_CM_single 0 0 0 4294967295 ECU_ADDRESS 0x00 DISPLAY_IDENTIFIER BMS_MaxMinDiffCellVol_phy /end MEASUREMENT
/begin MEASUREMENT cap_canApiMsg_BMS_VolMeas_PT.BMS_MaxMinDiffCellVol_raw "description" FLOAT32_IEEE cal_signal_objects_CM_single 0 0 0 4294967295 ECU_ADDRESS 0x00 DISPLAY_IDENTIFIER BMS_MaxMinDiffCellVol_raw /end MEASUREMENT
/begin MEASUREMENT cap_canApiMsg_DCDC_VCU_Temperature_Fbk_PT.DCDC_InternalTempA_phy "description" FLOAT32_IEEE cal_signal_objects_CM_single 0 0 0 4294967295 ECU_ADDRESS 0x00 DISPLAY_IDENTIFIER DCDC_InternalTempA_phy /end MEASUREMENT
/begin MEASUREMENT cap_canApiMsg_DCDC_VCU_Temperature_Fbk_PT.DCDC_InternalTempA_raw "description" FLOAT32_IEEE cal_signal_objects_CM_single 0 0 0 4294967295 ECU_ADDRESS 0x00 DISPLAY_IDENTIFIER DCDC_InternalTempA_raw /end MEASUREMENT
/begin MEASUREMENT cap_canApiMsg_DCDC_VCU_Temperature_Fbk_PT.DCDC_InternalTempB_phy "description" FLOAT32_IEEE cal_signal_objects_CM_single 0 0 0 4294967295 ECU_ADDRESS 0x00 DISPLAY_IDENTIFIER DCDC_InternalTempB_phy /end MEASUREMENT
/begin MEASUREMENT cap_canApiMsg_DCDC_VCU_Temperature_Fbk_PT.DCDC_InternalTempB_raw "description" FLOAT32_IEEE cal_signal_objects_CM_single 0 0 0 4294967295 ECU_ADDRESS 0x00 DISPLAY_IDENTIFIER DCDC_InternalTempB_raw /end MEASUREMENT
/begin MEASUREMENT cap_canApiMsg_DCDC_VCU_Temperature_Fbk_PT.DCDC_InternalTempC_phy "description" FLOAT32_IEEE cal_signal_objects_CM_single 0 0 0 4294967295 ECU_ADDRESS 0x00 DISPLAY_IDENTIFIER DCDC_InternalTempC_phy /end MEASUREMENT
/begin MEASUREMENT cap_canApiMsg_DCDC_VCU_Temperature_Fbk_PT.DCDC_InternalTempC_raw "description" FLOAT32_IEEE cal_signal_objects_CM_single 0 0 0 4294967295 ECU_ADDRESS 0x00 DISPLAY_IDENTIFIER DCDC_InternalTempC_raw /end MEASUREMENT
/begin MEASUREMENT cap_canApiMsg_DCDC_VCU_Temperature_Fbk_PT.DCDC_CoolPwrDemand_phy "description" FLOAT32_IEEE cal_signal_objects_CM_single 0 0 0 4294967295 ECU_ADDRESS 0x00 DISPLAY_IDENTIFIER DCDC_CoolPwrDemand_phy /end MEASUREMENT
/begin MEASUREMENT cap_canApiMsg_DCDC_VCU_Temperature_Fbk_PT.DCDC_CoolPwrDemand_raw "description" FLOAT32_IEEE cal_signal_objects_CM_single 0 0 0 4294967295 ECU_ADDRESS 0x00 DISPLAY_IDENTIFIER DCDC_CoolPwrDemand_raw /end MEASUREMENT
/begin MEASUREMENT cap_canApiMsg_Kilometerstand_2_PT.MILE_KM_TOT_phy "description" FLOAT32_IEEE cal_signal_objects_CM_single 0 0 0 4294967295 ECU_ADDRESS 0x00 DISPLAY_IDENTIFIER MILE_KM_TOT_phy /end MEASUREMENT
/begin MEASUREMENT cap_canApiMsg_Kilometerstand_2_PT.MILE_KM_TOT_raw "description" FLOAT32_IEEE cal_signal_objects_CM_single 0 0 0 4294967295 ECU_ADDRESS 0x00 DISPLAY_IDENTIFIER MILE_KM_TOT_raw /end MEASUREMENT
/begin MEASUREMENT cap_canApiMsg_VCU_DCDC_Req_PT.VCU_OutVltgReq_phy "description" FLOAT32_IEEE cal_signal_objects_CM_single 0 0 0 4294967295 ECU_ADDRESS 0x00 DISPLAY_IDENTIFIER VCU_OutVltgReq_phy /end MEASUREMENT
/begin MEASUREMENT cap_canApiMsg_VCU_DCDC_Req_PT.VCU_OutVltgReq_raw "description" FLOAT32_IEEE cal_signal_objects_CM_single 0 0 0 4294967295 ECU_ADDRESS 0x00 DISPLAY_IDENTIFIER VCU_OutVltgReq_raw /end MEASUREMENT
/begin MEASUREMENT cap_canApiMsg_VCU_DCDC_Req_PT.VCU_OutCurReq_phy "description" FLOAT32_IEEE cal_signal_objects_CM_single 0 0 0 4294967295 ECU_ADDRESS 0x00 DISPLAY_IDENTIFIER VCU_OutCurReq_phy /end MEASUREMENT
/begin MEASUREMENT cap_canApiMsg_VCU_DCDC_Req_PT.VCU_OutCurReq_raw "description" FLOAT32_IEEE cal_signal_objects_CM_single 0 0 0 4294967295 ECU_ADDRESS 0x00 DISPLAY_IDENTIFIER VCU_OutCurReq_raw /end MEASUREMENT
/begin MEASUREMENT cap_canApiMsg_OBC_Temperature_PT.OBC_InternalTemp_phy "description" FLOAT32_IEEE cal_signal_objects_CM_single 0 0 0 4294967295 ECU_ADDRESS 0x00 DISPLAY_IDENTIFIER OBC_InternalTemp_phy /end MEASUREMENT
/begin MEASUREMENT cap_canApiMsg_OBC_Temperature_PT.OBC_InternalTemp_raw "description" FLOAT32_IEEE cal_signal_objects_CM_single 0 0 0 4294967295 ECU_ADDRESS 0x00 DISPLAY_IDENTIFIER OBC_InternalTemp_raw /end MEASUREMENT
/begin MEASUREMENT cap_canApiMsg_OBC_Temperature_PT.OBC_CoolPwrDemand_phy "description" FLOAT32_IEEE cal_signal_objects_CM_single 0 0 0 4294967295 ECU_ADDRESS 0x00 DISPLAY_IDENTIFIER OBC_CoolPwrDemand_phy /end MEASUREMENT
/begin MEASUREMENT cap_canApiMsg_OBC_Temperature_PT.OBC_CoolPwrDemand_raw "description" FLOAT32_IEEE cal_signal_objects_CM_single 0 0 0 4294967295 ECU_ADDRESS 0x00 DISPLAY_IDENTIFIER OBC_CoolPwrDemand_raw /end MEASUREMENT
/begin MEASUREMENT cap_canApiMsg_A_TEMP_PT.TEMP_EX_phy "description" FLOAT32_IEEE cal_signal_objects_CM_single 0 0 0 4294967295 ECU_ADDRESS 0x00 DISPLAY_IDENTIFIER TEMP_EX_phy /end MEASUREMENT
/begin MEASUREMENT cap_canApiMsg_A_TEMP_PT.TEMP_EX_raw "description" FLOAT32_IEEE cal_signal_objects_CM_single 0 0 0 4294967295 ECU_ADDRESS 0x00 DISPLAY_IDENTIFIER TEMP_EX_raw /end MEASUREMENT
/begin MEASUREMENT cap_canApiMsg_DMEBK100_PT.ActValVolFlowCoolantETractSys2_phy "description" FLOAT32_IEEE cal_signal_objects_CM_single 0 0 0 4294967295 ECU_ADDRESS 0x00 DISPLAY_IDENTIFIER ActValVolFlowCoolantETractSys2_phy /end MEASUREMENT
/begin MEASUREMENT cap_canApiMsg_DMEBK100_PT.ActValVolFlowCoolantETractSys2_raw "description" FLOAT32_IEEE cal_signal_objects_CM_single 0 0 0 4294967295 ECU_ADDRESS 0x00 DISPLAY_IDENTIFIER ActValVolFlowCoolantETractSys2_raw /end MEASUREMENT
/begin MEASUREMENT cap_canApiMsg_DMEBK100_PT.ActValVolFlowCoolantETractSys1_phy "description" FLOAT32_IEEE cal_signal_objects_CM_single 0 0 0 4294967295 ECU_ADDRESS 0x00 DISPLAY_IDENTIFIER ActValVolFlowCoolantETractSys1_phy /end MEASUREMENT
/begin MEASUREMENT cap_canApiMsg_DMEBK100_PT.ActValVolFlowCoolantETractSys1_raw "description" FLOAT32_IEEE cal_signal_objects_CM_single 0 0 0 4294967295 ECU_ADDRESS 0x00 DISPLAY_IDENTIFIER ActValVolFlowCoolantETractSys1_raw /end MEASUREMENT
/begin MEASUREMENT cap_canApiMsg_CombinedChargerUnit100msNo1_PT.RequestPowerETractSys1Loss_phy "description" FLOAT32_IEEE cal_signal_objects_CM_single 0 0 0 4294967295 ECU_ADDRESS 0x00 DISPLAY_IDENTIFIER RequestPowerETractSys1Loss_phy /end MEASUREMENT
/begin MEASUREMENT cap_canApiMsg_CombinedChargerUnit100msNo1_PT.RequestPowerETractSys1Loss_raw "description" FLOAT32_IEEE cal_signal_objects_CM_single 0 0 0 4294967295 ECU_ADDRESS 0x00 DISPLAY_IDENTIFIER RequestPowerETractSys1Loss_raw /end MEASUREMENT
/begin MEASUREMENT cap_canApiMsg_CombinedChargerUnit100msNo1_PT.RequestPowerETractSys2Loss_phy "description" FLOAT32_IEEE cal_signal_objects_CM_single 0 0 0 4294967295 ECU_ADDRESS 0x00 DISPLAY_IDENTIFIER RequestPowerETractSys2Loss_phy /end MEASUREMENT
/begin MEASUREMENT cap_canApiMsg_CombinedChargerUnit100msNo1_PT.RequestPowerETractSys2Loss_raw "description" FLOAT32_IEEE cal_signal_objects_CM_single 0 0 0 4294967295 ECU_ADDRESS 0x00 DISPLAY_IDENTIFIER RequestPowerETractSys2Loss_raw /end MEASUREMENT
/begin MEASUREMENT cap_canApiMsg_TLT_RW_PT.AVL_LOGR_RW_phy "description" FLOAT32_IEEE cal_signal_objects_CM_single 0 0 0 4294967295 ECU_ADDRESS 0x00 DISPLAY_IDENTIFIER AVL_LOGR_RW_phy /end MEASUREMENT
/begin MEASUREMENT cap_canApiMsg_TLT_RW_PT.AVL_LOGR_RW_raw "description" FLOAT32_IEEE cal_signal_objects_CM_single 0 0 0 4294967295 ECU_ADDRESS 0x00 DISPLAY_IDENTIFIER AVL_LOGR_RW_raw /end MEASUREMENT
/begin MEASUREMENT cap_canApiMsg_EnergyStorageMeasurementValues_PT.EnergyStorageClamp30VoltageValue_phy "description" FLOAT32_IEEE cal_signal_objects_CM_single 0 0 0 4294967295 ECU_ADDRESS 0x00 DISPLAY_IDENTIFIER EnergyStorageClamp30VoltageValue_phy /end MEASUREMENT
/begin MEASUREMENT cap_canApiMsg_EnergyStorageMeasurementValues_PT.EnergyStorageClamp30VoltageValue_raw "description" FLOAT32_IEEE cal_signal_objects_CM_single 0 0 0 4294967295 ECU_ADDRESS 0x00 DISPLAY_IDENTIFIER EnergyStorageClamp30VoltageValue_raw /end MEASUREMENT
/begin MEASUREMENT cap_canApiMsg_StatusCrashIdentETractSys1_PT.TempETractSys1DirectCurrentPlug_phy "description" FLOAT32_IEEE cal_signal_objects_CM_single 0 0 0 4294967295 ECU_ADDRESS 0x00 DISPLAY_IDENTIFIER TempETractSys1DirectCurrentPlug_phy /end MEASUREMENT
/begin MEASUREMENT cap_canApiMsg_StatusCrashIdentETractSys1_PT.TempETractSys1DirectCurrentPlug_raw "description" FLOAT32_IEEE cal_signal_objects_CM_single 0 0 0 4294967295 ECU_ADDRESS 0x00 DISPLAY_IDENTIFIER TempETractSys1DirectCurrentPlug_raw /end MEASUREMENT
/begin MEASUREMENT cap_canApiMsg_StatusCrashIdentETractSys2_PT.TempETractSys2DirectCurrentPlug_phy "description" FLOAT32_IEEE cal_signal_objects_CM_single 0 0 0 4294967295 ECU_ADDRESS 0x00 DISPLAY_IDENTIFIER TempETractSys2DirectCurrentPlug_phy /end MEASUREMENT
/begin MEASUREMENT cap_canApiMsg_StatusCrashIdentETractSys2_PT.TempETractSys2DirectCurrentPlug_raw "description" FLOAT32_IEEE cal_signal_objects_CM_single 0 0 0 4294967295 ECU_ADDRESS 0x00 DISPLAY_IDENTIFIER TempETractSys2DirectCurrentPlug_raw /end MEASUREMENT
/begin MEASUREMENT cap_canApiMsg_CombinedChargerUnit1000msNo1_PT.TemperatureCoolantOutput_phy "description" FLOAT32_IEEE cal_signal_objects_CM_single 0 0 0 4294967295 ECU_ADDRESS 0x00 DISPLAY_IDENTIFIER TemperatureCoolantOutput_phy /end MEASUREMENT
/begin MEASUREMENT cap_canApiMsg_CombinedChargerUnit1000msNo1_PT.TemperatureCoolantOutput_raw "description" FLOAT32_IEEE cal_signal_objects_CM_single 0 0 0 4294967295 ECU_ADDRESS 0x00 DISPLAY_IDENTIFIER TemperatureCoolantOutput_raw /end MEASUREMENT
/end MODULE
/end PROJECT
